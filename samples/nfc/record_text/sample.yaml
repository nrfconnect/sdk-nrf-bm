## samples/nfc/record_text/sample.yaml
```yaml
sample:
  description: NFC Records text sample
  name: NFC Records text
tests:
  sample.nfc.record_text:
    sysbuild: true
    build_only: true
    integration_platforms:
      - bm_nrf54l15dk/nrf54l05/cpuapp/s115_softdevice
      - bm_nrf54l15dk/nrf54l10/cpuapp/s115_softdevice
      - bm_nrf54l15dk/nrf54l15/cpuapp/s115_softdevice
    platform_allow:
      - bm_nrf54l15dk/nrf54l05/cpuapp/s115_softdevice
      - bm_nrf54l15dk/nrf54l10/cpuapp/s115_softdevice
      - bm_nrf54l15dk/nrf54l15/cpuapp/s115_softdevice
    tags: ci_build
```

## samples/subsys/storage/storage/Kconfig
```kconfig
#
# Copyright (c) 2025 Nordic Semiconductor ASA
#
# SPDX-License-Identifier: LicenseRef-Nordic-5-Clause
#

menu "Storage sample"

module=APP_STORAGE
module-str=Storage Sample
source "$(ZEPHYR_BASE)/subsys/logging/Kconfig.template.log_config"

endmenu # "Storage sample"

source "Kconfig.zephyr"
```

## samples/subsys/storage/storage/sample.yaml
```yaml
sample:
  name: Storage Sample
tests:
  sample.storage:
    sysbuild: true
    build_only: true
    integration_platforms:
      - bm_nrf54l15dk/nrf54l05/cpuapp/s115_softdevice
      - bm_nrf54l15dk/nrf54l10/cpuapp/s115_softdevice
      - bm_nrf54l15dk/nrf54l15/cpuapp/s115_softdevice
      - bm_nrf54l15dk/nrf54l05/cpuapp/s115_softdevice/mcuboot
      - bm_nrf54l15dk/nrf54l10/cpuapp/s115_softdevice/mcuboot
      - bm_nrf54l15dk/nrf54l15/cpuapp/s115_softdevice/mcuboot
    platform_allow:
      - bm_nrf54l15dk/nrf54l05/cpuapp/s115_softdevice
      - bm_nrf54l15dk/nrf54l10/cpuapp/s115_softdevice
      - bm_nrf54l15dk/nrf54l15/cpuapp/s115_softdevice
      - bm_nrf54l15dk/nrf54l05/cpuapp/s115_softdevice/mcuboot
      - bm_nrf54l15dk/nrf54l10/cpuapp/s115_softdevice/mcuboot
      - bm_nrf54l15dk/nrf54l15/cpuapp/s115_softdevice/mcuboot
    tags: ci_build
  sample.storage_rram:
    sysbuild: true
    build_only: true
    integration_platforms:
      - bm_nrf54l15dk/nrf54l05/cpuapp/s115_softdevice
      - bm_nrf54l15dk/nrf54l10/cpuapp/s115_softdevice
      - bm_nrf54l15dk/nrf54l15/cpuapp/s115_softdevice
      - bm_nrf54l15dk/nrf54l05/cpuapp/s115_softdevice/mcuboot
      - bm_nrf54l15dk/nrf54l10/cpuapp/s115_softdevice/mcuboot
      - bm_nrf54l15dk/nrf54l15/cpuapp/s115_softdevice/mcuboot
    platform_allow:
      - bm_nrf54l15dk/nrf54l05/cpuapp/s115_softdevice
      - bm_nrf54l15dk/nrf54l10/cpuapp/s115_softdevice
      - bm_nrf54l15dk/nrf54l15/cpuapp/s115_softdevice
      - bm_nrf54l15dk/nrf54l05/cpuapp/s115_softdevice/mcuboot
      - bm_nrf54l15dk/nrf54l10/cpuapp/s115_softdevice/mcuboot
      - bm_nrf54l15dk/nrf54l15/cpuapp/s115_softdevice/mcuboot
    extra_args: EXTRA_CONF_FILE=storage-rram.conf
    tags: ci_build
```

## soc/nordic/nrf54l/Kconfig
```kconfig
if SOC_SERIES_NRF54LX

config SOC_NORDIC_NRF54L_LFXO_SOMETHING_A
	bool "Enable some SoC LFXO option with this"
	help
	  some descriptive text of what this does

choice SOC_NORDIC_NRF54L_LFXO_CAP
	prompt "LFXO capacitance"
	default SOC_NORDIC_NRF54L_LFXO_CAP_1_0PF

config SOC_NORDIC_NRF54L_LFXO_CAP_1_0PF
	bool "1pF"

config SOC_NORDIC_NRF54L_LFXO_CAP_0_5PF
	bool "0.5pF"

endchoice # SOC_NORDIC_NRF54L_LFXO_CAP

endif # SOC_SERIES_NRF54LX
```

## subsys/Kconfig
```kconfig
#
# Copyright (c) 2024 Nordic Semiconductor
#
# SPDX-License-Identifier: LicenseRef-Nordic-5-Clause
#

menu "Subsystems"

# zephyr-keep-sorted-start
rsource "bluetooth/Kconfig"
rsource "bm_installs/Kconfig"
rsource "fs/Kconfig"
rsource "logging/Kconfig"
rsource "mgmt/mcumgr/Kconfig"
rsource "nfc/Kconfig"
rsource "settings/Kconfig"
rsource "softdevice/Kconfig"
rsource "softdevice_handler/Kconfig"
rsource "storage/Kconfig"
# zephyr-keep-sorted-stop

endmenu
```

## subsys/ble/Kconfig
```kconfig
#
# Copyright (c) 2024 Nordic Semiconductor
#
# SPDX-License-Identifier: LicenseRef-Nordic-5-Clause
#

menu "SoftDevice BLE services"

rsource "services/Kconfig"

endmenu
```

## subsys/ble/services/Kconfig.template.sec_mode
```kconfig
#
# Copyright (c) 2024 Nordic Semiconductor ASA
#
# SPDX-License-Identifier: LicenseRef-Nordic-5-Clause
#

choice "$(characteristic)_SEC_MODE_CHOICE"
	prompt "Security mode for $(characteristic-str)"
	default $(characteristic)_SEC_MODE_JUST_WORKS

config $(characteristic)_SEC_MODE_JUST_WORKS
	bool "Just works (open)"
	help
	  No security is needed (aka open link).

config $(characteristic)_SEC_MODE_ENCRYPTED
	bool "Encrypted"
	help
	  Encrypted link required, MITM protection not necessary.

config $(characteristic)_SEC_MODE_ENCRYPTED_MITM
	bool "Encrypted, with MITM protection"
	help
	  MITM protected encrypted link required.

config $(characteristic)_SEC_MODE_LESC_ENCRYPTED_MITM
	bool "LESC encryption, with MITM protection"
	help
	  LESC MITM protected encrypted link using a 128-bit strength encryption key required.

config $(characteristic)_SEC_MODE_SIGNED
	bool "Signing or encryption"
	help
	  Signing or encryption required, MITM protection not necessary.

config $(characteristic)_SEC_MODE_SIGNED_MITM
	bool "Signing or encryption, with MITM protection"
	help
	   MITM protected signing required, unless link is MITM protected encrypted.

endchoice

config $(characteristic)_SEC_MODE
	hex
	default 0x11 if $(characteristic)_SEC_MODE_JUST_WORKS
	default 0x12 if $(characteristic)_SEC_MODE_ENCRYPTED
	default 0x13 if $(characteristic)_SEC_MODE_ENCRYPTED_MITM
	default 0x14 if $(characteristic)_SEC_MODE_LESC_ENCRYPTED_MITM
	default 0x21 if $(characteristic)_SEC_MODE_SIGNED
	default 0x22 if $(characteristic)_SEC_MODE_SIGNED_MITM
```

## subsys/bluetooth/Kconfig
```kconfig
#
# Copyright (c) 2024 Nordic Semiconductor
#
# SPDX-License-Identifier: LicenseRef-Nordic-5-Clause
#

menu "SoftDevice Bluetooth LE services"

rsource "services/Kconfig"

endmenu
```

## subsys/bluetooth/services/Kconfig
```kconfig
#
# Copyright (c) 2024 Nordic Semiconductor ASA
#
# SPDX-License-Identifier: LicenseRef-Nordic-5-Clause
#
rsource "ble_bas/Kconfig"
rsource "ble_cgms/Kconfig"
rsource "ble_dis/Kconfig"
rsource "ble_hids/Kconfig"
rsource "ble_hrs/Kconfig"
rsource "ble_lbs/Kconfig"
rsource "ble_nus/Kconfig"
rsource "ble_mcumgr/Kconfig"
```

## subsys/bluetooth/services/Kconfig.bms
```kconfig
#
# Copyright (c) 2025 Nordic Semiconductor ASA
#
# SPDX-License-Identifier: LicenseRef-Nordic-5-Clause
#
menuconfig BLE_BMS
	bool "Bond management service"

if BLE_BMS

config NRF_BLE_BMS_BLE_OBSERVER_PRIO
	int "Softdevice event observer priority"
	default 0

module=BLE_BMS
module-dep=LOG
module-str=BLE_BMS
source "${ZEPHYR_BASE}/subsys/logging/Kconfig.template.log_config"

endif
```

## subsys/bluetooth/services/Kconfig.hrs
```kconfig
#
# Copyright (c) 2024 Nordic Semiconductor ASA
#
# SPDX-License-Identifier: LicenseRef-Nordic-5-Clause
#
menuconfig BLE_HRS
	bool "Heart rate service"
	depends on BLE_CONN_PARAMS_AUTO_ATT_MTU

if BLE_HRS

config BLE_HRS_MAX_BUFFERED_RR_INTERVALS
	int "Size of RR Interval buffers"
	default 20

module=BLE_HRS
module-dep=LOG
module-str=BLE Heart rate service
source "${ZEPHYR_BASE}/subsys/logging/Kconfig.template.log_config"

endif
```

## subsys/bluetooth/services/Kconfig.lbs
```kconfig
#
# Copyright (c) 2025 Nordic Semiconductor ASA
#
# SPDX-License-Identifier: LicenseRef-Nordic-5-Clause
#

menuconfig BLE_LBS
	bool "BLE LED Button service"

if BLE_LBS

module=BLE_LBS
module-dep=LOG
module-str=BLE LED Button service
source "${ZEPHYR_BASE}/subsys/logging/Kconfig.template.log_config"

endif
```

## subsys/bluetooth/services/Kconfig.nus
```kconfig
#
# Copyright (c) 2025 Nordic Semiconductor ASA
#
# SPDX-License-Identifier: LicenseRef-Nordic-5-Clause
#
menuconfig BLE_NUS
	bool "Nordic UART service"
	depends on NRF_BLE_QWR

if BLE_NUS

config  BLE_NUS_MAX_CLIENTS
	int "Max NUS clients"
	range 0 NRF_SDH_BLE_PERIPHERAL_LINK_COUNT
	default 1

module=BLE_NUS
module-dep=LOG
module-str=BLE Nordic UART Service
source "${ZEPHYR_BASE}/subsys/logging/Kconfig.template.log_config"

endif
```

## subsys/bluetooth/services/ble_bas/Kconfig
```kconfig
#
# Copyright (c) 2024 Nordic Semiconductor ASA
#
# SPDX-License-Identifier: LicenseRef-Nordic-5-Clause
#
menuconfig BLE_BAS
	bool "Battery service"
	depends on SOFTDEVICE_PERIPHERAL
	depends on NRF_SDH_BLE

if BLE_BAS

module=BLE_BAS
module-str=BLE Battery service
source "$(ZEPHYR_BASE)/subsys/logging/Kconfig.template.log_config"

endif
```

## subsys/bluetooth/services/ble_bas_client/Kconfig
```kconfig
#
# Copyright (c) 2026 Nordic Semiconductor
#
# SPDX-License-Identifier: LicenseRef-Nordic-5-Clause
#

menuconfig BLE_BAS_CLIENT
	bool "BLE battery service client [EXPERIMENTAL]"
	depends on SOFTDEVICE_CENTRAL
	depends on NRF_SDH_BLE
	depends on BLE_DB_DISCOVERY
	depends on BLE_GATT_QUEUE
	select EXPERIMENTAL
	help
	  battery service client library.

if BLE_BAS_CLIENT

module=BLE_BAS_CLIENT
module-str=BLE battery client
source "$(ZEPHYR_BASE)/subsys/logging/Kconfig.template.log_config"

endif # BLE_BAS_CLIENT
```

## subsys/bluetooth/services/ble_bms/Kconfig
```kconfig
#
# Copyright (c) 2025 Nordic Semiconductor ASA
#
# SPDX-License-Identifier: LicenseRef-Nordic-5-Clause
#
menuconfig BLE_BMS
	bool "Bond management service [EXPERIMENTAL]"
	select EXPERIMENTAL
	depends on SOFTDEVICE_PERIPHERAL
	depends on NRF_SDH_BLE
	depends on BLE_QWR

if BLE_BMS

module=BLE_BMS
module-str=BLE_BMS
source "$(ZEPHYR_BASE)/subsys/logging/Kconfig.template.log_config"

endif
```

## subsys/bluetooth/services/ble_cgms/Kconfig
```kconfig
#
# Copyright (c) 2025 Nordic Semiconductor ASA
#
# SPDX-License-Identifier: LicenseRef-Nordic-5-Clause
#
menuconfig BLE_CGMS
	bool "Continuous glucose monitoring service [EXPERIMENTAL]"
	depends on SOFTDEVICE_PERIPHERAL
	depends on NRF_SDH_BLE
	depends on BLE_GATT_QUEUE
	depends on BLE_RACP
	select EXPERIMENTAL

if BLE_CGMS

config BLE_CGMS_DB_RECORDS_MAX
	int "Number of records that can be stored in the database"
	default 100

module=BLE_CGMS
module-str=BLE CGMS
source "$(ZEPHYR_BASE)/subsys/logging/Kconfig.template.log_config"

endif
```

## subsys/bluetooth/services/ble_dis/Kconfig
```kconfig
#
# Copyright (c) 2024 Nordic Semiconductor ASA
#
# SPDX-License-Identifier: LicenseRef-Nordic-5-Clause
#
menuconfig BLE_DIS
	bool "Device Information Service"
	depends on SOFTDEVICE
	help
	  Enable the Bluetooth LE Device Information Service (DIS).
	  The values configured here are used as the build-time defaults,
	  applied when the application passes no run-time values to ble_dis_init().

if BLE_DIS

config BLE_DIS_MANUFACTURER_NAME
	string "Manufacturer Name"
	default "Nordic Semiconductor"
	help
	  Manufacturer Name characteristic value inside Device Information Service.
	  Leave empty to omit the characteristic from the service.

config BLE_DIS_MODEL_NUMBER
	string "Model Number"
	default SOC
	help
	  Model Number characteristic value inside Device Information Service.
	  Defaults to the SoC name.
	  Leave empty to omit the characteristic from the service.

config BLE_DIS_SERIAL_NUMBER
	string "Serial Number"
	help
	  Serial Number characteristic value inside Device Information Service.
	  Leave empty to omit the characteristic from the service.

config BLE_DIS_HW_REVISION
	string "Hardware Revision"
	help
	  Hardware Revision characteristic value inside Device Information Service.
	  Leave empty to omit the characteristic from the service.

config BLE_DIS_FW_REVISION
	string "Firmware Revision"
	help
	  Firmware Revision characteristic value inside Device Information Service.
	  Leave empty to omit the characteristic from the service.

config BLE_DIS_SW_REVISION
	string "Software Revision"
	help
	  Software Revision characteristic value inside Device Information Service.
	  Leave empty to omit the characteristic from the service.

config BLE_DIS_SYSTEM_ID
	bool "Include System ID characteristic"
	help
	  Include the System ID characteristic in the Device Information Service.
	  The System ID is an 8-octet value built from a Manufacturer Identifier
	  (5 octets) and an Organizationally Unique Identifier (3 octets).

config BLE_DIS_SYSTEM_ID_OUI
	hex "Organizationally Unique Identifier (OUI)"
	depends on BLE_DIS_SYSTEM_ID
	range 0 0xFFFFFF # 3 bytes
	help
	  Organizationally Unique Identifier (OUI). Only the 3 least significant
	  octets are used.

config BLE_DIS_SYSTEM_ID_MID
	hex "Manufacturer Identifier (MID)"
	depends on BLE_DIS_SYSTEM_ID
	range 0 0xFFFFFFFFFF # 5 bytes
	help
	  Manufacturer Identifier. Only the 5 least significant octets are used.

config BLE_DIS_PNP_ID
	bool "Include Plug and Play ID characteristic"
	help
	  Include the PnP ID characteristic in the Device Information Service.

if BLE_DIS_PNP_ID

config BLE_DIS_PNP_VID_SRC
	hex "PnP Vendor ID source"
	range 1 2
	default 1
	help
	  Source of the Vendor ID field:
	    1 - Vendor ID assigned by the Bluetooth SIG.
	    2 - Vendor ID assigned by the USB Implementer's Forum.

config BLE_DIS_PNP_VID
	hex "PnP Vendor ID"
	range 0 0xFFFF
	default 0
	help
	  Vendor ID, assigned by the body selected in BLE_DIS_PNP_VID_SRC.

config BLE_DIS_PNP_PID
	hex "PnP Product ID"
	range 0 0xFFFF
	default 0
	help
	  Product ID, assigned by the vendor.

config BLE_DIS_PNP_VER
	hex "PnP Product Version"
	range 0 0xFFFF
	default 1
	help
	  Product version, assigned by the vendor.

endif # BLE_DIS_PNP_ID

config BLE_DIS_REGULATORY_CERT
	bool "Include IEEE 11073-20601 Regulatory Certification characteristic"
	help
	  Include the IEEE 11073-20601 Regulatory Certification Data List characteristic in the
	  Device Information Service.

if BLE_DIS_REGULATORY_CERT

config BLE_DIS_REGULATORY_CERT_LIST
	hex "Regulatory Certification Data List"
	range 0 0xFFFFFFFFFFFFFFFF # 8 bytes, 1 byte per entry
	help
	  Opaque value encoded according to the IEEE 11073-20601 specification.
	  Provided as an 8-octet value, one byte per certification entry.

endif # BLE_DIS_REGULATORY_CERT

module=BLE_DIS
module-str=BLE Device Information Service
source "$(ZEPHYR_BASE)/subsys/logging/Kconfig.template.log_config"

endif # BLE_DIS
```

## subsys/bluetooth/services/ble_hids/Kconfig
```kconfig
#
# Copyright (c) 2025 Nordic Semiconductor ASA
#
# SPDX-License-Identifier: LicenseRef-Nordic-5-Clause
#
menuconfig BLE_HIDS
	bool "HID service"
	depends on SOFTDEVICE_PERIPHERAL
	depends on NRF_SDH_BLE

if BLE_HIDS

config BLE_HIDS_BOOT_MOUSE
	bool "Add boot mouse input characteristic"
	help
	  Add the boot mouse input characteristic.

config BLE_HIDS_BOOT_KEYBOARD
	bool "Add boot keyboard characteristics"
	help
	  Add the boot keyboard input and output characteristics.

choice
	prompt "Default HID protocol mode"
	depends on BLE_HIDS_BOOT_KEYBOARD || BLE_HIDS_BOOT_MOUSE

config BLE_HIDS_PROTOCOL_MODE_REPORT
	bool "Report"

config BLE_HIDS_PROTOCOL_MODE_BOOT
	bool "Boot"

endchoice

config BLE_HIDS_DEFAULT_PROTOCOL_MODE
	int
	default 0 if BLE_HIDS_PROTOCOL_MODE_BOOT
	default 1 if BLE_HIDS_PROTOCOL_MODE_REPORT

config BLE_HIDS_INPUT_REPORT_MAX_NUM
	int "Number of input reports"
	range 0 10
	default 10
	help
	  Number of input reports.

config BLE_HIDS_INPUT_REPORT_MAX_LEN
	int "Maximum input report length" if (BLE_HIDS_INPUT_REPORT_MAX_NUM != 0)
	default 0 if (BLE_HIDS_INPUT_REPORT_MAX_NUM = 0)
	default 8

config BLE_HIDS_OUTPUT_REPORT_MAX_NUM
	int "Number of output reports"
	range 0 10
	default 10
	help
	  Number of output reports

config BLE_HIDS_OUTPUT_REPORT_MAX_LEN
	int "Maximum output report length" if (BLE_HIDS_OUTPUT_REPORT_MAX_NUM != 0)
	default 0 if (BLE_HIDS_OUTPUT_REPORT_MAX_NUM = 0)
	default 1

config BLE_HIDS_FEATURE_REPORT_MAX_NUM
	int "Number of feature reports"
	range 0 10
	default 10
	help
	  Number of feature reports

config BLE_HIDS_FEATURE_REPORT_MAX_LEN
	int "Maximum feature report length" if (BLE_HIDS_FEATURE_REPORT_MAX_NUM != 0)
	default 0 if (BLE_HIDS_FEATURE_REPORT_MAX_NUM = 0)
	default 2

config BLE_HIDS_MAX_CLIENTS
	int "Maximum HID clients"
	range 1 NRF_SDH_BLE_PERIPHERAL_LINK_COUNT
	default 1

module=BLE_HIDS
module-str=BLE HID service
source "$(ZEPHYR_BASE)/subsys/logging/Kconfig.template.log_config"

endif
```
