## subsys/bluetooth/services/ble_hrs_central/Kconfig
```kconfig
#
# Copyright (c) 2025 Nordic Semiconductor
#
# SPDX-License-Identifier: LicenseRef-Nordic-5-Clause
#

menuconfig BLE_HRS_CENTRAL
	bool "BLE Heart rate service central [EXPERIMENTAL]"
	depends on SOFTDEVICE
	select EXPERIMENTAL
	help
	  Heart rate service central library.

if BLE_HRS_CENTRAL

config BLE_HRS_CENTRAL_RR_INTERVALS_MAX_COUNT
	int "Maximum number of RR intervals per HRM notification"
	default 20
	help
	  Maximum number of RR intervals to be decoded for each HRM notifications
	  (any extra RR intervals are ignored).

module=BLE_HRS_CENTRAL
module-str=BLE Heart rate client
source "$(ZEPHYR_BASE)/subsys/logging/Kconfig.template.log_config"

endif # BLE_HRS_CENTRAL
```

## subsys/bluetooth/services/ble_hrs_client/Kconfig
```kconfig
#
# Copyright (c) 2025 Nordic Semiconductor
#
# SPDX-License-Identifier: LicenseRef-Nordic-5-Clause
#

menuconfig BLE_HRS_CLIENT
	bool "BLE Heart rate service client [EXPERIMENTAL]"
	depends on SOFTDEVICE_CENTRAL
	depends on NRF_SDH_BLE
	depends on BLE_DB_DISCOVERY
	depends on BLE_GATT_QUEUE
	select EXPERIMENTAL
	help
	  Heart rate service client library.

if BLE_HRS_CLIENT

config BLE_HRS_CLIENT_RR_INTERVALS_MAX_COUNT
	int "Maximum number of RR intervals per HRM notification"
	default 20
	help
	  Maximum number of RR intervals to be decoded for each HRM notifications
	  (any extra RR intervals are ignored).

module=BLE_HRS_CLIENT
module-str=BLE Heart rate client
source "$(ZEPHYR_BASE)/subsys/logging/Kconfig.template.log_config"

endif # BLE_HRS_CLIENT
```

## subsys/bluetooth/services/ble_lbs/Kconfig
```kconfig
#
# Copyright (c) 2025 Nordic Semiconductor ASA
#
# SPDX-License-Identifier: LicenseRef-Nordic-5-Clause
#

menuconfig BLE_LBS
	bool "Nordic LED Button Service"

if BLE_LBS

module=BLE_LBS
module-dep=LOG
module-str=BLE LED Button Service
source "${ZEPHYR_BASE}/subsys/logging/Kconfig.template.log_config"

endif
```

## subsys/bluetooth/services/ble_mcumgr/Kconfig
```kconfig
#
# Copyright (c) 2025 Nordic Semiconductor ASA
#
# SPDX-License-Identifier: LicenseRef-Nordic-5-Clause
#

menuconfig BLE_MCUMGR
	bool "MCUmgr service"
	depends on SOFTDEVICE_PERIPHERAL
	depends on NRF_SDH_BLE
	depends on BLE_CONN_PARAMS
	depends on NCS_BM_MCUMGR

if BLE_MCUMGR

module=BLE_MCUMGR
module-str=BLE MCUmgr Service
source "$(ZEPHYR_BASE)/subsys/logging/Kconfig.template.log_config"

endif
```

## subsys/bluetooth/services/ble_mds/Kconfig
```kconfig
#
# Copyright (c) 2026 Nordic Semiconductor ASA
#
# SPDX-License-Identifier: LicenseRef-Nordic-5-Clause
#

menuconfig BLE_MDS
	bool "Memfault Diagnostic Service"
	depends on SOFTDEVICE_PERIPHERAL
	depends on NRF_SDH_BLE
	depends on BLE_CONN_PARAMS
	depends on MEMFAULT
	help
	  Expose the Memfault Diagnostic Service over Bluetooth LE so
	  gateway applications can read the upload URI/authorization and
	  stream Memfault chunks from the device.

if BLE_MDS

config BLE_MDS_DATA_URI_MAX_LEN
	int "Maximum MDS data URI length"
	default 192
	range 64 512

config BLE_MDS_EMPTY_POLL_INTERVAL_MS
	int "MDS empty data poll interval in milliseconds"
	default 1000
	range 100 60000

config BLE_MDS_TRIGGER_LOG_COLLECTION
	bool "Trigger Memfault log collection while MDS data export is active"
	default y
	help
	  Periodically snapshot the Memfault RAM log buffer into the packetizer
	  while a gateway is subscribed and has enabled data export. This mirrors
	  the upload behavior used by the Memfault Zephyr periodic uploader.

config BLE_MDS_LOG_COLLECTION_INTERVAL_MS
	int "MDS log collection interval in milliseconds"
	default 1000
	range 100 60000
	depends on BLE_MDS_TRIGGER_LOG_COLLECTION

module=BLE_MDS
module-str=BLE Memfault Diagnostic Service
source "$(ZEPHYR_BASE)/subsys/logging/Kconfig.template.log_config"

endif
```

## subsys/bluetooth/services/ble_nus/Kconfig
```kconfig
#
# Copyright (c) 2025 Nordic Semiconductor ASA
#
# SPDX-License-Identifier: LicenseRef-Nordic-5-Clause
#
menuconfig BLE_NUS
	bool "Nordic UART service"
	depends on SOFTDEVICE_PERIPHERAL
	depends on NRF_SDH_BLE
	depends on BLE_QWR

if BLE_NUS

module=BLE_NUS
module-str=BLE Nordic UART Service
source "$(ZEPHYR_BASE)/subsys/logging/Kconfig.template.log_config"

endif
```
