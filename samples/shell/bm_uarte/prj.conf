## CMakeLists.txt
```
#
# Copyright (c) 2025 Nordic Semiconductor ASA
#
# SPDX-License-Identifier: LicenseRef-Nordic-5-Clause
#

cmake_minimum_required(VERSION 3.20.0)

find_package(Zephyr REQUIRED HINTS $ENV{ZEPHYR_BASE})
project(shell_bm_uarte)

target_sources(app PRIVATE src/main.c)
```

## sample.yaml
```
sample:
  name: Shell sample
tests:
  sample.shell.bm_uarte:
    sysbuild: true
    build_only: true
    integration_platforms:
      - bm_nrf54l15dk/nrf54l05/cpuapp/s115_softdevice
      - bm_nrf54l15dk/nrf54l10/cpuapp/s115_softdevice
      - bm_nrf54l15dk/nrf54l15/cpuapp/s115_softdevice
    platform_allow:
      - bm_nrf54l15dk/nrf54l05/cpuapp/s115_softdevice
      - bm_nrf54l15dk/nrf54l10/cpuapp/s115_softdevice
      - bm_nrf54l15dk/nrf54l15/cpuapp/s115_softdevice
    tags: ci_build
```

## prj.conf
```kconfig
CONFIG_SHELL=y
CONFIG_SHELL_MINIMAL=y
CONFIG_SHELL_BACKEND_BM_UARTE=y
```

## src/main.c
```c
/*
 * Copyright (c) 2025 Nordic Semiconductor ASA
 *
 * SPDX-License-Identifier: LicenseRef-Nordic-5-Clause
 */

#include <zephyr/shell/shell.h>
#include <zephyr/sys/atomic.h>
#include <shell/backend_bm_uarte.h>

#include <zephyr/shell/shell.h>

static atomic_t running = ATOMIC_INIT(1);

static int sample_terminate_cmd(const struct shell *sh, size_t argc, char **argv)
{
	shell_print(sh, "goodbye");
	atomic_set(&running, 0);
	return 0;
}

SHELL_CMD_REGISTER(terminate, NULL, "terminate shell", sample_terminate_cmd);

int main(void)
{
	const struct shell_backend_config_flags cfg_flags = SHELL_DEFAULT_BACKEND_CONFIG_FLAGS;

	shell_init(shell_backend_bm_uarte_get_ptr(), NULL, cfg_flags, false, 0);
	shell_start(shell_backend_bm_uarte_get_ptr());
	printk("shell started\n");
	while (atomic_get(&running)) {
		shell_process(shell_backend_bm_uarte_get_ptr());
		k_busy_wait(10000);
	}
	shell_uninit(shell_backend_bm_uarte_get_ptr(), NULL);
	printk("shell terminated\n");
	return 0;
}
```
