## CMakeLists.txt
```
#
# Copyright (c) 2023 Nordic Semiconductor ASA
#
# SPDX-License-Identifier: LicenseRef-Nordic-5-Clause
#

cmake_minimum_required(VERSION 3.20.0)
find_package(Zephyr REQUIRED HINTS $ENV{ZEPHYR_BASE})
project(mcuboot_recovery_retention)

if(NOT (DEFINED SYSBUILD))
  message(FATAL_ERROR "This must be built with sysbuild.")
endif()

if(NOT CONFIG_MCUBOOT_BOOTLOADER_MODE_FIRMWARE_UPDATER)
  message(FATAL_ERROR "Invalid MCUboot mode selected.")
endif()

target_sources(app PRIVATE src/main.c)
```

## Kconfig
```
#
# Copyright (c) 2025 Nordic Semiconductor ASA
#
# SPDX-License-Identifier: LicenseRef-Nordic-5-Clause
#

menu "MCUboot recovery retention sample"

module=SAMPLE
module-str=MCUboot recovery retention
source "$(ZEPHYR_BASE)/subsys/logging/Kconfig.template.log_config"

endmenu # "MCUboot recovery retention sample"

source "Kconfig.zephyr"
```

## sample.yaml
```
sample:
  description: MCUboot buttonless entry, for firmware loader mode
  name: MCUboot buttonless entry
tests:
  sample.boot.mcuboot_recovery_retention.bluetooth:
    sysbuild: true
    build_only: true
    integration_platforms:
      - bm_nrf54l15dk/nrf54l10/cpuapp/s145_softdevice/mcuboot
      - bm_nrf54lm20dk/nrf54lm20a/cpuapp/s115_softdevice/mcuboot
    platform_allow:
      - bm_nrf54l15dk/nrf54l05/cpuapp/s115_softdevice/mcuboot
      - bm_nrf54l15dk/nrf54l05/cpuapp/s145_softdevice/mcuboot
      - bm_nrf54l15dk/nrf54l10/cpuapp/s115_softdevice/mcuboot
      - bm_nrf54l15dk/nrf54l10/cpuapp/s145_softdevice/mcuboot
      - bm_nrf54l15dk/nrf54l15/cpuapp/s115_softdevice/mcuboot
      - bm_nrf54l15dk/nrf54l15/cpuapp/s145_softdevice/mcuboot
      - bm_nrf54lc10dk/nrf54lc10a/cpuapp/s115_softdevice/mcuboot
      - bm_nrf54lc10dk/nrf54lc10a/cpuapp/s145_softdevice/mcuboot
      - bm_nrf54lv10dk/nrf54lv10a/cpuapp/s115_softdevice/mcuboot
      - bm_nrf54lv10dk/nrf54lv10a/cpuapp/s145_softdevice/mcuboot
      - bm_nrf54lm20dk/nrf54lm20a/cpuapp/s115_softdevice/mcuboot
      - bm_nrf54lm20dk/nrf54lm20a/cpuapp/s145_softdevice/mcuboot
    tags:
      - sysbuild
      - bluetooth
  sample.boot.mcuboot_recovery_retention.uart:
    sysbuild: true
    build_only: true
    integration_platforms:
      - bm_nrf54l15dk/nrf54l15/cpuapp/s115_softdevice/mcuboot
    platform_allow:
      - bm_nrf54l15dk/nrf54l05/cpuapp/s115_softdevice/mcuboot
      - bm_nrf54l15dk/nrf54l05/cpuapp/s145_softdevice/mcuboot
      - bm_nrf54l15dk/nrf54l10/cpuapp/s115_softdevice/mcuboot
      - bm_nrf54l15dk/nrf54l10/cpuapp/s145_softdevice/mcuboot
      - bm_nrf54l15dk/nrf54l15/cpuapp/s115_softdevice/mcuboot
      - bm_nrf54l15dk/nrf54l15/cpuapp/s145_softdevice/mcuboot
      - bm_nrf54lc10dk/nrf54lc10a/cpuapp/s115_softdevice/mcuboot
      - bm_nrf54lc10dk/nrf54lc10a/cpuapp/s145_softdevice/mcuboot
      - bm_nrf54lv10dk/nrf54lv10a/cpuapp/s115_softdevice/mcuboot
      - bm_nrf54lv10dk/nrf54lv10a/cpuapp/s145_softdevice/mcuboot
      - bm_nrf54lm20dk/nrf54lm20a/cpuapp/s115_softdevice/mcuboot
      - bm_nrf54lm20dk/nrf54lm20a/cpuapp/s145_softdevice/mcuboot
    extra_args:
      - SB_CONFIG_BM_FIRMWARE_LOADER_UART_MCUMGR=y
    tags:
      - sysbuild
      - uart
  sample.boot.mcuboot_recovery_retention.bluetooth.nrf54ls05_oberon:
    sysbuild: true
    build_only: true
    integration_platforms:
      - bm_nrf54ls05dk/nrf54ls05a/cpuapp/s145_softdevice/mcuboot
    platform_allow:
      - bm_nrf54ls05dk/nrf54ls05a/cpuapp/s115_softdevice/mcuboot
      - bm_nrf54ls05dk/nrf54ls05a/cpuapp/s145_softdevice/mcuboot
      - bm_nrf54ls05dk/nrf54ls05b/cpuapp/s115_softdevice/mcuboot
      - bm_nrf54ls05dk/nrf54ls05b/cpuapp/s145_softdevice/mcuboot
    extra_args:
      - mcuboot_CONFIG_NRF_OBERON=y
    tags:
      - sysbuild
      - bluetooth
  sample.boot.mcuboot_recovery_retention.uart.nrf54ls05_oberon:
    sysbuild: true
    build_only: true
    integration_platforms:
      - bm_nrf54ls05dk/nrf54ls05a/cpuapp/s145_softdevice/mcuboot
    platform_allow:
      - bm_nrf54ls05dk/nrf54ls05a/cpuapp/s115_softdevice/mcuboot
      - bm_nrf54ls05dk/nrf54ls05a/cpuapp/s145_softdevice/mcuboot
      - bm_nrf54ls05dk/nrf54ls05b/cpuapp/s115_softdevice/mcuboot
      - bm_nrf54ls05dk/nrf54ls05b/cpuapp/s145_softdevice/mcuboot
    extra_args:
      - SB_CONFIG_BM_FIRMWARE_LOADER_UART_MCUMGR=y
      - mcuboot_CONFIG_NRF_OBERON=y
    tags:
      - sysbuild
      - uart
  sample.boot.mcuboot_recovery_retention.uart.builtin.key:
    sysbuild: true
    build_only: true
    integration_platforms:
      - bm_nrf54l15dk/nrf54l05/cpuapp/s115_softdevice/mcuboot
    platform_allow:
      - bm_nrf54l15dk/nrf54l05/cpuapp/s115_softdevice/mcuboot
      - bm_nrf54l15dk/nrf54l05/cpuapp/s145_softdevice/mcuboot
      - bm_nrf54l15dk/nrf54l10/cpuapp/s115_softdevice/mcuboot
      - bm_nrf54l15dk/nrf54l10/cpuapp/s145_softdevice/mcuboot
      - bm_nrf54l15dk/nrf54l15/cpuapp/s115_softdevice/mcuboot
      - bm_nrf54l15dk/nrf54l15/cpuapp/s145_softdevice/mcuboot
    extra_args:
      - SB_CONFIG_BM_FIRMWARE_LOADER_UART_MCUMGR=y
      - SB_CONFIG_BM_BOOTLOADER_MCUBOOT_SIGNATURE_USING_KMU=n
    tags:
      - sysbuild
      - uart
      - kmu
```

## sysbuild.conf
```
SB_CONFIG_BM_BOOTLOADER_MCUBOOT=y
SB_CONFIG_BM_FIRMWARE_LOADER_BT_MCUMGR=y
SB_CONFIG_SOFTDEVICE_S115=y
SB_CONFIG_BM_BOOTLOADER_MCUBOOT_SIGNATURE_TYPE_ED25519=y
SB_CONFIG_MCUBOOT_GENERATE_DEFAULT_KMU_KEYFILE=y
```

## prj.conf
```kconfig
# Logging
CONFIG_LOG=y
CONFIG_LOG_MODE_MINIMAL=y

# Enabling SoftDevice is not strictly needed, though we are building with SoftDevice boards.
CONFIG_SOFTDEVICE=y

# Memory retention
CONFIG_RETAINED_MEM=y
CONFIG_RETENTION=y
CONFIG_RETENTION_BOOT_MODE=y

# Reboot
CONFIG_REBOOT=y
```

## src/main.c
```c
/*
 * Copyright (c) 2023 Nordic Semiconductor ASA
 *
 * SPDX-License-Identifier: LicenseRef-Nordic-5-Clause
 */

#include <stdint.h>
#include <zephyr/kernel.h>
#include <zephyr/sys/reboot.h>
#include <zephyr/retention/bootmode.h>
#include <zephyr/logging/log.h>

LOG_MODULE_REGISTER(sample, CONFIG_SAMPLE_LOG_LEVEL);

int main(void)
{
	int rc;

	LOG_INF("Waiting...");
	k_sleep(K_SECONDS(3));

	rc = bootmode_set(BOOT_MODE_TYPE_BOOTLOADER);

	if (rc == 0) {
		sys_reboot(SYS_REBOOT_WARM);
	} else {
		LOG_INF("Failed to set boot mode, err %d", rc);
	}

	return 0;
}
```
