## CMakeLists.txt
```
#
# Copyright (c) 2026 Nordic Semiconductor ASA
#
# SPDX-License-Identifier: LicenseRef-Nordic-5-Clause
#
cmake_minimum_required(VERSION 3.20.0)

find_package(Zephyr REQUIRED HINTS $ENV{ZEPHYR_BASE})
project(ble_mds)

target_sources(app PRIVATE src/main.c)

zephyr_include_directories(memfault_config)
```

## Kconfig
```
#
# Copyright (c) 2026 Nordic Semiconductor ASA
#
# SPDX-License-Identifier: LicenseRef-Nordic-5-Clause
#

menu "Bluetooth LE MDS sample"

config SAMPLE_BLE_DEVICE_NAME
	string "Device name"
	default "nRF BM Memfault"

config SAMPLE_BLE_MDS_BATTERY_LEVEL_MEAS_INTERVAL
	int "Battery level measurement interval (ms)"
	default 1000
	help
	  Battery level measurement interval in milliseconds.

module=SAMPLE_BLE_MDS
module-str=BLE Memfault Diagnostic Service Sample
source "$(ZEPHYR_BASE)/subsys/logging/Kconfig.template.log_config"

endmenu # "Bluetooth LE MDS sample"

configdefault MEMFAULT_NCS_FW_VERSION
	default "$(APPVERSION)"

configdefault BLE_DIS_FW_REVISION
	default MEMFAULT_NCS_FW_VERSION

configdefault MEMFAULT_NCS_FW_TYPE
	default "app"

configdefault BLE_DIS_SW_REVISION
	default MEMFAULT_NCS_FW_TYPE

configdefault MEMFAULT_NCS_HW_VERSION
	default "hw 54.15.0"

configdefault BLE_DIS_HW_REVISION
	default MEMFAULT_NCS_HW_VERSION

# Handle increased buffersize when MEMFAULT Logging is enabled

configdefault MEMFAULT_LOGGING_RAM_SIZE
	default 1024 if MEMFAULT_LOGGING_ENABLE

source "Kconfig.zephyr"
```

## sample.yaml
```
sample:
  name: Bluetooth LE Memfault Diagnostic Service Sample
tests:
  sample.ble_mds:
    sysbuild: true
    build_only: true
    extra_configs:
      - CONFIG_MEMFAULT_NCS_PROJECT_KEY="dummy-key"
    integration_platforms:
      - bm_nrf54l15dk/nrf54l05/cpuapp/s145_softdevice
      - bm_nrf54lm20dk/nrf54lm20a/cpuapp/s115_softdevice
    platform_allow:
      - bm_nrf54l15dk/nrf54l05/cpuapp/s115_softdevice
      - bm_nrf54l15dk/nrf54l05/cpuapp/s115_softdevice/mcuboot
      - bm_nrf54l15dk/nrf54l05/cpuapp/s145_softdevice
      - bm_nrf54l15dk/nrf54l05/cpuapp/s145_softdevice/mcuboot
      - bm_nrf54l15dk/nrf54l10/cpuapp/s115_softdevice
      - bm_nrf54l15dk/nrf54l10/cpuapp/s115_softdevice/mcuboot
      - bm_nrf54l15dk/nrf54l10/cpuapp/s145_softdevice
      - bm_nrf54l15dk/nrf54l10/cpuapp/s145_softdevice/mcuboot
      - bm_nrf54l15dk/nrf54l15/cpuapp/s115_softdevice
      - bm_nrf54l15dk/nrf54l15/cpuapp/s115_softdevice/mcuboot
      - bm_nrf54l15dk/nrf54l15/cpuapp/s145_softdevice
      - bm_nrf54l15dk/nrf54l15/cpuapp/s145_softdevice/mcuboot
      - bm_nrf54lc10dk/nrf54lc10a/cpuapp/s115_softdevice
      - bm_nrf54lc10dk/nrf54lc10a/cpuapp/s115_softdevice/mcuboot
      - bm_nrf54lc10dk/nrf54lc10a/cpuapp/s145_softdevice
      - bm_nrf54lc10dk/nrf54lc10a/cpuapp/s145_softdevice/mcuboot
      - bm_nrf54lm20dk/nrf54lm20a/cpuapp/s115_softdevice
      - bm_nrf54lm20dk/nrf54lm20a/cpuapp/s115_softdevice/mcuboot
      - bm_nrf54lm20dk/nrf54lm20a/cpuapp/s145_softdevice
      - bm_nrf54lm20dk/nrf54lm20a/cpuapp/s145_softdevice/mcuboot
      - bm_nrf54ls05dk/nrf54ls05b/cpuapp/s115_softdevice
      - bm_nrf54ls05dk/nrf54ls05b/cpuapp/s115_softdevice/mcuboot
      - bm_nrf54ls05dk/nrf54ls05b/cpuapp/s145_softdevice
      - bm_nrf54ls05dk/nrf54ls05b/cpuapp/s145_softdevice/mcuboot
      - bm_nrf54lv10dk/nrf54lv10a/cpuapp/s115_softdevice
      - bm_nrf54lv10dk/nrf54lv10a/cpuapp/s115_softdevice/mcuboot
      - bm_nrf54lv10dk/nrf54lv10a/cpuapp/s145_softdevice
      - bm_nrf54lv10dk/nrf54lv10a/cpuapp/s145_softdevice/mcuboot
    tags: ci_build
```

## prj.conf
```kconfig
# Logging
CONFIG_LOG=y
CONFIG_LOG_BACKEND_BM_UARTE=y

# SoftDevice
CONFIG_SOFTDEVICE=y
CONFIG_NRF_SDH_BLE_VS_UUID_COUNT=1
CONFIG_NRF_SDH_BLE_GATT_MAX_MTU_SIZE=247

# Enable RNG
CONFIG_PSA_CRYPTO=y
CONFIG_PSA_WANT_GENERATE_RANDOM=y

# Enable Crypto functionality required by LE Secure Connection
CONFIG_PSA_WANT_ALG_ECDH=y
CONFIG_PSA_WANT_KEY_TYPE_ECC_KEY_PAIR_GENERATE=y
CONFIG_PSA_WANT_KEY_TYPE_ECC_KEY_PAIR_IMPORT=y
CONFIG_PSA_WANT_KEY_TYPE_ECC_KEY_PAIR_EXPORT=y
CONFIG_PSA_WANT_ECC_SECP_R1_256=y
CONFIG_MBEDTLS_PSA_STATIC_KEY_SLOTS=y
CONFIG_MBEDTLS_PSA_KEY_SLOT_COUNT=1

# Advertising library
CONFIG_BLE_ADV=y

# BLE connection parameters
CONFIG_BLE_CONN_PARAMS=y
CONFIG_BLE_CONN_PARAMS_DATA_LENGTH_TX=251
CONFIG_BLE_CONN_PARAMS_DATA_LENGTH_RX=251
CONFIG_BLE_CONN_PARAMS_INITIATE_ATT_MTU_EXCHANGE=y
CONFIG_BLE_CONN_PARAMS_INITIATE_DATA_LENGTH_UPDATE=y

# Device information service (FW/HW/SW revisions come from VERSION + Kconfig)
CONFIG_BLE_DIS=y
CONFIG_BLE_DIS_SERIAL_NUMBER="ABCD"

# Battery service
CONFIG_BLE_BAS=y

# Memfault Diagnostic Service
CONFIG_BLE_MDS=y

# Buttons and timers
CONFIG_BM_TIMER=y
CONFIG_BM_BUTTONS=y
CONFIG_BM_GPIOTE=y

# Peer Manager
CONFIG_PEER_MANAGER=y
CONFIG_PM_LESC=y
CONFIG_BM_ZMS=y

# Memfault
CONFIG_MEMFAULT=y

CONFIG_MEMFAULT_NCS_STACK_METRICS=n
CONFIG_MEMFAULT_METRICS_DEFAULT_SET_ENABLE=n
CONFIG_MEMFAULT_METRICS_THREADS=n
CONFIG_MEMFAULT_METRICS_TIMER_CUSTOM=y
CONFIG_MEMFAULT_REBOOT_REASON_GET_BASIC=y
CONFIG_MEMFAULT_SOFTWARE_WATCHDOG_CUSTOM=y
CONFIG_MEMFAULT_COREDUMP_COLLECT_KERNEL_REGION=n
CONFIG_MEMFAULT_COREDUMP_COLLECT_TASKS_REGIONS=n
CONFIG_MEMFAULT_EVENT_STORAGE_SIZE=2048

CONFIG_MEMFAULT_NCS_PROJECT_KEY=""
CONFIG_MEMFAULT_NCS_FW_VERSION_STATIC=y
CONFIG_MEMFAULT_NCS_DEVICE_ID_HW_ID=y
CONFIG_HW_ID_LIBRARY_SOURCE_DEVICE_ID=y
```

## src/main.c
```c
/*
 * Copyright (c) 2026 Nordic Semiconductor ASA
 *
 * SPDX-License-Identifier: LicenseRef-Nordic-5-Clause
 */

#include <stdint.h>
#include <stdbool.h>
#include <string.h>

#include <ble_gap.h>
#include <ble_hci.h>
#include <ble_types.h>
#include <hal/nrf_gpio.h>
#include <nrf_error.h>
#include <nrf_soc.h>

#include <bm/bm_buttons.h>
#include <bm/bm_timer.h>
#include <bm/bluetooth/ble_adv.h>
#include <bm/bluetooth/ble_conn_params.h>
#include <bm/bluetooth/peer_manager/nrf_ble_lesc.h>
#include <bm/bluetooth/peer_manager/peer_manager.h>
#include <bm/bluetooth/peer_manager/peer_manager_handler.h>
#include <bm/bluetooth/services/ble_bas.h>
#include <bm/bluetooth/services/ble_dis.h>
#include <bm/bluetooth/services/ble_mds.h>
#include <bm/bluetooth/services/uuid.h>
#include <bm/softdevice_handler/nrf_sdh.h>
#include <bm/softdevice_handler/nrf_sdh_ble.h>

#include <memfault/core/trace_event.h>
#include <memfault/metrics/metrics.h>
#include <memfault/metrics/platform/timer.h>

#include <zephyr/kernel.h>
#include <zephyr/logging/log.h>
#include <zephyr/logging/log_ctrl.h>
#include <zephyr/sys/util.h>

#include <board-config.h>

LOG_MODULE_REGISTER(sample, CONFIG_SAMPLE_BLE_MDS_LOG_LEVEL);

#define RUN_STATUS_LED BOARD_PIN_LED_0
#define CONN_STATUS_LED BOARD_PIN_LED_1
#define BATTERY_LEVEL_MAX 100U

BLE_ADV_DEF(ble_adv); /* BLE advertising instance */
BLE_BAS_DEF(ble_bas); /* BLE battery service instance */
BLE_MDS_DEF(ble_mds); /* BLE Memfault Diagnostic Service instance */

static uint16_t conn_handle = BLE_CONN_HANDLE_INVALID;
static uint8_t battery_level = BATTERY_LEVEL_MAX;

static struct bm_timer battery_timer;

static volatile bool memfault_heartbeat_pending;

#if IS_ENABLED(CONFIG_MEMFAULT_METRICS_TIMER_CUSTOM)
/* CONFIG_MEMFAULT_METRICS_TIMER_CUSTOM delegates heartbeat scheduling to the platform.
 * On boot, Memfault itself calls memfault_platform_metrics_timer_boot() below,
 * a function we get to define, and hands us a callback and an interval.
 * This whole block is us building that schedule ourselves: we save the callback,
 * start our own repeating timer via bm_timer for the given interval,
 * and then poll every loop in main() via memfault_metrics_timer_process(),
 * to check if that timer has fired yet, and if it has, run the callback.
 */
static struct bm_timer memfault_metrics_timer;
static MemfaultPlatformTimerCallback *memfault_metrics_timer_cb;
static volatile bool memfault_metrics_timer_due;

static void memfault_metrics_timer_timeout_handler(void *context)
{
	ARG_UNUSED(context);

	memfault_metrics_timer_due = true;
}

bool memfault_platform_metrics_timer_boot(uint32_t period_sec,
					  MemfaultPlatformTimerCallback callback)
{
	int err;
	uint32_t period_ms;

	if ((period_sec == 0U) || (callback == NULL)) {
		return false;
	}

	memfault_metrics_timer_cb = callback;

	err = bm_timer_init(&memfault_metrics_timer, BM_TIMER_MODE_REPEATED,
			    memfault_metrics_timer_timeout_handler);
	if (err) {
		return false;
	}

	period_ms = period_sec * 1000U;
	err = bm_timer_start(&memfault_metrics_timer, BM_TIMER_MS_TO_TICKS(period_ms), NULL);
	if (err) {
		return false;
	}

	return true;
}

/* Polls the memfault_metrics_timer_due flag, set by the bm_timer expiry handler,
 * and runs the callback once it fires.
 */
static void memfault_metrics_timer_process(void)
{
	if (!memfault_metrics_timer_due || (memfault_metrics_timer_cb == NULL)) {
		return;
	}
	memfault_metrics_timer_due = false;

	/*
	 * The "memfault_metrics_timer_cb" serializes every metric set via
	 * MEMFAULT_METRIC_SET_UNSIGNED, MEMFAULT_METRIC_ADD, etc. into a
	 * heartbeat event, and queues it for the memfault packetizer.
	 */
	memfault_metrics_timer_cb();
}
#endif /* IS_ENABLED(CONFIG_MEMFAULT_METRICS_TIMER_CUSTOM) */

static void leds_init(void)
{
	nrf_gpio_cfg_output(RUN_STATUS_LED);
	nrf_gpio_cfg_output(CONN_STATUS_LED);
	nrf_gpio_pin_write(RUN_STATUS_LED, !BOARD_LED_ACTIVE_STATE);
	nrf_gpio_pin_write(CONN_STATUS_LED, !BOARD_LED_ACTIVE_STATE);
}

static void battery_level_timeout_handler(void *context)
{
	uint32_t nrf_err;
	int err;

	ARG_UNUSED(context);

	if (battery_level == 0U) {
		battery_level = BATTERY_LEVEL_MAX;
	} else {
		battery_level--;
	}

	err = MEMFAULT_METRIC_SET_UNSIGNED(battery_soc_pct, battery_level);
	if (err) {
		LOG_ERR("Failed to set battery_soc_pct metric, err %d", err);
	}

	nrf_err = ble_bas_battery_level_update(&ble_bas, conn_handle, battery_level);
	if ((nrf_err != NRF_SUCCESS) &&
	    (nrf_err != BLE_ERROR_INVALID_CONN_HANDLE) &&
	    (nrf_err != NRF_ERROR_INVALID_STATE) &&
	    (nrf_err != BLE_ERROR_GATTS_SYS_ATTR_MISSING)) {
		LOG_ERR("Failed to update battery level, nrf_error %#x", nrf_err);
	}
}

static void on_ble_evt(const ble_evt_t *evt, void *ctx)
{
	ARG_UNUSED(ctx);

	switch (evt->header.evt_id) {
	case BLE_GAP_EVT_CONNECTED:
		LOG_INF("Peer connected");
		conn_handle = evt->evt.gap_evt.conn_handle;
		nrf_gpio_pin_write(CONN_STATUS_LED, BOARD_LED_ACTIVE_STATE);
		break;

	case BLE_GAP_EVT_DISCONNECTED:
		LOG_INF("Peer disconnected, reason %#x",
			evt->evt.gap_evt.params.disconnected.reason);
		if (conn_handle == evt->evt.gap_evt.conn_handle) {
			conn_handle = BLE_CONN_HANDLE_INVALID;
		}
		nrf_gpio_pin_write(CONN_STATUS_LED, !BOARD_LED_ACTIVE_STATE);
		break;

	case BLE_GAP_EVT_AUTH_STATUS:
		LOG_INF("Authentication status: %#x",
			evt->evt.gap_evt.params.auth_status.auth_status);
		break;

	case BLE_GAP_EVT_PASSKEY_DISPLAY:
		LOG_INF("Passkey: %.*s", BLE_GAP_PASSKEY_LEN,
			evt->evt.gap_evt.params.passkey_display.passkey);
		break;

	default:
		break;
	}
}
NRF_SDH_BLE_OBSERVER(sdh_ble, on_ble_evt, NULL, USER_LOW);

static void on_conn_params_evt(const struct ble_conn_params_evt *evt)
{
	uint32_t nrf_err;

	switch (evt->evt_type) {
	case BLE_CONN_PARAMS_EVT_REJECTED:
		nrf_err = sd_ble_gap_disconnect(evt->conn_handle,
						BLE_HCI_CONN_INTERVAL_UNACCEPTABLE);
		if (nrf_err) {
			LOG_ERR("Failed to disconnect, nrf_error %#x", nrf_err);
		}
		break;

	case BLE_CONN_PARAMS_EVT_ATT_MTU_UPDATED:
		LOG_INF("ATT MTU updated: %u", evt->att_mtu);
		break;

	case BLE_CONN_PARAMS_EVT_DATA_LENGTH_UPDATED:
		LOG_INF("Data length updated: tx %u rx %u",
			evt->data_length.tx,
			evt->data_length.rx);
		break;

	case BLE_CONN_PARAMS_EVT_ERROR:
		LOG_ERR("Connection parameter error, nrf_error %#x", evt->error.reason);
		break;

	default:
		break;
	}
}

static void delete_bonds(void)
{
	uint32_t nrf_err;

	LOG_INF("Erase bonds!");

	nrf_err = pm_peers_delete();
	if (nrf_err) {
		LOG_ERR("Failed to delete peers, nrf_error %#x", nrf_err);
	}
}

static void advertising_start(bool erase_bonds)
{
	uint32_t nrf_err;

	if (erase_bonds) {
		delete_bonds();
	} else {
		nrf_err = ble_adv_start(&ble_adv, BLE_ADV_MODE_FAST);
		if (nrf_err) {
			LOG_ERR("Failed to start advertising, nrf_error %#x", nrf_err);
		} else {
			LOG_INF("Advertising as %s", CONFIG_SAMPLE_BLE_DEVICE_NAME);
		}
	}
}

static void pm_evt_handler(const struct pm_evt *evt)
{
	pm_handler_on_pm_evt(evt);
	pm_handler_disconnect_on_sec_failure(evt);
	pm_handler_flash_clean(evt);

	switch (evt->evt_id) {
	case PM_EVT_PEERS_DELETE_SUCCEEDED:
		advertising_start(false);
		break;
	default:
		break;
	}
}

static uint32_t peer_manager_init(void)
{
	ble_gap_sec_params_t sec_param;
	uint32_t nrf_err;

	nrf_err = pm_init();
	if (nrf_err) {
		return nrf_err;
	}

	memset(&sec_param, 0, sizeof(ble_gap_sec_params_t));

	/* Security parameters to be used for all security procedures. */
	sec_param = (ble_gap_sec_params_t) {
		.bond = 1,
		.mitm = 0,
		.lesc = 1,
		.keypress = 0,
		.io_caps = BLE_GAP_IO_CAPS_DISPLAY_ONLY,
		.oob = 0,
		.min_key_size = 16,
		.max_key_size = 16,
		.kdist_own.enc = 1,
		.kdist_own.id = 1,
		.kdist_peer.enc = 1,
		.kdist_peer.id = 1,
	};

	nrf_err = pm_sec_params_set(&sec_param);
	if (nrf_err) {
		LOG_ERR("pm_sec_params_set() failed, nrf_error %#x", nrf_err);
		return nrf_err;
	}

	nrf_err = pm_register(pm_evt_handler);
	if (nrf_err) {
		LOG_ERR("pm_register() failed, nrf_error %#x", nrf_err);
		return nrf_err;
	}

	return NRF_SUCCESS;
}

static void ble_adv_evt_handler(struct ble_adv *adv, const struct ble_adv_evt *evt)
{
	ARG_UNUSED(adv);

	switch (evt->evt_type) {
	case BLE_ADV_EVT_ERROR:
		LOG_ERR("Advertising error, nrf_error %#x", evt->error.reason);
		break;
	case BLE_ADV_EVT_IDLE:
		LOG_INF("Advertising stopped");
		break;
	default:
		break;
	}
}

static void button_handler(uint8_t pin, enum bm_buttons_evt_type action)
{
	static bool time_measure_start;
	int err;

	switch (pin) {
	case BOARD_PIN_BTN_0:
		if (action != BM_BUTTONS_PRESS) {
			break;
		}

		time_measure_start = !time_measure_start;
		if (time_measure_start) {
			err = MEMFAULT_METRIC_TIMER_START(button_elapsed_time_ms);
			if (err) {
				LOG_ERR("Failed to start button timer metric, err %d", err);
			} else {
				LOG_INF("Button0 - button_elapsed_time_ms metric timer started");
			}
		} else {
			err = MEMFAULT_METRIC_TIMER_STOP(button_elapsed_time_ms);
			if (err) {
				LOG_ERR("Failed to stop button timer metric, err %d", err);
			} else {
				LOG_INF("Button0 - button_elapsed_time_ms metric timer stopped");
			}

			memfault_heartbeat_pending = true;
			LOG_INF("Memfault heartbeat scheduled");
		}
		break;

	case BOARD_PIN_BTN_1:
		MEMFAULT_TRACE_EVENT_WITH_LOG(button_state_changed, "Button1 state: %u",
					      (uint32_t)(action == BM_BUTTONS_PRESS));
		LOG_INF("Button1 - button_state_changed event tracked, button 1 state: %u",
			(uint32_t)(action == BM_BUTTONS_PRESS));
		break;

	case BOARD_PIN_BTN_2:
		if (action != BM_BUTTONS_PRESS) {
			break;
		}

		err = MEMFAULT_METRIC_ADD(button_press_count, 1);
		if (err) {
			LOG_ERR("Failed to increase button_press_count metric, err %d", err);
		} else {
			LOG_INF("Button2 - button_press_count metric increased");
		}
		break;

	case BOARD_PIN_BTN_3: {
		if (action != BM_BUTTONS_PRESS) {
			break;
		}

		volatile uint32_t div;

		LOG_INF("Division by zero will now be triggered");
#pragma GCC diagnostic push
#pragma GCC diagnostic ignored "-Wdiv-by-zero"
		div = 1 / 0;
#pragma GCC diagnostic pop
		ARG_UNUSED(div);
		break;
	}

	default:
		break;
	}
}

int main(void)
{
	int err;
	uint32_t nrf_err;
	bool erase_bonds = false;
	ble_gap_conn_sec_mode_t device_name_write_sec;
	struct bm_buttons_config button_configs[] = {
		{
			.pin_number = BOARD_PIN_BTN_0,
			.active_state = BM_BUTTONS_ACTIVE_LOW,
			.pull_config = BM_BUTTONS_PIN_PULLUP,
			.handler = button_handler,
		},
		{
			.pin_number = BOARD_PIN_BTN_1,
			.active_state = BM_BUTTONS_ACTIVE_LOW,
			.pull_config = BM_BUTTONS_PIN_PULLUP,
			.handler = button_handler,
		},
		{
			.pin_number = BOARD_PIN_BTN_2,
			.active_state = BM_BUTTONS_ACTIVE_LOW,
			.pull_config = BM_BUTTONS_PIN_PULLUP,
			.handler = button_handler,
		},
		{
			.pin_number = BOARD_PIN_BTN_3,
			.active_state = BM_BUTTONS_ACTIVE_LOW,
			.pull_config = BM_BUTTONS_PIN_PULLUP,
			.handler = button_handler,
		},
	};
	struct ble_bas_config bas_cfg = {
		.can_notify = true,
		.battery_level = battery_level,
		.sec_mode = BLE_BAS_CONFIG_SEC_MODE_DEFAULT,
	};
	struct ble_dis_config dis_cfg = {
		.sec_mode = BLE_DIS_CONFIG_SEC_MODE_DEFAULT,
	};
	struct ble_mds_config mds_cfg = {
		.sec_mode = BLE_MDS_CONFIG_SEC_MODE_DEFAULT,
	};

	/* Advertise MDS and Battery so scanning apps spot Memfault support, before connecting. */
	ble_uuid_t adv_uuid_list[] = {
		{
			.uuid = BLE_UUID_MDS_SERVICE,
			/* Type will be set after MDS is initialized. */
		},
		{
			.uuid = BLE_UUID_BATTERY_SERVICE,
			.type = BLE_UUID_TYPE_BLE,
		},
	};
	struct ble_adv_config adv_cfg = {
		.conn_cfg_tag = CONFIG_NRF_SDH_BLE_CONN_TAG,
		.evt_handler = ble_adv_evt_handler,
		.adv_data = {
			.name_type = BLE_ADV_DATA_FULL_NAME,
			.flags = BLE_GAP_ADV_FLAGS_LE_ONLY_GENERAL_DISC_MODE,
		},
		.sr_data.uuid_lists.complete = {
			.len = ARRAY_SIZE(adv_uuid_list),
			.uuid = &adv_uuid_list[0],
		},
	};

	LOG_INF("BLE MDS sample started");

	leds_init();

	err = bm_timer_init(&battery_timer, BM_TIMER_MODE_REPEATED,
			    battery_level_timeout_handler);
	if (err) {
		LOG_ERR("Failed to initialize battery timer, err %d", err);
		goto idle;
	}

	err = bm_buttons_init(button_configs, ARRAY_SIZE(button_configs),
			      BM_BUTTONS_DETECTION_DELAY_MIN_US);
	if (err) {
		LOG_ERR("Failed to initialize buttons, err %d", err);
		goto idle;
	}

	err = bm_buttons_enable();
	if (err) {
		LOG_ERR("Failed to enable buttons, err %d", err);
		goto idle;
	}

	erase_bonds = bm_buttons_is_pressed(BOARD_PIN_BTN_1);

	err = nrf_sdh_enable_request();
	if (err) {
		LOG_ERR("Failed to enable SoftDevice, err %d", err);
		goto idle;
	}

	LOG_INF("SoftDevice enabled");

	err = nrf_sdh_ble_enable(CONFIG_NRF_SDH_BLE_CONN_TAG);
	if (err) {
		LOG_ERR("Failed to enable BLE, err %d", err);
		goto idle;
	}

	LOG_INF("Bluetooth enabled");

	BLE_GAP_CONN_SEC_MODE_SET_NO_ACCESS(&device_name_write_sec);
	nrf_err = sd_ble_gap_device_name_set(&device_name_write_sec, CONFIG_SAMPLE_BLE_DEVICE_NAME,
					     strlen(CONFIG_SAMPLE_BLE_DEVICE_NAME));
	if (nrf_err) {
		LOG_ERR("Failed to set device name, nrf_error %#x", nrf_err);
		goto idle;
	}

	nrf_err = peer_manager_init();
	if (nrf_err) {
		LOG_ERR("Failed to initialize Peer Manager, nrf_error %#x", nrf_err);
		goto idle;
	}

	LOG_INF("Peer Manager initialized");

	nrf_err = ble_conn_params_evt_handler_set(on_conn_params_evt);
	if (nrf_err) {
		LOG_ERR("Failed to setup conn param event handler, nrf_error %#x", nrf_err);
		goto idle;
	}

	nrf_err = ble_bas_init(&ble_bas, &bas_cfg);
	if (nrf_err) {
		LOG_ERR("Failed to initialize battery service, nrf_error %#x", nrf_err);
		goto idle;
	}

	nrf_err = ble_dis_init(&dis_cfg);
	if (nrf_err) {
		LOG_ERR("Failed to initialize device information service, nrf_error %#x", nrf_err);
		goto idle;
	}

	nrf_err = ble_mds_init(&ble_mds, &mds_cfg);
	if (nrf_err) {
		LOG_ERR("Failed to initialize Memfault Diagnostic Service, nrf_error %#x", nrf_err);
		goto idle;
	}

	/* Set the type for MDS in adv_uuid_list now that MDS is initialized. */
	adv_uuid_list[0].type = ble_mds_service_uuid_type(&ble_mds);

	nrf_err = ble_adv_init(&ble_adv, &adv_cfg);
	if (nrf_err) {
		LOG_ERR("Failed to initialize advertising, nrf_error %#x", nrf_err);
		goto idle;
	}

	LOG_INF("BLE MDS sample initialized");

	err = bm_timer_start(&battery_timer,
			     BM_TIMER_MS_TO_TICKS(
				     CONFIG_SAMPLE_BLE_MDS_BATTERY_LEVEL_MEAS_INTERVAL),
			     NULL);
	if (err) {
		LOG_ERR("Failed to start battery timer, err %d", err);
		goto idle;
	}

	nrf_gpio_pin_write(RUN_STATUS_LED, BOARD_LED_ACTIVE_STATE);

	advertising_start(erase_bonds);

idle:
	while (true) {
		(void)nrf_ble_lesc_request_handler();
#if IS_ENABLED(CONFIG_MEMFAULT_METRICS_TIMER_CUSTOM)
		/* With CONFIG_MEMFAULT_METRICS_TIMER_CUSTOM, Memfault's own internal
		 * `timer_boot` implementation is disabled so we need to drive the heartbeat.
		 */
		memfault_metrics_timer_process();
#endif
		/* Flushes the ISR-pended trace event and serializes it here in the main loop,
		 * since bm_buttons invoke handlers in ISR context, where serialization is not safe.
		 */
		memfault_trace_event_try_flush_isr_event();
		if (memfault_heartbeat_pending) {
			memfault_heartbeat_pending = false;
			memfault_metrics_heartbeat_debug_trigger();
		}
		/* Process Memfault data and send the next chunk over BLE when ready. */
		ble_mds_process(&ble_mds);

		log_flush();

		k_cpu_idle();
	}

	return 0;
}
```
