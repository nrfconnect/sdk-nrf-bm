## CMakeLists.txt
```
#
# Copyright (c) 2025 Nordic Semiconductor ASA
#
# SPDX-License-Identifier: LicenseRef-Nordic-5-Clause
#

cmake_minimum_required(VERSION 3.20.0)

find_package(Zephyr REQUIRED HINTS $ENV{ZEPHYR_BASE})
project(timer_sample)

target_sources(app PRIVATE src/main.c)
```

## Kconfig
```
#
# Copyright (c) 2025 Nordic Semiconductor ASA
#
# SPDX-License-Identifier: LicenseRef-Nordic-5-Clause
#

menu "Timer sample"

config SAMPLE_PERIODIC_TIMER_INTERVAL_MS
	int "Timeout interval of periodic timer"
	default 500

config SAMPLE_HELLO_TIMER_DURATION_MS
	int "First timeout duration of oneshot timer"
	default 1000

config SAMPLE_WORLD_TIMER_DURATION_MS
	int "Second timeout duration of oneshot timer"
	default 2000

config SAMPLE_BYE_TIMER_DURATION_MS
	int "Third timeout duration of oneshot timer"
	default 4000

module=SAMPLE_TIMER
module-str=Timer Sample
source "$(ZEPHYR_BASE)/subsys/logging/Kconfig.template.log_config"

endmenu # "Timer sample"

source "Kconfig.zephyr"
```

## sample.yaml
```
sample:
  name: Timer Sample
common:
  sysbuild: true
  build_only: true
  tags:
    - ci_build
tests:
  sample.timer:
    integration_platforms:
      - bm_nrf54lv10dk/nrf54lv10a/cpuapp/s115_softdevice
    platform_allow:
      - bm_nrf54l15dk/nrf54l05/cpuapp/s115_softdevice
      - bm_nrf54l15dk/nrf54l05/cpuapp/s115_softdevice/mcuboot
      - bm_nrf54l15dk/nrf54l05/cpuapp/s145_softdevice
      - bm_nrf54l15dk/nrf54l05/cpuapp/s145_softdevice/mcuboot
      - bm_nrf54l15dk/nrf54l10/cpuapp/s115_softdevice
      - bm_nrf54l15dk/nrf54l10/cpuapp/s115_softdevice/mcuboot
      - bm_nrf54l15dk/nrf54l10/cpuapp/s145_softdevice
      - bm_nrf54l15dk/nrf54l10/cpuapp/s145_softdevice/mcuboot
      - bm_nrf54l15dk/nrf54l15/cpuapp/s115_softdevice
      - bm_nrf54l15dk/nrf54l15/cpuapp/s115_softdevice/mcuboot
      - bm_nrf54l15dk/nrf54l15/cpuapp/s145_softdevice
      - bm_nrf54l15dk/nrf54l15/cpuapp/s145_softdevice/mcuboot
      - bm_nrf54lc10dk/nrf54lc10a/cpuapp/s115_softdevice
      - bm_nrf54lc10dk/nrf54lc10a/cpuapp/s115_softdevice/mcuboot
      - bm_nrf54lc10dk/nrf54lc10a/cpuapp/s145_softdevice
      - bm_nrf54lc10dk/nrf54lc10a/cpuapp/s145_softdevice/mcuboot
      - bm_nrf54lm20dk/nrf54lm20a/cpuapp/s115_softdevice
      - bm_nrf54lm20dk/nrf54lm20a/cpuapp/s115_softdevice/mcuboot
      - bm_nrf54lm20dk/nrf54lm20a/cpuapp/s145_softdevice
      - bm_nrf54lm20dk/nrf54lm20a/cpuapp/s145_softdevice/mcuboot
      - bm_nrf54ls05dk/nrf54ls05a/cpuapp/s115_softdevice
      - bm_nrf54ls05dk/nrf54ls05a/cpuapp/s115_softdevice/mcuboot
      - bm_nrf54ls05dk/nrf54ls05a/cpuapp/s145_softdevice
      - bm_nrf54ls05dk/nrf54ls05a/cpuapp/s145_softdevice/mcuboot
      - bm_nrf54ls05dk/nrf54ls05b/cpuapp/s115_softdevice
      - bm_nrf54ls05dk/nrf54ls05b/cpuapp/s115_softdevice/mcuboot
      - bm_nrf54ls05dk/nrf54ls05b/cpuapp/s145_softdevice
      - bm_nrf54ls05dk/nrf54ls05b/cpuapp/s145_softdevice/mcuboot
      - bm_nrf54lv10dk/nrf54lv10a/cpuapp/s115_softdevice
      - bm_nrf54lv10dk/nrf54lv10a/cpuapp/s115_softdevice/mcuboot
      - bm_nrf54lv10dk/nrf54lv10a/cpuapp/s145_softdevice
      - bm_nrf54lv10dk/nrf54lv10a/cpuapp/s145_softdevice/mcuboot
```

## prj.conf
```kconfig
# Logging
CONFIG_LOG=y
CONFIG_LOG_BACKEND_BM_UARTE=y

# Enabling SoftDevice is not strictly needed, though we are building with SoftDevice boards.
CONFIG_SOFTDEVICE=y

# Timer
CONFIG_BM_TIMER=y

# Clock control
CONFIG_CLOCK_CONTROL=y
```

## src/main.c
```c
/*
 * Copyright (c) 2025 Nordic Semiconductor ASA
 *
 * SPDX-License-Identifier: LicenseRef-Nordic-5-Clause
 */

#include <bm/bm_timer.h>
#include <zephyr/kernel.h>
#include <zephyr/logging/log.h>
#include <zephyr/logging/log_ctrl.h>
#include <hal/nrf_gpio.h>
#include <board-config.h>

LOG_MODULE_REGISTER(sample, CONFIG_SAMPLE_TIMER_LOG_LEVEL);

#define PERIODIC_TIMER_TICKS BM_TIMER_MS_TO_TICKS(CONFIG_SAMPLE_PERIODIC_TIMER_INTERVAL_MS)
#define HELLO_TIMER_TICKS    BM_TIMER_MS_TO_TICKS(CONFIG_SAMPLE_HELLO_TIMER_DURATION_MS)
#define WORLD_TIMER_TICKS    BM_TIMER_MS_TO_TICKS(CONFIG_SAMPLE_WORLD_TIMER_DURATION_MS)
#define BYE_TIMER_TICKS      BM_TIMER_MS_TO_TICKS(CONFIG_SAMPLE_BYE_TIMER_DURATION_MS)

static struct bm_timer oneshot_timer;
static struct bm_timer periodic_timer;

static const char *const hello_str = "Hello";
static const char *const world_str = "world!";
static const char *const bye_str = "bye!";

/**
 * @brief Timeout handler for single-shot timer.
 *
 * Restarts the oneshot timer two times with different strings. Then stops the periodic timer.
 */
static void oneshot_timeout_handler(void *context)
{
	static int cnt;
	int err;
	const char *const str = (const char *const)context;

	LOG_INF("%s", str);

	if (cnt == 0) {
		err = bm_timer_start(&oneshot_timer, WORLD_TIMER_TICKS, (void *)world_str);
		if (err) {
			LOG_ERR("Failed to start oneshot timer, err %d", err);
		}
	} else if (cnt == 1) {
		err = bm_timer_start(&oneshot_timer, BYE_TIMER_TICKS, (void *)bye_str);
		if (err) {
			LOG_ERR("Failed to start oneshot timer, err %d", err);
		}
	} else {
		err = bm_timer_stop(&periodic_timer);
		if (err) {
			LOG_ERR("Failed to stop periodic timer, err %d", err);
		}
	}

	cnt++;
}

/**
 * @brief Timeout handler for repeated timer.
 *
 * Prints punctuation on timeout.
 */
static void periodic_timeout_handler(void *context)
{
	ARG_UNUSED(context);

	LOG_INF(".");
}

int main(void)
{
	int err;

	LOG_INF("Timer sample started");

	err = bm_timer_init(&periodic_timer, BM_TIMER_MODE_REPEATED, periodic_timeout_handler);
	if (err) {
		LOG_ERR("Failed to initialize periodic timer, err %d", err);
		goto idle;
	}

	err = bm_timer_init(&oneshot_timer, BM_TIMER_MODE_SINGLE_SHOT, oneshot_timeout_handler);
	if (err) {
		LOG_ERR("Failed to initialize oneshot timer, err %d", err);
		goto idle;
	}

	err = bm_timer_start(&periodic_timer, PERIODIC_TIMER_TICKS, NULL);
	if (err) {
		LOG_ERR("Failed to start periodic timer, err %d", err);
		goto idle;
	}

	err = bm_timer_start(&oneshot_timer, HELLO_TIMER_TICKS, (void *)hello_str);
	if (err) {
		LOG_ERR("Failed to start oneshot timer, err %d", err);
		goto idle;
	}

	nrf_gpio_cfg_output(BOARD_PIN_LED_0);
	nrf_gpio_pin_write(BOARD_PIN_LED_0, BOARD_LED_ACTIVE_STATE);

	LOG_INF("Timer sample initialized");

idle:
	while (true) {
		log_flush();

		k_cpu_idle();
	}

	return 0;
}
```
