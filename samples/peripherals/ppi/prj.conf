## CMakeLists.txt
```
#
# Copyright (c) 2026 Nordic Semiconductor ASA
#
# SPDX-License-Identifier: LicenseRef-Nordic-5-Clause
#

cmake_minimum_required(VERSION 3.20.0)

find_package(Zephyr REQUIRED HINTS $ENV{ZEPHYR_BASE})
project(ppi)

target_sources(app PRIVATE src/main.c)
```

## Kconfig
```
#
# Copyright (c) 2026 Nordic Semiconductor ASA
#
# SPDX-License-Identifier: LicenseRef-Nordic-5-Clause
#

menu "PPI sample"

config SAMPLE_TIMER_IRQ_PRIO
	int "Timer IRQ priority"
	range 2 7
	default 3
	help
	  Sets the interrupt priority of the Timer peripheral used in the sample.
	  Levels are from 2 (highest priority) to 7 (lowest priority).

config SAMPLE_LED_BLINK_INTERVAL_MS
	int "LED blink interval in milliseconds"
	default 500
	help
	   This is the time the LED remains in an on and off state.

module=SAMPLE_PPI
module-str=PPI Sample
source "$(ZEPHYR_BASE)/subsys/logging/Kconfig.template.log_config"

endmenu # "PPI sample"

source "Kconfig.zephyr"
```

## sample.yaml
```
sample:
  name: PPI Sample
tests:
  sample.ppi:
    sysbuild: true
    build_only: true
    integration_platforms:
      - bm_nrf54l15dk/nrf54l15/cpuapp/s145_softdevice
    platform_allow:
      - bm_nrf54l15dk/nrf54l05/cpuapp/s115_softdevice
      - bm_nrf54l15dk/nrf54l10/cpuapp/s115_softdevice
      - bm_nrf54l15dk/nrf54l15/cpuapp/s115_softdevice
      - bm_nrf54l15dk/nrf54l05/cpuapp/s115_softdevice/mcuboot
      - bm_nrf54l15dk/nrf54l10/cpuapp/s115_softdevice/mcuboot
      - bm_nrf54l15dk/nrf54l15/cpuapp/s115_softdevice/mcuboot
      - bm_nrf54l15dk/nrf54l05/cpuapp/s145_softdevice
      - bm_nrf54l15dk/nrf54l10/cpuapp/s145_softdevice
      - bm_nrf54l15dk/nrf54l15/cpuapp/s145_softdevice
      - bm_nrf54l15dk/nrf54l05/cpuapp/s145_softdevice/mcuboot
      - bm_nrf54l15dk/nrf54l10/cpuapp/s145_softdevice/mcuboot
      - bm_nrf54l15dk/nrf54l15/cpuapp/s145_softdevice/mcuboot
      - bm_nrf54lc10dk/nrf54lc10a/cpuapp/s115_softdevice
      - bm_nrf54lc10dk/nrf54lc10a/cpuapp/s115_softdevice/mcuboot
      - bm_nrf54lc10dk/nrf54lc10a/cpuapp/s145_softdevice
      - bm_nrf54lc10dk/nrf54lc10a/cpuapp/s145_softdevice/mcuboot
      - bm_nrf54lm20dk/nrf54lm20a/cpuapp/s115_softdevice
      - bm_nrf54lm20dk/nrf54lm20a/cpuapp/s115_softdevice/mcuboot
      - bm_nrf54lm20dk/nrf54lm20a/cpuapp/s145_softdevice
      - bm_nrf54lm20dk/nrf54lm20a/cpuapp/s145_softdevice/mcuboot
      - bm_nrf54ls05dk/nrf54ls05a/cpuapp/s115_softdevice
      - bm_nrf54ls05dk/nrf54ls05a/cpuapp/s115_softdevice/mcuboot
      - bm_nrf54ls05dk/nrf54ls05a/cpuapp/s145_softdevice
      - bm_nrf54ls05dk/nrf54ls05a/cpuapp/s145_softdevice/mcuboot
      - bm_nrf54ls05dk/nrf54ls05b/cpuapp/s115_softdevice
      - bm_nrf54ls05dk/nrf54ls05b/cpuapp/s115_softdevice/mcuboot
      - bm_nrf54ls05dk/nrf54ls05b/cpuapp/s145_softdevice
      - bm_nrf54ls05dk/nrf54ls05b/cpuapp/s145_softdevice/mcuboot
      - bm_nrf54lv10dk/nrf54lv10a/cpuapp/s115_softdevice
      - bm_nrf54lv10dk/nrf54lv10a/cpuapp/s115_softdevice/mcuboot
      - bm_nrf54lv10dk/nrf54lv10a/cpuapp/s145_softdevice
      - bm_nrf54lv10dk/nrf54lv10a/cpuapp/s145_softdevice/mcuboot
    tags: ci_build
```

## prj.conf
```kconfig
# Logging
CONFIG_LOG=y
CONFIG_LOG_BACKEND_BM_UARTE=y

CONFIG_BM_GPIOTE=y

# Enabling SoftDevice is not strictly needed, though we are building with SoftDevice boards.
CONFIG_SOFTDEVICE=y
```

## src/main.c
```c
/*
 * Copyright (c) 2026 Nordic Semiconductor ASA
 *
 * SPDX-License-Identifier: LicenseRef-Nordic-5-Clause
 */

#include <zephyr/kernel.h>
#include <zephyr/logging/log.h>
#include <zephyr/logging/log_ctrl.h>
#include <bm/bm_gpiote.h>
#include <bm/bm_irq.h>
#include <helpers/nrfx_gppi.h>
#include <nrfx_gpiote.h>
#include <nrfx_timer.h>
#include <board-config.h>

LOG_MODULE_REGISTER(sample, CONFIG_SAMPLE_PPI_LOG_LEVEL);

static nrfx_timer_t timer_inst = NRFX_TIMER_INSTANCE(NRF_TIMER20);

ISR_DIRECT_DECLARE(timer_direct_isr)
{
	nrfx_timer_irq_handler(&timer_inst);
	return 0;
}

static void timer_handler(nrf_timer_event_t event_type, void *ctx)
{
	switch (event_type) {
	case NRF_TIMER_EVENT_COMPARE0:
	default:
		/* Do nothing. */
		break;
	}
}

int main(void)
{
	int err;
	uint8_t out_channel;
	nrfx_gppi_handle_t gppi_handle;
	uint32_t ticks_blink_period;

	nrfx_gpiote_t *gpiote_inst =
		bm_gpiote_instance_get(NRF_PIN_NUMBER_TO_PORT(BOARD_PIN_LED_1));

	nrfx_timer_config_t timer_config = {
		/* For frequencies up to 1MHz, the timer peripheral uses the 1MHz clock instead of
		 * the 16MHz clock.
		 */
		.frequency = 1000000,
		.mode = NRF_TIMER_MODE_TIMER,
		.bit_width = NRF_TIMER_BIT_WIDTH_32,
		.interrupt_priority = CONFIG_SAMPLE_TIMER_IRQ_PRIO,
	};
	const nrfx_gpiote_output_config_t gpiote_output_config = {
		.drive = NRF_GPIO_PIN_S0S1,
		.input_connect = NRF_GPIO_PIN_INPUT_DISCONNECT,
		.pull = NRF_GPIO_PIN_NOPULL,
	};
	nrfx_gpiote_task_config_t gpiote_task_config = {
		.polarity = NRF_GPIOTE_POLARITY_TOGGLE,
		.init_val = NRF_GPIOTE_INITIAL_VALUE_LOW,
	};

	LOG_INF("PPI sample started");

	BM_IRQ_DIRECT_CONNECT(NRFX_IRQ_NUMBER_GET(NRF_TIMER20),
			      CONFIG_SAMPLE_TIMER_IRQ_PRIO,
			      timer_direct_isr, 0);

	err = nrfx_timer_init(&timer_inst, &timer_config, timer_handler);
	if (err) {
		LOG_ERR("nrfx_timer_init failed, err %d", err);
		goto idle;
	}

	ticks_blink_period = nrfx_timer_ms_to_ticks(&timer_inst,
						    CONFIG_SAMPLE_LED_BLINK_INTERVAL_MS);

	nrfx_timer_extended_compare(&timer_inst, NRF_TIMER_CC_CHANNEL0, ticks_blink_period,
				    NRF_TIMER_SHORT_COMPARE0_CLEAR_MASK, true);

	err = nrfx_gpiote_channel_alloc(gpiote_inst, &out_channel);
	if (err) {
		LOG_ERR("nrfx_gpiote_channel_alloc failed, err %d", err);
		goto idle;
	}

	gpiote_task_config.task_ch = out_channel;

	err = nrfx_gpiote_output_configure(
		gpiote_inst, BOARD_PIN_LED_1, &gpiote_output_config, &gpiote_task_config);
	if (err) {
		LOG_ERR("nrfx_gpiote_output_configure failed, err %d", err);
		goto idle;
	}

	nrfx_gpiote_out_task_enable(gpiote_inst, BOARD_PIN_LED_1);

	/* Allocate a GPPI channel and setup the connection between the timer and LED1 */
	err = nrfx_gppi_conn_alloc(
		nrfx_timer_compare_event_address_get(&timer_inst, NRF_TIMER_CC_CHANNEL0),
		nrfx_gpiote_out_task_address_get(gpiote_inst, BOARD_PIN_LED_1),
		&gppi_handle);
	if (err) {
		LOG_ERR("nrfx_gppi_conn_alloc failed, err %d", err);
		goto idle;
	}

	nrf_gpio_cfg_output(BOARD_PIN_LED_0);
	nrf_gpio_pin_write(BOARD_PIN_LED_0, BOARD_LED_ACTIVE_STATE);
	LOG_INF("PPI sample initialized");

	nrfx_gppi_conn_enable(gppi_handle);

	/* We don't want to wake up the CPU on timer compare event. */
	nrfx_timer_compare_int_disable(&timer_inst, NRF_TIMER_CC_CHANNEL0);

	nrfx_timer_enable(&timer_inst);

idle:
	while (true) {
		log_flush();
		k_cpu_idle();
	}

	return 0;
}
```
