## CMakeLists.txt
```
#
# Copyright (c) 2025 Nordic Semiconductor ASA
#
# SPDX-License-Identifier: LicenseRef-Nordic-5-Clause
#

cmake_minimum_required(VERSION 3.20.0)

find_package(Zephyr REQUIRED HINTS $ENV{ZEPHYR_BASE})
project(lpuarte)

target_sources(app PRIVATE src/main.c)
```

## Kconfig
```
#
# Copyright (c) 2025 Nordic Semiconductor ASA
#
# SPDX-License-Identifier: LicenseRef-Nordic-5-Clause
#

menu "LPUARTE sample"

config SAMPLE_LPUARTE_DATA_LEN_MAX
	int "Maximum UARTE data length"
	default 128
	help
	  Defines the maximum length the application can store in the receive buffer.

config SAMPLE_LPUARTE_PARITY
	bool "UARTE parity"
	help
	  Enable parity on the UARTE peripheral used by the application.

config SAMPLE_LPUARTE_IRQ_PRIO
	int "LPUARTE IRQ priority"
	range 2 7
	default 5 if SOFTDEVICE
	default 3
	help
	  Sets the interrupt priority of the UARTE peripheral used in the LPUARTE sample.
	  Levels are from 2 (highest priority) to 7 (lowest priority).
	  Interrupt priority level must be greater than 4 (SoftDevice low priority)
	  if you want to call into SoftDevice from the interrupt driver.

config SAMPLE_LPUARTE_INIT_LED
	bool "LED indicating if application has been initialized"

module=SAMPLE_LPUARTE
module-str=Low Power UARTE Sample
source "$(ZEPHYR_BASE)/subsys/logging/Kconfig.template.log_config"

endmenu # "LPUARTE sample"

source "Kconfig.zephyr"
```

## sample.yaml
```
sample:
  name: LPUARTE Sample
tests:
  sample.lpuarte:
    sysbuild: true
    build_only: true
    integration_platforms:
      - bm_nrf54lm20dk/nrf54lm20a/cpuapp/s115_softdevice
    platform_allow:
      - bm_nrf54l15dk/nrf54l05/cpuapp/s115_softdevice
      - bm_nrf54l15dk/nrf54l05/cpuapp/s115_softdevice/mcuboot
      - bm_nrf54l15dk/nrf54l05/cpuapp/s145_softdevice
      - bm_nrf54l15dk/nrf54l05/cpuapp/s145_softdevice/mcuboot
      - bm_nrf54l15dk/nrf54l10/cpuapp/s115_softdevice
      - bm_nrf54l15dk/nrf54l10/cpuapp/s115_softdevice/mcuboot
      - bm_nrf54l15dk/nrf54l10/cpuapp/s145_softdevice
      - bm_nrf54l15dk/nrf54l10/cpuapp/s145_softdevice/mcuboot
      - bm_nrf54l15dk/nrf54l15/cpuapp/s115_softdevice
      - bm_nrf54l15dk/nrf54l15/cpuapp/s115_softdevice/mcuboot
      - bm_nrf54l15dk/nrf54l15/cpuapp/s145_softdevice
      - bm_nrf54l15dk/nrf54l15/cpuapp/s145_softdevice/mcuboot
      - bm_nrf54lc10dk/nrf54lc10a/cpuapp/s115_softdevice
      - bm_nrf54lc10dk/nrf54lc10a/cpuapp/s115_softdevice/mcuboot
      - bm_nrf54lc10dk/nrf54lc10a/cpuapp/s145_softdevice
      - bm_nrf54lc10dk/nrf54lc10a/cpuapp/s145_softdevice/mcuboot
      - bm_nrf54lm20dk/nrf54lm20a/cpuapp/s115_softdevice
      - bm_nrf54lm20dk/nrf54lm20a/cpuapp/s115_softdevice/mcuboot
      - bm_nrf54lm20dk/nrf54lm20a/cpuapp/s145_softdevice
      - bm_nrf54lm20dk/nrf54lm20a/cpuapp/s145_softdevice/mcuboot
      - bm_nrf54ls05dk/nrf54ls05a/cpuapp/s115_softdevice
      - bm_nrf54ls05dk/nrf54ls05a/cpuapp/s115_softdevice/mcuboot
      - bm_nrf54ls05dk/nrf54ls05a/cpuapp/s145_softdevice
      - bm_nrf54ls05dk/nrf54ls05a/cpuapp/s145_softdevice/mcuboot
      - bm_nrf54ls05dk/nrf54ls05b/cpuapp/s115_softdevice
      - bm_nrf54ls05dk/nrf54ls05b/cpuapp/s115_softdevice/mcuboot
      - bm_nrf54ls05dk/nrf54ls05b/cpuapp/s145_softdevice
      - bm_nrf54ls05dk/nrf54ls05b/cpuapp/s145_softdevice/mcuboot
      - bm_nrf54lv10dk/nrf54lv10a/cpuapp/s115_softdevice
      - bm_nrf54lv10dk/nrf54lv10a/cpuapp/s115_softdevice/mcuboot
      - bm_nrf54lv10dk/nrf54lv10a/cpuapp/s145_softdevice
      - bm_nrf54lv10dk/nrf54lv10a/cpuapp/s145_softdevice/mcuboot
    tags: ci_build
```

## prj.conf
```kconfig
# Disable logging and console for power efficiency
CONFIG_LOG=n
CONFIG_LOG_BACKEND_BM_UARTE=n
CONFIG_CONSOLE=n
CONFIG_BM_UARTE_CONSOLE=n

# Enabling SoftDevice is not strictly needed, though we are building with SoftDevice boards.
CONFIG_SOFTDEVICE=y

# Timer
CONFIG_BM_TIMER=y

# Clock control
CONFIG_CLOCK_CONTROL=y

# Low Power UARTE
CONFIG_BM_SW_LPUARTE=y
CONFIG_BM_GPIOTE=y

# Set number of event handlers used by the LPUART driver
CONFIG_NRFX_GPIOTE_NUM_OF_EVT_HANDLERS=2
```

## src/main.c
```c
/*
 * Copyright (c) 2025 Nordic Semiconductor ASA
 *
 * SPDX-License-Identifier: LicenseRef-Nordic-5-Clause
 */

#include <nrfx_uarte.h>
#include <bm/drivers/bm_lpuarte.h>
#include <bm/bm_irq.h>
#include <bm/bm_timer.h>
#include <bm/softdevice_handler/nrf_sdh.h>

#include <zephyr/kernel.h>
#include <zephyr/logging/log.h>
#include <zephyr/logging/log_ctrl.h>

#include <hal/nrf_gpio.h>
#include <board-config.h>

LOG_MODULE_REGISTER(sample, CONFIG_SAMPLE_LPUARTE_LOG_LEVEL);

#define SAMPLE_LPUARTE_RX_BUF_SIZE 128

static nrfx_uarte_t uarte_inst = NRFX_UARTE_INSTANCE(BOARD_APP_LPUARTE_INST);

/** Application Low Power UARTE instance */
struct bm_lpuarte lpu;

/* Receive buffer used in UARTE ISR callback */
static uint8_t uarte_rx_buf[2][SAMPLE_LPUARTE_RX_BUF_SIZE];
static int buf_idx;

/* Handle data received from UARTE. */
static void uarte_rx_handler(char *data, size_t data_len)
{
	LOG_HEXDUMP_INF(data, data_len, "Received data from UARTE:");
}

/* UARTE event handler */
static void lpuarte_event_handler(const nrfx_uarte_event_t *event, void *ctx)
{
	struct bm_lpuarte *lpu = ctx;

	switch (event->type) {
	case NRFX_UARTE_EVT_RX_DONE:
		if (event->data.rx.length > 0) {
			uarte_rx_handler(event->data.rx.p_buffer, event->data.rx.length);
		}
		break;
	case NRFX_UARTE_EVT_RX_BUF_REQUEST:
		(void)bm_lpuarte_rx_buffer_set(lpu, uarte_rx_buf[buf_idx],
					       SAMPLE_LPUARTE_RX_BUF_SIZE);
		buf_idx = buf_idx ? 0 : 1;
		break;
	case NRFX_UARTE_EVT_ERROR:
		LOG_ERR("UARTE error event, %#x", event->data.error.error_mask);
		break;
	default:
		break;
	}
}

ISR_DIRECT_DECLARE(lpuarte_direct_isr)
{
	nrfx_uarte_irq_handler(&uarte_inst);
	return 0;
}

/* Initialize UARTE driver. */
static int lpuarte_init(void)
{
	int err;

	struct bm_lpuarte_config lpu_cfg = {
		.uarte_inst = &uarte_inst,
		.uarte_cfg = NRFX_UARTE_DEFAULT_CONFIG(BOARD_APP_LPUARTE_PIN_TX,
						       BOARD_APP_LPUARTE_PIN_RX),
		.req_pin = BOARD_APP_LPUARTE_PIN_REQ,
		.rdy_pin = BOARD_APP_LPUARTE_PIN_RDY,
	};

#if defined(CONFIG_SAMPLE_LPUARTE_PARITY)
	lpu_cfg.uarte_cfg.config.parity = NRF_UARTE_PARITY_INCLUDED;
#endif

	lpu_cfg.uarte_cfg.interrupt_priority = CONFIG_SAMPLE_LPUARTE_IRQ_PRIO;

	BM_IRQ_DIRECT_CONNECT(NRFX_IRQ_NUMBER_GET(BOARD_APP_LPUARTE_INST),
			      CONFIG_SAMPLE_LPUARTE_IRQ_PRIO,
			      lpuarte_direct_isr, 0);

	irq_enable(NRFX_IRQ_NUMBER_GET(BOARD_APP_LPUARTE_INST));

	err = bm_lpuarte_init(&lpu, &lpu_cfg, lpuarte_event_handler);
	if (err) {
		LOG_ERR("Failed to initialize UARTE, err %d", err);
		return err;
	}

	return 0;
}

static struct bm_timer tx_timer;
static uint8_t out[] = {1, 2, 3, 4, 5};

static void tx_timeout(void *context)
{
	int err;

	err = bm_lpuarte_tx(&lpu, out, sizeof(out), 3000);
	if (err) {
		LOG_ERR("UARTE TX failed, err %d", err);
		return;
	}
}

int main(void)
{
	int err;

	LOG_INF("LPUARTE sample started");
	LOG_INF("Disable console and logging for minimal power consumption");

	/* Enable the SoftDevice to be able to request the HFCLK for LPUARTE. */
	err = nrf_sdh_enable_request();
	if (err) {
		LOG_ERR("Failed to enable SoftDevice, err %d", err);
		goto idle;
	}

	LOG_INF("SoftDevice enabled");

	err = lpuarte_init();
	if (err) {
		LOG_ERR("Failed to enable UARTE, err %d", err);
		goto idle;
	}

	/* Start reception */
	err = bm_lpuarte_rx_enable(&lpu);
	if (err) {
		LOG_ERR("UARTE RX failed, err %d", err);
		goto idle;
	}

	err = bm_timer_init(&tx_timer, BM_TIMER_MODE_REPEATED, tx_timeout);
	if (err) {
		LOG_ERR("bm_timer_init failed, err %d", err);
		goto idle;
	}

	err = bm_timer_start(&tx_timer, BM_TIMER_MS_TO_TICKS(5000), NULL);
	if (err) {
		LOG_ERR("bm_timer_start failed, err %d", err);
	}

#if defined(CONFIG_SAMPLE_LPUARTE_INIT_LED)
	nrf_gpio_cfg_output(BOARD_PIN_LED_0);
	nrf_gpio_pin_write(BOARD_PIN_LED_0, BOARD_LED_ACTIVE_STATE);
#endif

	LOG_INF("LPUARTE sample initialized");

idle:
	while (true) {
		log_flush();

		k_cpu_idle();
	}

	/* Unreachable */
	return 0;
}
```
