## CMakeLists.txt
```
#
# Copyright (c) 2025 Nordic Semiconductor ASA
#
# SPDX-License-Identifier: LicenseRef-Nordic-5-Clause
#

cmake_minimum_required(VERSION 3.20.0)

find_package(Zephyr REQUIRED HINTS $ENV{ZEPHYR_BASE})
project(pwm)

target_sources(app PRIVATE src/main.c)
```

## Kconfig
```
#
# Copyright (c) 2025 Nordic Semiconductor ASA
#
# SPDX-License-Identifier: LicenseRef-Nordic-5-Clause
#

menu "PWM sample"

config SAMPLE_PWM_IRQ_PRIO
	int "PWM IRQ priority"
	range 2 7
	default 3
	help
	  Sets the interrupt priority of the PWM peripheral used in the sample.
	  Levels are from 2 (highest priority) to 7 (lowest priority).

config SAMPLE_PWM_PLAYBACK_COUNT
	int "PWM playback count"
	default 1
	help
	  Number of times the sequence will be replayed until the
	  NRFX_PWM_EVT_FINISHED event is raised.

config SAMPLE_PWM_VALUE_REPEATS
	int "PWM value repeats"
	default 150
	help
	   Number of times that each duty cycle is to be repeated (after being played once).

module=SAMPLE_PWM
module-str=PWM Sample
source "$(ZEPHYR_BASE)/subsys/logging/Kconfig.template.log_config"

endmenu # "PWM sample"

source "Kconfig.zephyr"
```

## sample.yaml
```
sample:
  name: PWM Sample
tests:
  sample.pwm:
    sysbuild: true
    build_only: true
    integration_platforms:
      - bm_nrf54lm20dk/nrf54lm20a/cpuapp/s115_softdevice
    platform_allow:
      - bm_nrf54l15dk/nrf54l05/cpuapp/s115_softdevice
      - bm_nrf54l15dk/nrf54l05/cpuapp/s115_softdevice/mcuboot
      - bm_nrf54l15dk/nrf54l05/cpuapp/s145_softdevice
      - bm_nrf54l15dk/nrf54l05/cpuapp/s145_softdevice/mcuboot
      - bm_nrf54l15dk/nrf54l10/cpuapp/s115_softdevice
      - bm_nrf54l15dk/nrf54l10/cpuapp/s115_softdevice/mcuboot
      - bm_nrf54l15dk/nrf54l10/cpuapp/s145_softdevice
      - bm_nrf54l15dk/nrf54l10/cpuapp/s145_softdevice/mcuboot
      - bm_nrf54l15dk/nrf54l15/cpuapp/s115_softdevice
      - bm_nrf54l15dk/nrf54l15/cpuapp/s115_softdevice/mcuboot
      - bm_nrf54l15dk/nrf54l15/cpuapp/s145_softdevice
      - bm_nrf54l15dk/nrf54l15/cpuapp/s145_softdevice/mcuboot
      - bm_nrf54lm20dk/nrf54lm20a/cpuapp/s115_softdevice
      - bm_nrf54lm20dk/nrf54lm20a/cpuapp/s115_softdevice/mcuboot
      - bm_nrf54lm20dk/nrf54lm20a/cpuapp/s145_softdevice
      - bm_nrf54lm20dk/nrf54lm20a/cpuapp/s145_softdevice/mcuboot
    tags: ci_build
```

## prj.conf
```kconfig
# Logging
CONFIG_LOG=y
CONFIG_LOG_BACKEND_BM_UARTE=y

# Enabling SoftDevice is not strictly needed, though we are building with SoftDevice boards.
CONFIG_SOFTDEVICE=y
```

## src/main.c
```c
/*
 * Copyright (c) 2025 Nordic Semiconductor ASA
 *
 * SPDX-License-Identifier: LicenseRef-Nordic-5-Clause
 */

#include <zephyr/kernel.h>
#include <zephyr/logging/log.h>
#include <zephyr/logging/log_ctrl.h>
#include <bm/bm_irq.h>
#include <nrfx_pwm.h>
#include <hal/nrf_gpio.h>
#include <board-config.h>

LOG_MODULE_REGISTER(sample, CONFIG_SAMPLE_PWM_LOG_LEVEL);

/* nrfx PWM instance index. */
#define PWM_INST NRF_PWM20

nrfx_pwm_t pwm_instance = NRFX_PWM_INSTANCE(PWM_INST);
nrf_pwm_values_common_t pwm_val[] = {
	0, 100, 200, 300, 400, 500, 600, 700, 800, 900, 1000,
	900, 800, 700, 600, 500, 400, 300, 200, 100, 0
};

static void pwm_handler(nrfx_pwm_event_type_t event_type, void *ctx)
{
	static uint32_t curr_loop = 1;

	LOG_INF("Loops: %u ", curr_loop);
	curr_loop++;
}

ISR_DIRECT_DECLARE(pwm_direct_isr)
{
	nrfx_pwm_irq_handler(&pwm_instance);
	return 0;
}

int main(void)
{
	int err;
	/*
	 * PWM signal can be exposed on GPIO pin only within the same domain.
	 * For nRF54L-series there is only one domain which contains both PWM and GPIO:
	 * PWM20/21/22 and GPIO Port P1.
	 * Only LEDs connected to P1 can work with PWM, in this case LED1 and LED3.
	 */
	nrfx_pwm_config_t config = NRFX_PWM_DEFAULT_CONFIG(BOARD_PIN_LED_1, BOARD_PIN_LED_3,
							   NRF_PWM_PIN_NOT_CONNECTED,
							   NRF_PWM_PIN_NOT_CONNECTED);
	nrf_pwm_sequence_t seq = {
		.values = {pwm_val},
		.length = NRFX_ARRAY_SIZE(pwm_val),
		.repeats = CONFIG_SAMPLE_PWM_VALUE_REPEATS,
		.end_delay = 0
	};

	LOG_INF("PWM sample started");

	BM_IRQ_DIRECT_CONNECT(NRFX_IRQ_NUMBER_GET(PWM_INST),
			      CONFIG_SAMPLE_PWM_IRQ_PRIO,
			      pwm_direct_isr, 0);

	err = nrfx_pwm_init(&pwm_instance, &config, pwm_handler, &pwm_instance);
	if (err) {
		LOG_ERR("Failed to initialize PWM, err %d", err);
		goto idle;
	}

	nrfx_pwm_simple_playback(&pwm_instance, &seq, CONFIG_SAMPLE_PWM_PLAYBACK_COUNT,
				 NRFX_PWM_FLAG_LOOP);

	nrf_gpio_cfg_output(BOARD_PIN_LED_0);
	nrf_gpio_pin_write(BOARD_PIN_LED_0, BOARD_LED_ACTIVE_STATE);

	LOG_INF("PWM sample initialized");

idle:
	while (true) {
		log_flush();

		k_cpu_idle();
	}

	return 0;
}
```
