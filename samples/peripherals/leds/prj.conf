## CMakeLists.txt
```
#
# Copyright (c) 2025 Nordic Semiconductor ASA
#
# SPDX-License-Identifier: LicenseRef-Nordic-5-Clause
#

cmake_minimum_required(VERSION 3.20.0)

find_package(Zephyr REQUIRED HINTS $ENV{ZEPHYR_BASE})
project(leds)

target_sources(app PRIVATE src/main.c)
```

## Kconfig
```
#
# Copyright (c) 2025 Nordic Semiconductor ASA
#
# SPDX-License-Identifier: LicenseRef-Nordic-5-Clause
#

menu "LEDs sample"

module=SAMPLE_LEDS
module-str=LEDs Sample
source "$(ZEPHYR_BASE)/subsys/logging/Kconfig.template.log_config"

endmenu # "LEDs sample"

source "Kconfig.zephyr"
```

## sample.yaml
```
sample:
  name: LEDs Sample
tests:
  sample.leds:
    sysbuild: true
    build_only: true
    integration_platforms:
      - bm_nrf54lv10dk/nrf54lv10a/cpuapp/s145_softdevice
    platform_allow:
      - bm_nrf54l15dk/nrf54l05/cpuapp/s115_softdevice
      - bm_nrf54l15dk/nrf54l05/cpuapp/s115_softdevice/mcuboot
      - bm_nrf54l15dk/nrf54l05/cpuapp/s145_softdevice
      - bm_nrf54l15dk/nrf54l05/cpuapp/s145_softdevice/mcuboot
      - bm_nrf54l15dk/nrf54l10/cpuapp/s115_softdevice
      - bm_nrf54l15dk/nrf54l10/cpuapp/s115_softdevice/mcuboot
      - bm_nrf54l15dk/nrf54l10/cpuapp/s145_softdevice
      - bm_nrf54l15dk/nrf54l10/cpuapp/s145_softdevice/mcuboot
      - bm_nrf54l15dk/nrf54l15/cpuapp/s115_softdevice
      - bm_nrf54l15dk/nrf54l15/cpuapp/s115_softdevice/mcuboot
      - bm_nrf54l15dk/nrf54l15/cpuapp/s145_softdevice
      - bm_nrf54l15dk/nrf54l15/cpuapp/s145_softdevice/mcuboot
      - bm_nrf54lc10dk/nrf54lc10a/cpuapp/s115_softdevice
      - bm_nrf54lc10dk/nrf54lc10a/cpuapp/s115_softdevice/mcuboot
      - bm_nrf54lc10dk/nrf54lc10a/cpuapp/s145_softdevice
      - bm_nrf54lc10dk/nrf54lc10a/cpuapp/s145_softdevice/mcuboot
      - bm_nrf54lm20dk/nrf54lm20a/cpuapp/s115_softdevice
      - bm_nrf54lm20dk/nrf54lm20a/cpuapp/s115_softdevice/mcuboot
      - bm_nrf54lm20dk/nrf54lm20a/cpuapp/s145_softdevice
      - bm_nrf54lm20dk/nrf54lm20a/cpuapp/s145_softdevice/mcuboot
      - bm_nrf54ls05dk/nrf54ls05a/cpuapp/s115_softdevice
      - bm_nrf54ls05dk/nrf54ls05a/cpuapp/s115_softdevice/mcuboot
      - bm_nrf54ls05dk/nrf54ls05a/cpuapp/s145_softdevice
      - bm_nrf54ls05dk/nrf54ls05a/cpuapp/s145_softdevice/mcuboot
      - bm_nrf54ls05dk/nrf54ls05b/cpuapp/s115_softdevice
      - bm_nrf54ls05dk/nrf54ls05b/cpuapp/s115_softdevice/mcuboot
      - bm_nrf54ls05dk/nrf54ls05b/cpuapp/s145_softdevice
      - bm_nrf54ls05dk/nrf54ls05b/cpuapp/s145_softdevice/mcuboot
      - bm_nrf54lv10dk/nrf54lv10a/cpuapp/s115_softdevice
      - bm_nrf54lv10dk/nrf54lv10a/cpuapp/s115_softdevice/mcuboot
      - bm_nrf54lv10dk/nrf54lv10a/cpuapp/s145_softdevice
      - bm_nrf54lv10dk/nrf54lv10a/cpuapp/s145_softdevice/mcuboot
    tags: ci_build
```

## prj.conf
```kconfig
# Logging
CONFIG_LOG=y
CONFIG_LOG_BACKEND_BM_UARTE=y

# Enabling SoftDevice is not strictly needed, though we are building with SoftDevice boards.
CONFIG_SOFTDEVICE=y

# Clock control
CONFIG_CLOCK_CONTROL=y
```

## src/main.c
```c
/*
 * Copyright (c) 2025 Nordic Semiconductor ASA
 *
 * SPDX-License-Identifier: LicenseRef-Nordic-5-Clause
 */

#include <zephyr/kernel.h> /* k_busy_wait() */
#include <zephyr/sys_clock.h> /* USEC_PER_MSEC */
#include <zephyr/logging/log.h>
#include <zephyr/logging/log_ctrl.h>

#include <hal/nrf_gpio.h>

#include <board-config.h>

LOG_MODULE_REGISTER(sample, CONFIG_SAMPLE_LEDS_LOG_LEVEL);

static void led_init(void)
{
	nrf_gpio_cfg_output(BOARD_PIN_LED_0);
	nrf_gpio_cfg_output(BOARD_PIN_LED_2);
	nrf_gpio_pin_write(BOARD_PIN_LED_0, !BOARD_LED_ACTIVE_STATE);
	nrf_gpio_pin_write(BOARD_PIN_LED_2, !BOARD_LED_ACTIVE_STATE);
}

static void led_on(void)
{
	nrf_gpio_pin_write(BOARD_PIN_LED_2, BOARD_LED_ACTIVE_STATE);
}

static void led_off(void)
{
	nrf_gpio_pin_write(BOARD_PIN_LED_2, !BOARD_LED_ACTIVE_STATE);
}

int main(void)
{
	LOG_INF("LEDs sample started");

	/* Initialize the LED */
	led_init();
	LOG_INF("LEDs enabled");

	/* Signal successful initialization */
	nrf_gpio_pin_write(BOARD_PIN_LED_0, BOARD_LED_ACTIVE_STATE);
	LOG_INF("LEDs sample initialized");

	while (true) {
		log_flush();

		/* Turn the LED on */
		led_on();

		k_busy_wait(500 * USEC_PER_MSEC);

		/* Turn the LED off */
		led_off();

		k_busy_wait(500 * USEC_PER_MSEC);
	}

	return 0;
}
```
