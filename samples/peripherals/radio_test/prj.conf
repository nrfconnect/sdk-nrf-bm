## CMakeLists.txt
```
#
# Copyright (c) 2026 Nordic Semiconductor
#
# SPDX-License-Identifier: LicenseRef-Nordic-5-Clause
#

cmake_minimum_required(VERSION 3.20.0)

find_package(Zephyr REQUIRED HINTS $ENV{ZEPHYR_BASE})
project(peripheral_radio_test)

FILE(GLOB app_sources src/*.c)

target_sources(app PRIVATE
  ${app_sources}
)
```

## Kconfig
```
#
# Copyright (c) 2026 Nordic Semiconductor
#
# SPDX-License-Identifier: LicenseRef-Nordic-5-Clause
#

mainmenu "Nordic Radio test sample"

config SAMPLE_RADIO_TEST_RX_TIMEOUT
	int "RX packet reception timeout in seconds"
	default 10
	help
	  Specifies the time in seconds that the application waits for the first packet to be
	  received in RX mode when a specified number of packets are set to be received.
	  If the timeout is reached before the first packet is received, the radio will be disabled.

source "Kconfig.zephyr"
```

## sample.yaml
```
sample:
  name: radio_test sample
tests:
  sample.radio_test:
    sysbuild: true
    build_only: true
    integration_platforms:
      - bm_nrf54l15dk/nrf54l10/cpuapp/s115_softdevice
    platform_allow:
      - bm_nrf54l15dk/nrf54l05/cpuapp/s115_softdevice
      - bm_nrf54l15dk/nrf54l05/cpuapp/s115_softdevice/mcuboot
      - bm_nrf54l15dk/nrf54l05/cpuapp/s145_softdevice
      - bm_nrf54l15dk/nrf54l05/cpuapp/s145_softdevice/mcuboot
      - bm_nrf54l15dk/nrf54l10/cpuapp/s115_softdevice
      - bm_nrf54l15dk/nrf54l10/cpuapp/s115_softdevice/mcuboot
      - bm_nrf54l15dk/nrf54l10/cpuapp/s145_softdevice
      - bm_nrf54l15dk/nrf54l10/cpuapp/s145_softdevice/mcuboot
      - bm_nrf54l15dk/nrf54l15/cpuapp/s115_softdevice
      - bm_nrf54l15dk/nrf54l15/cpuapp/s115_softdevice/mcuboot
      - bm_nrf54l15dk/nrf54l15/cpuapp/s145_softdevice
      - bm_nrf54l15dk/nrf54l15/cpuapp/s145_softdevice/mcuboot
      - bm_nrf54lc10dk/nrf54lc10a/cpuapp/s115_softdevice
      - bm_nrf54lc10dk/nrf54lc10a/cpuapp/s115_softdevice/mcuboot
      - bm_nrf54lc10dk/nrf54lc10a/cpuapp/s145_softdevice
      - bm_nrf54lc10dk/nrf54lc10a/cpuapp/s145_softdevice/mcuboot
      - bm_nrf54lm20dk/nrf54lm20a/cpuapp/s115_softdevice
      - bm_nrf54lm20dk/nrf54lm20a/cpuapp/s115_softdevice/mcuboot
      - bm_nrf54lm20dk/nrf54lm20a/cpuapp/s145_softdevice
      - bm_nrf54lm20dk/nrf54lm20a/cpuapp/s145_softdevice/mcuboot
      - bm_nrf54ls05dk/nrf54ls05a/cpuapp/s115_softdevice
      - bm_nrf54ls05dk/nrf54ls05a/cpuapp/s115_softdevice/mcuboot
      - bm_nrf54ls05dk/nrf54ls05a/cpuapp/s145_softdevice
      - bm_nrf54ls05dk/nrf54ls05a/cpuapp/s145_softdevice/mcuboot
      - bm_nrf54ls05dk/nrf54ls05b/cpuapp/s115_softdevice
      - bm_nrf54ls05dk/nrf54ls05b/cpuapp/s115_softdevice/mcuboot
      - bm_nrf54ls05dk/nrf54ls05b/cpuapp/s145_softdevice
      - bm_nrf54ls05dk/nrf54ls05b/cpuapp/s145_softdevice/mcuboot
      - bm_nrf54lv10dk/nrf54lv10a/cpuapp/s115_softdevice
      - bm_nrf54lv10dk/nrf54lv10a/cpuapp/s115_softdevice/mcuboot
      - bm_nrf54lv10dk/nrf54lv10a/cpuapp/s145_softdevice
      - bm_nrf54lv10dk/nrf54lv10a/cpuapp/s145_softdevice/mcuboot
    tags: ci_build
```

## prj.conf
```kconfig
#
# Copyright (c) 2026 Nordic Semiconductor
#
# SPDX-License-Identifier: LicenseRef-Nordic-5-Clause
#

# Logging
CONFIG_LOG=y
CONFIG_LOG_BACKEND_BM_UARTE=y

# Shell
CONFIG_SHELL=y
CONFIG_SHELL_BACKEND_BM_UARTE=y

# Optional shell features
CONFIG_SHELL_HELP=y
CONFIG_SHELL_TAB=y
CONFIG_SHELL_TAB_AUTOCOMPLETION=y
CONFIG_SHELL_HISTORY=y

# HW used by radio_test
CONFIG_NRFX_TIMER=y
CONFIG_NRFX_GPPI=y

# Use fake PRNG to reduce HW dependencies
CONFIG_TEST_RANDOM_GENERATOR=y

# Disable SoftDevice.
# The radio_test sample needs to control radio and other relevant periperhals on its own.
CONFIG_SOFTDEVICE=n
```

## src/main.c
```c
/*
 * Copyright (c) 2026 Nordic Semiconductor ASA
 *
 * SPDX-License-Identifier: LicenseRef-Nordic-5-Clause
 */

#include <zephyr/shell/shell.h>
#include <bm/shell/backend_bm_uarte.h>
#include <nrfx.h>
#include <hal/nrf_clock.h>
#if NRF_ERRATA_STATIC_CHECK(54L, 20)
#include <hal/nrf_power.h>
#endif /* NRF_ERRATA_STATIC_CHECK(54L, 20) */

#include "radio_test.h"

const struct shell *sh;

static void clock_init(void)
{
	nrf_clock_event_clear(NRF_CLOCK, NRF_CLOCK_EVENT_HFCLKSTARTED);
	nrf_clock_task_trigger(NRF_CLOCK, NRF_CLOCK_TASK_HFCLKSTART);
	while (!nrf_clock_event_check(NRF_CLOCK, NRF_CLOCK_EVENT_HFCLKSTARTED)) {
		/* spin until HFXO is up */
	}
	nrf_clock_event_clear(NRF_CLOCK, NRF_CLOCK_EVENT_HFCLKSTARTED);

#if NRF_ERRATA_STATIC_CHECK(54L, 20)
	if (NRF_ERRATA_DYNAMIC_CHECK(54L, 20)) {
		nrf_power_task_trigger(NRF_POWER, NRF_POWER_TASK_CONSTLAT);
	}
#endif /* NRF_ERRATA_STATIC_CHECK(54L, 20) */

#if defined(NRF54LM20A_XXAA)
	/* MLTPAN-39 */
	nrf_clock_task_trigger(NRF_CLOCK, NRF_CLOCK_TASK_PLLSTART);
#endif /* defined(NRF54LM20A_XXAA) */
}

int main(void)
{
	sh = shell_backend_bm_uarte_get_ptr();
	const struct shell_backend_config_flags cfg_flags =
		SHELL_DEFAULT_BACKEND_CONFIG_FLAGS;

	shell_init(sh, NULL, cfg_flags, false, 0);
	shell_start(sh);

	shell_print(sh, "Starting Radio Test sample");

	clock_init();

	struct radio_test_config *radio_test_conf = radio_cmd_get_test_config();
	int err = radio_test_init(radio_test_conf);

	if (err) {
		shell_error(sh, "radio_test_init() failed: %d", err);
	}

	while (true) {
		/*
		 * Process all received data from the shell backend, calling registered command
		 * handlers like sample_terminate_cmd if the command and arguments match.
		 */
		shell_process(sh);

		/*
		 * Ensure no events are missed while we check if there is pending RX data to
		 * be processed.
		 */
		unsigned int key = irq_lock();

		radio_test_process_rx_timeout();

		if (shell_backend_bm_uarte_rx_ready()) {
			/* Process pending RX data */
			irq_unlock(key);
			continue;
		}

		/* Idle until next event */
		k_cpu_atomic_idle(key);
	}

	return 0;
}
```

## src/radio_test.h
```c
/*
 * Copyright (c) 2026 Nordic Semiconductor ASA
 *
 * SPDX-License-Identifier: LicenseRef-Nordic-5-Clause
 */

#ifndef RADIO_TEST_H_
#define RADIO_TEST_H_

#include <zephyr/types.h>
#include <hal/nrf_radio.h>

/** Maximum radio RX or TX payload. */
#define RADIO_MAX_PAYLOAD_LEN	256
/** IEEE 802.15.4 maximum payload length. */
#define IEEE_MAX_PAYLOAD_LEN	127
/** IEEE 802.15.4 minimum channel. */
#define IEEE_MIN_CHANNEL	11
/** IEEE 802.15.4 maximum channel. */
#define IEEE_MAX_CHANNEL	26

/** @brief Radio transmit and address pattern. */
enum transmit_pattern {
	/** Random pattern. */
	TRANSMIT_PATTERN_RANDOM,

	/** Pattern 11110000(F0). */
	TRANSMIT_PATTERN_11110000,

	/** Pattern 11001100(CC). */
	TRANSMIT_PATTERN_11001100,
};

/** @brief Radio test mode. */
enum radio_test_mode {
	/** TX carrier. */
	UNMODULATED_TX,

	/** Modulated TX carrier. */
	MODULATED_TX,

	/** RX carrier. */
	RX,

	/** TX carrier sweep. */
	TX_SWEEP,

	/** RX carrier sweep. */
	RX_SWEEP,

	/** Duty-cycled modulated TX carrier. */
	MODULATED_TX_DUTY_CYCLE,
};

/** @brief Radio test configuration. */
struct radio_test_config {
	/** Radio test type. */
	enum radio_test_mode type;

	/** Radio mode. Data rate and modulation. */
	nrf_radio_mode_t mode;

	union {
		/** @brief Configuration for the unmodulated TX mode. */
		struct {
			/** Radio output power. */
			int8_t txpower;

			/** Radio channel. */
			uint8_t channel;
		} unmodulated_tx;

		/** @brief Configuration for the modulated TX mode. */
		struct {
			/** Radio output power. */
			int8_t txpower;

			/** Radio transmission pattern. */
			enum transmit_pattern pattern;

			/** Radio channel. */
			uint8_t channel;

			/**
			 * Number of packets to transmit.
			 * Set to zero for continuous TX.
			 */
			uint32_t packets_num;

			/** Callback to indicate that TX is finished. */
			void (*cb)(void);
		} modulated_tx;

		/** @brief Configuration for the RX mode. */
		struct {
			/** Radio transmission pattern. */
			enum transmit_pattern pattern;

			/** Radio channel. */
			uint8_t channel;

			/**
			 * Number of packets to be received.
			 * Set to zero for continuous RX.
			 */
			uint32_t packets_num;

			/** Callback to indicate that RX is finished. */
			void (*cb)(void);
		} rx;

		/** @brief Configuration for the TX sweep mode. */
		struct {
			/** Radio output power. */
			int8_t txpower;

			/** Radio start channel (frequency). */
			uint8_t channel_start;

			/** Radio end channel (frequency). */
			uint8_t channel_end;

			/** Delay time in milliseconds. */
			uint32_t delay_ms;
		} tx_sweep;

		/** @brief Configuration for the RX sweep mode. */
		struct {
			/** Radio start channel (frequency). */
			uint8_t channel_start;

			/** Radio end channel (frequency). */
			uint8_t channel_end;

			/** Delay time in milliseconds. */
			uint32_t delay_ms;
		} rx_sweep;

		/** @brief Configuration for the modulated TX duty cycle mode. */
		struct {
			/** Radio output power. */
			int8_t txpower;

			/** Radio transmission pattern. */
			enum transmit_pattern pattern;

			/** Radio channel. */
			uint8_t channel;

			/** Duty cycle. */
			uint32_t duty_cycle;
		} modulated_tx_duty_cycle;
	} params;
};

/** @brief Radio RX statistics. */
struct radio_rx_stats {
	/** Content of the last packet. */
	struct {
		/** Content of the last packet. */
		uint8_t *buf;

		/** Length of the last packet. */
		size_t len;
	} last_packet;

	/** Number of received packets with valid CRC. */
	uint32_t packet_cnt;
};

/**
 * @brief Function for initializing the Radio Test module.
 *
 * @param[in] config  Radio test configuration.
 *
 * @retval 0 If the operation was successful.
 *           Otherwise, a (negative) error code is returned.
 */
int radio_test_init(struct radio_test_config *config);

/**
 * @brief Get pointer to the shell command's radio_test_config storage.
 *
 */
struct radio_test_config *radio_cmd_get_test_config(void);

/**
 * @brief Function for starting radio test.
 *
 * @param[in] config  Radio test configuration.
 */
void radio_test_start(const struct radio_test_config *config);

/**
 * @brief Function for stopping ongoing test (Radio and Timer operations).
 *
 * @param[in] type  Radio test mode.
 */
void radio_test_cancel(enum radio_test_mode type);

/**
 * @brief Function for get RX statistics.
 *
 * @param[out] rx_stats RX statistics.
 */
void radio_rx_stats_get(struct radio_rx_stats *rx_stats);

/**
 * @brief Function for toggling the DC/DC converter state.
 *
 * @param[in] dcdc_state  DC/DC converter state.
 */
void toggle_dcdc_state(uint8_t dcdc_state);

/**
 * @brief Process radio RX timeout.
 */
void radio_test_process_rx_timeout(void);

#endif /* RADIO_TEST_H_ */
```
