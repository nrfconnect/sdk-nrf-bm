## CMakeLists.txt
```
#
# Copyright (c) 2026 Nordic Semiconductor ASA
#
# SPDX-License-Identifier: LicenseRef-Nordic-5-Clause
#

cmake_minimum_required(VERSION 3.20.0)

find_package(Zephyr REQUIRED HINTS $ENV{ZEPHYR_BASE})
project(spi)

target_sources(app PRIVATE src/main.c)
```

## Kconfig
```
#
# Copyright (c) 2026 Nordic Semiconductor ASA
#
# SPDX-License-Identifier: LicenseRef-Nordic-5-Clause
#

menu "SPI sample"

config SAMPLE_SPI_MSG
	string "Message to send over SPI"
	default "Hello World!"
	help
	  The message that the SPI controller sends to the SPI target when the button is pressed.

config SAMPLE_SPI_RX_BUF_SIZE
	int "Size of the SPI target receive buffer in bytes"
	default 32
	help
	  Maximum number of bytes the SPI target can receive in a single transfer.

config SAMPLE_SPI_CSN_TO_CLK_DELAY
	int "Delay between chip select (CSN) and the first SCK edge, in SPIM core clock periods"
	range 0 255
	default 80
	help
	  An SPI target with a long wake-up time may sample data incorrectly if the SPI controller
	  starts clocking before the target is ready. Increasing this value gives the SPI target
	  more time to get ready before data is transferred.
	  A delay between CSN and first SCK edge is needed when using the SPIS peripheral on
	  devices such as the nRF54L, where the high-frequency clock is powered down during sleep
	  and needs time to start. No delay is needed if the SPIS core clock runs continuously.
	  Refer to IFTIMING.CSNDUR in the device specification.

module=SAMPLE_SPI
module-str=SPI Sample
source "$(ZEPHYR_BASE)/subsys/logging/Kconfig.template.log_config"

endmenu # "SPI sample"

source "Kconfig.zephyr"
```

## sample.yaml
```
sample:
  name: SPI Sample
tests:
  sample.spi:
    sysbuild: true
    build_only: true
    integration_platforms:
      - bm_nrf54l15dk/nrf54l15/cpuapp/s115_softdevice
    platform_allow:
      - bm_nrf54l15dk/nrf54l05/cpuapp/s115_softdevice
      - bm_nrf54l15dk/nrf54l05/cpuapp/s115_softdevice/mcuboot
      - bm_nrf54l15dk/nrf54l05/cpuapp/s145_softdevice
      - bm_nrf54l15dk/nrf54l05/cpuapp/s145_softdevice/mcuboot
      - bm_nrf54l15dk/nrf54l10/cpuapp/s115_softdevice
      - bm_nrf54l15dk/nrf54l10/cpuapp/s115_softdevice/mcuboot
      - bm_nrf54l15dk/nrf54l10/cpuapp/s145_softdevice
      - bm_nrf54l15dk/nrf54l10/cpuapp/s145_softdevice/mcuboot
      - bm_nrf54l15dk/nrf54l15/cpuapp/s115_softdevice
      - bm_nrf54l15dk/nrf54l15/cpuapp/s115_softdevice/mcuboot
      - bm_nrf54l15dk/nrf54l15/cpuapp/s145_softdevice
      - bm_nrf54l15dk/nrf54l15/cpuapp/s145_softdevice/mcuboot
      - bm_nrf54lc10dk/nrf54lc10a/cpuapp/s115_softdevice
      - bm_nrf54lc10dk/nrf54lc10a/cpuapp/s115_softdevice/mcuboot
      - bm_nrf54lc10dk/nrf54lc10a/cpuapp/s145_softdevice
      - bm_nrf54lc10dk/nrf54lc10a/cpuapp/s145_softdevice/mcuboot
      - bm_nrf54lm20dk/nrf54lm20a/cpuapp/s115_softdevice
      - bm_nrf54lm20dk/nrf54lm20a/cpuapp/s115_softdevice/mcuboot
      - bm_nrf54lm20dk/nrf54lm20a/cpuapp/s145_softdevice
      - bm_nrf54lm20dk/nrf54lm20a/cpuapp/s145_softdevice/mcuboot
      - bm_nrf54ls05dk/nrf54ls05b/cpuapp/s115_softdevice
      - bm_nrf54ls05dk/nrf54ls05b/cpuapp/s115_softdevice/mcuboot
      - bm_nrf54ls05dk/nrf54ls05b/cpuapp/s145_softdevice
      - bm_nrf54ls05dk/nrf54ls05b/cpuapp/s145_softdevice/mcuboot
      - bm_nrf54lv10dk/nrf54lv10a/cpuapp/s115_softdevice
      - bm_nrf54lv10dk/nrf54lv10a/cpuapp/s115_softdevice/mcuboot
      - bm_nrf54lv10dk/nrf54lv10a/cpuapp/s145_softdevice
      - bm_nrf54lv10dk/nrf54lv10a/cpuapp/s145_softdevice/mcuboot
    tags: ci_build
```

## prj.conf
```kconfig
# Logging
CONFIG_LOG=y
CONFIG_LOG_BACKEND_BM_UARTE=y

# Enabling SoftDevice is not strictly needed, though we are building with SoftDevice boards.
CONFIG_SOFTDEVICE=y

# Clock control
CONFIG_CLOCK_CONTROL=y

# Button and timer
CONFIG_BM_BUTTONS=y
CONFIG_BM_GPIOTE=y
CONFIG_BM_TIMER=y

# SPI libraries
CONFIG_NRFX_SPIM=y
CONFIG_NRFX_SPIS=y
```

## src/main.c
```c
/*
 * Copyright (c) 2026 Nordic Semiconductor ASA
 *
 * SPDX-License-Identifier: LicenseRef-Nordic-5-Clause
 */

#include <zephyr/kernel.h>
#include <zephyr/logging/log.h>
#include <zephyr/logging/log_ctrl.h>

#include <bm/bm_buttons.h>
#include <bm/bm_irq.h>
#include <hal/nrf_gpio.h>
#include <board-config.h>
#include <nrfx_spim.h>
#include <nrfx_spis.h>

LOG_MODULE_REGISTER(sample, CONFIG_SAMPLE_SPI_LOG_LEVEL);

static nrfx_spim_t spim_inst = NRFX_SPIM_INSTANCE(BOARD_APP_SPIM_INST);
static nrfx_spis_t spis_inst = NRFX_SPIS_INSTANCE(BOARD_APP_SPIS_INST);

static uint8_t tx_buf[] = CONFIG_SAMPLE_SPI_MSG;
static uint8_t rx_buf[CONFIG_SAMPLE_SPI_RX_BUF_SIZE];

static void spim_handler(nrfx_spim_event_t const *event, void *context)
{
	if (event->type == NRFX_SPIM_EVENT_DONE) {
		LOG_INF("Message sent: \"%s\"", tx_buf);
	}
}

static void spis_handler(nrfx_spis_event_t const *event, void *context)
{
	if (event->evt_type == NRFX_SPIS_XFER_DONE) {
		LOG_INF("Message received (%u bytes): \"%.*s\"",
			event->rx_amount, event->rx_amount, rx_buf);
		nrf_gpio_pin_toggle(BOARD_PIN_LED_2);

		nrfx_spis_buffers_set(&spis_inst, NULL, 0, rx_buf, sizeof(rx_buf));
	}
}

ISR_DIRECT_DECLARE(spim_isr_handler)
{
	nrfx_spim_irq_handler(&spim_inst);
	return 0;
}

ISR_DIRECT_DECLARE(spis_isr_handler)
{
	nrfx_spis_irq_handler(&spis_inst);
	return 0;
}

static void button_handler(uint8_t pin, uint8_t action)
{
	if (pin == BOARD_PIN_BTN_2 && action == BM_BUTTONS_PRESS) {
		nrfx_spim_xfer_desc_t xfer = NRFX_SPIM_XFER_TX(tx_buf, sizeof(tx_buf));

		nrfx_spim_xfer(&spim_inst, &xfer, 0);
	}
}

int main(void)
{
	int err;
	nrfx_spim_config_t spim_config = NRFX_SPIM_DEFAULT_CONFIG(BOARD_APP_SPIM_PIN_SCK,
								  BOARD_APP_SPIM_PIN_MOSI,
								  BOARD_APP_SPIM_PIN_MISO,
								  BOARD_APP_SPIM_PIN_CSN);
	nrfx_spis_config_t spis_config = NRFX_SPIS_DEFAULT_CONFIG(BOARD_APP_SPIS_PIN_SCK,
								  BOARD_APP_SPIS_PIN_MOSI,
								  BOARD_APP_SPIS_PIN_MISO,
								  BOARD_APP_SPIS_PIN_CSN);
	struct bm_buttons_config btn_configs[] = {
		{
			.pin_number = BOARD_PIN_BTN_2,
			.active_state = BM_BUTTONS_ACTIVE_LOW,
			.pull_config = BM_BUTTONS_PIN_PULLUP,
			.handler = button_handler,
		},
	};

	LOG_INF("SPI sample started");

	nrf_gpio_cfg_output(BOARD_PIN_LED_0);
	nrf_gpio_cfg_output(BOARD_PIN_LED_2);
	nrf_gpio_pin_write(BOARD_PIN_LED_0, !BOARD_LED_ACTIVE_STATE);
	nrf_gpio_pin_write(BOARD_PIN_LED_2, !BOARD_LED_ACTIVE_STATE);

	err = bm_buttons_init(btn_configs, ARRAY_SIZE(btn_configs),
			      BM_BUTTONS_DETECTION_DELAY_MIN_US);
	if (err) {
		LOG_ERR("Buttons init failed, err %d", err);
		goto idle;
	}

	BM_IRQ_DIRECT_CONNECT(NRFX_IRQ_NUMBER_GET(BOARD_APP_SPIM_INST), IRQ_PRIO_LOWEST,
			      spim_isr_handler, 0);
	irq_enable(NRFX_IRQ_NUMBER_GET(BOARD_APP_SPIM_INST));
	BM_IRQ_DIRECT_CONNECT(NRFX_IRQ_NUMBER_GET(BOARD_APP_SPIS_INST), IRQ_PRIO_LOWEST,
			      spis_isr_handler, 0);
	irq_enable(NRFX_IRQ_NUMBER_GET(BOARD_APP_SPIS_INST));

	err = nrfx_spim_init(&spim_inst, &spim_config, spim_handler, NULL);
	if (err) {
		LOG_ERR("SPIM init failed, err %d", err);
		goto idle;
	}

	/* Set delay from chip select going active to the first SCK edge.
	 * A larger value allows for a longer wakeup time on the SPI target device.
	 */
	spim_inst.p_reg->IFTIMING.CSNDUR = CONFIG_SAMPLE_SPI_CSN_TO_CLK_DELAY;

	err = nrfx_spis_init(&spis_inst, &spis_config, spis_handler, NULL);
	if (err) {
		LOG_ERR("SPIS init failed, err %d", err);
		goto idle;
	}

	err = nrfx_spis_buffers_set(&spis_inst, NULL, 0, rx_buf, sizeof(rx_buf));
	if (err) {
		LOG_ERR("SPIS buffers set failed, err %d", err);
		goto idle;
	}

	err = bm_buttons_enable();
	if (err) {
		LOG_ERR("Buttons enable failed, err %d", err);
		goto idle;
	}

	nrf_gpio_pin_write(BOARD_PIN_LED_0, BOARD_LED_ACTIVE_STATE);
	LOG_INF("SPI sample initialized");

	/* User info on startup */
	LOG_INF("Press Button 2 to send \"%s\" over SPI", tx_buf);
	LOG_INF("Waiting for SPI controller to send data...");

idle:
	while (true) {
		log_flush();

		k_cpu_idle();
	}

	return 0;
}
```
