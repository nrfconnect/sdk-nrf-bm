## CMakeLists.txt
```
#
# Copyright (c) 2025 Nordic Semiconductor ASA
#
# SPDX-License-Identifier: LicenseRef-Nordic-5-Clause
#

cmake_minimum_required(VERSION 3.20.0)

find_package(Zephyr REQUIRED HINTS $ENV{ZEPHYR_BASE})

project(test_ble_dis)

set(SOFTDEVICE_VARIANT "s115")
set(SOFTDEVICE_INCLUDE_DIR "${ZEPHYR_NRF_BM_MODULE_DIR}/components/softdevice/\
${SOFTDEVICE_VARIANT}/${SOFTDEVICE_VARIANT}_API/include")

cmock_handle(${SOFTDEVICE_INCLUDE_DIR}/ble_gatts.h)

zephyr_compile_definitions(
  NRF54L15_XXAA
  SVCALL_AS_NORMAL_FUNCTION
  SUPPRESS_INLINE_IMPLEMENTATION
)

zephyr_include_directories(
  ${ZEPHYR_NRF_BM_MODULE_DIR}/include
  ${SOFTDEVICE_INCLUDE_DIR}
)

# Generate and add test file
test_runner_generate(src/unity_test.c)
target_sources(app PRIVATE src/unity_test.c)
```

## prj.conf
```kconfig
#
# Copyright (c) 2025 Nordic Semiconductor ASA
#
# SPDX-License-Identifier: LicenseRef-Nordic-5-Clause
#
CONFIG_UNITY=y

CONFIG_BLE_DIS_MANUFACTURER_NAME="Manufacturer"
CONFIG_BLE_DIS_MODEL_NUMBER="Model"
CONFIG_BLE_DIS_SERIAL_NUMBER="Serial"
CONFIG_BLE_DIS_HW_REVISION="HWrev"
CONFIG_BLE_DIS_FW_REVISION="FWrev"
CONFIG_BLE_DIS_SW_REVISION="SWrev"
CONFIG_BLE_DIS_SYSTEM_ID=y
CONFIG_BLE_DIS_SYSTEM_ID_OUI=0x010203
CONFIG_BLE_DIS_SYSTEM_ID_MID=0x1112131415
CONFIG_BLE_DIS_PNP_ID=y
CONFIG_BLE_DIS_PNP_VID_SRC=0x01
CONFIG_BLE_DIS_PNP_VID=0x0203
CONFIG_BLE_DIS_PNP_PID=0x0405
CONFIG_BLE_DIS_PNP_VER=0x0607
CONFIG_BLE_DIS_REGULATORY_CERT=y
CONFIG_BLE_DIS_REGULATORY_CERT_LIST=0x0102030405060708
```

## src/unity_test.c
```c
/*
 * Copyright (c) 2025 Nordic Semiconductor ASA
 *
 * SPDX-License-Identifier: LicenseRef-Nordic-5-Clause
 */
#include <errno.h>
#include <unity.h>
#include <stdint.h>
#include <string.h>
#include <stdbool.h>

#include <bm/bluetooth/services/ble_dis.h>
#include <bm/bluetooth/services/uuid.h>
#include <nrf_error.h>

#include "cmock_ble_gatts.h"

#define HANDLE 0xa4

struct ble_dis_config dis_config = {
		.sec_mode = BLE_DIS_CONFIG_SEC_MODE_DEFAULT,
};

uint32_t stub_sd_ble_gatts_service_add_invalid_param(uint8_t type, ble_uuid_t const *p_uuid,
						     uint16_t *p_handle, int cmock_num_calls)
{
	return NRF_ERROR_INVALID_PARAM;
}

uint32_t stub_sd_ble_gatts_service_add(uint8_t type, ble_uuid_t const *p_uuid, uint16_t *p_handle,
				       int cmock_num_calls)
{
	TEST_ASSERT_EQUAL(BLE_GATTS_SRVC_TYPE_PRIMARY, type);
	TEST_ASSERT_EQUAL(BLE_UUID_TYPE_BLE, p_uuid->type);
	TEST_ASSERT_EQUAL(BLE_UUID_DEVICE_INFORMATION_SERVICE, p_uuid->uuid);

	*p_handle = HANDLE;

	return NRF_SUCCESS;
}

uint32_t stub_sd_ble_gatts_characteristic_add_invalid_param(
	uint16_t service_handle, ble_gatts_char_md_t const *p_char_md,
	ble_gatts_attr_t const *p_attr_char_value, ble_gatts_char_handles_t *p_handles,
	int cmock_num_calls)
{
	return NRF_ERROR_INVALID_PARAM;
}

uint32_t stub_sd_ble_gatts_characteristic_add(
	uint16_t service_handle, ble_gatts_char_md_t const *p_char_md,
	ble_gatts_attr_t const *p_attr_char_value, ble_gatts_char_handles_t *p_handles,
	int cmock_num_calls)
{
	ble_gatts_char_md_t char_md_expected = {
		.char_props = {
			.read = true,
		},
	};
	ble_gatts_char_handles_t char_handles_expected = {0};
	uint8_t sys_id_expected[8] = {0x15, 0x14, 0x13, 0x12, 0x11, 0x03, 0x02, 0x01};
	uint8_t pnp_id_expected[7] = {0x01, 0x03, 0x02, 0x05, 0x04, 0x07, 0x06};
	uint8_t regulatory_certifications_expected[8] = {0x08, 0x07, 0x06, 0x05,
							 0x04, 0x03, 0x02, 0x01};

	TEST_ASSERT_EQUAL(HANDLE, service_handle);

	TEST_ASSERT_EQUAL_MEMORY(&char_md_expected, p_char_md, sizeof(ble_gatts_char_md_t));
	TEST_ASSERT_EQUAL_MEMORY(&char_handles_expected, p_handles,
				 sizeof(ble_gatts_char_handles_t));

	switch (cmock_num_calls) {
	case 0:
		TEST_ASSERT_EQUAL(BLE_UUID_TYPE_BLE, p_attr_char_value->p_uuid->type);
		TEST_ASSERT_EQUAL(BLE_UUID_MANUFACTURER_NAME_STRING_CHAR,
				  p_attr_char_value->p_uuid->uuid);
		TEST_ASSERT_EQUAL_STRING("Manufacturer", p_attr_char_value->p_value);
		TEST_ASSERT_EQUAL(12, p_attr_char_value->max_len);
		TEST_ASSERT_EQUAL(12, p_attr_char_value->init_len);
		break;
	case 1:
		TEST_ASSERT_EQUAL(BLE_UUID_TYPE_BLE, p_attr_char_value->p_uuid->type);
		TEST_ASSERT_EQUAL(BLE_UUID_MODEL_NUMBER_STRING_CHAR,
				  p_attr_char_value->p_uuid->uuid);
		TEST_ASSERT_EQUAL_STRING("Model", p_attr_char_value->p_value);
		TEST_ASSERT_EQUAL(5, p_attr_char_value->max_len);
		TEST_ASSERT_EQUAL(5, p_attr_char_value->init_len);
		break;
	case 2:
		TEST_ASSERT_EQUAL(BLE_UUID_TYPE_BLE, p_attr_char_value->p_uuid->type);
		TEST_ASSERT_EQUAL(BLE_UUID_SERIAL_NUMBER_STRING_CHAR,
				  p_attr_char_value->p_uuid->uuid);
		TEST_ASSERT_EQUAL_STRING("Serial", p_attr_char_value->p_value);
		TEST_ASSERT_EQUAL(6, p_attr_char_value->max_len);
		TEST_ASSERT_EQUAL(6, p_attr_char_value->init_len);
		break;
	case 3:
		TEST_ASSERT_EQUAL(BLE_UUID_TYPE_BLE, p_attr_char_value->p_uuid->type);
		TEST_ASSERT_EQUAL(BLE_UUID_HARDWARE_REVISION_STRING_CHAR,
				  p_attr_char_value->p_uuid->uuid);
		TEST_ASSERT_EQUAL_STRING("HWrev", p_attr_char_value->p_value);
		TEST_ASSERT_EQUAL(5, p_attr_char_value->max_len);
		TEST_ASSERT_EQUAL(5, p_attr_char_value->init_len);
		break;
	case 4:
		TEST_ASSERT_EQUAL(BLE_UUID_TYPE_BLE, p_attr_char_value->p_uuid->type);
		TEST_ASSERT_EQUAL(BLE_UUID_FIRMWARE_REVISION_STRING_CHAR,
				  p_attr_char_value->p_uuid->uuid);
		TEST_ASSERT_EQUAL_STRING("FWrev", p_attr_char_value->p_value);
		TEST_ASSERT_EQUAL(5, p_attr_char_value->max_len);
		TEST_ASSERT_EQUAL(5, p_attr_char_value->init_len);
		break;
	case 5:
		TEST_ASSERT_EQUAL(BLE_UUID_TYPE_BLE, p_attr_char_value->p_uuid->type);
		TEST_ASSERT_EQUAL(BLE_UUID_SOFTWARE_REVISION_STRING_CHAR,
				  p_attr_char_value->p_uuid->uuid);
		TEST_ASSERT_EQUAL_STRING("SWrev", p_attr_char_value->p_value);
		TEST_ASSERT_EQUAL(5, p_attr_char_value->max_len);
		TEST_ASSERT_EQUAL(5, p_attr_char_value->init_len);
		break;
	case 6:
		TEST_ASSERT_EQUAL(BLE_UUID_TYPE_BLE, p_attr_char_value->p_uuid->type);
		TEST_ASSERT_EQUAL(BLE_UUID_SYSTEM_ID_CHAR, p_attr_char_value->p_uuid->uuid);
		TEST_ASSERT_EQUAL_MEMORY(sys_id_expected, p_attr_char_value->p_value,
					 sizeof(sys_id_expected));
		TEST_ASSERT_EQUAL(8, p_attr_char_value->max_len);
		TEST_ASSERT_EQUAL(8, p_attr_char_value->init_len);
		break;
	case 7:
		TEST_ASSERT_EQUAL(BLE_UUID_TYPE_BLE, p_attr_char_value->p_uuid->type);
		TEST_ASSERT_EQUAL(BLE_UUID_PNP_ID_CHAR, p_attr_char_value->p_uuid->uuid);
		TEST_ASSERT_EQUAL_MEMORY(pnp_id_expected, p_attr_char_value->p_value,
					 sizeof(pnp_id_expected));
		TEST_ASSERT_EQUAL(7, p_attr_char_value->max_len);
		TEST_ASSERT_EQUAL(7, p_attr_char_value->init_len);
		break;
	case 8:
		TEST_ASSERT_EQUAL(BLE_UUID_TYPE_BLE, p_attr_char_value->p_uuid->type);
		TEST_ASSERT_EQUAL(BLE_UUID_IEEE_REGULATORY_CERTIFICATION_DATA_LIST_CHAR,
				  p_attr_char_value->p_uuid->uuid);
		TEST_ASSERT_EQUAL_MEMORY(regulatory_certifications_expected,
					 p_attr_char_value->p_value,
					 sizeof(regulatory_certifications_expected));
		TEST_ASSERT_EQUAL(8, p_attr_char_value->max_len);
		TEST_ASSERT_EQUAL(8, p_attr_char_value->init_len);
		break;
	default:
		TEST_ASSERT_TRUE_MESSAGE(false, "Unreachable");
		break;
	}

	return NRF_SUCCESS;
}

void test_ble_dis_init_error_null(void)
{
	uint32_t nrf_err;

	nrf_err = ble_dis_init(NULL);
	TEST_ASSERT_EQUAL(NRF_ERROR_NULL, nrf_err);
}

void test_ble_dis_init_error_invalid_param(void)
{
	uint32_t nrf_err;

	__cmock_sd_ble_gatts_service_add_Stub(stub_sd_ble_gatts_service_add_invalid_param);

	nrf_err = ble_dis_init(&dis_config);
	TEST_ASSERT_EQUAL(NRF_ERROR_INVALID_PARAM, nrf_err);

	__cmock_sd_ble_gatts_service_add_Stub(stub_sd_ble_gatts_service_add);
	__cmock_sd_ble_gatts_characteristic_add_Stub(
		stub_sd_ble_gatts_characteristic_add_invalid_param);

	nrf_err = ble_dis_init(&dis_config);
	TEST_ASSERT_EQUAL(NRF_ERROR_INVALID_PARAM, nrf_err);
}

void test_ble_dis_init(void)
{
	uint32_t nrf_err;

	__cmock_sd_ble_gatts_service_add_Stub(stub_sd_ble_gatts_service_add);
	__cmock_sd_ble_gatts_characteristic_add_Stub(stub_sd_ble_gatts_characteristic_add);

	nrf_err = ble_dis_init(&dis_config);
	TEST_ASSERT_EQUAL(NRF_SUCCESS, nrf_err);
}

extern int unity_main(void);

int main(void)
{
	return unity_main();
}
```
