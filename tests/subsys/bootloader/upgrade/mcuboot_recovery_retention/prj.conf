## CMakeLists.txt
```
#
# Copyright (c) 2026 Nordic Semiconductor ASA
#
# SPDX-License-Identifier: LicenseRef-Nordic-5-Clause
#

cmake_minimum_required(VERSION 3.20.0)
find_package(Zephyr REQUIRED HINTS $ENV{ZEPHYR_BASE})
project(test_mcuboot_recovery_retention)

if(NOT SYSBUILD)
  message(FATAL_ERROR "This must be built with sysbuild.")
endif()

if(NOT CONFIG_MCUBOOT_BOOTLOADER_MODE_FIRMWARE_UPDATER)
  message(FATAL_ERROR "Invalid MCUboot mode selected.")
endif()

target_sources(app PRIVATE src/main.c)
```

## Kconfig
```
#
# Copyright (c) 2026 Nordic Semiconductor ASA
#
# SPDX-License-Identifier: LicenseRef-Nordic-5-Clause
#

menu "MCUboot recovery retention test"

module=TEST
module-str=MCUboot recovery retention
source "$(ZEPHYR_BASE)/subsys/logging/Kconfig.template.log_config"

endmenu # "MCUboot recovery retention test"

source "Kconfig.zephyr"
```

## prj.conf
```kconfig
#
# Copyright (c) 2026 Nordic Semiconductor ASA
#
# SPDX-License-Identifier: LicenseRef-Nordic-5-Clause
#
CONFIG_RETAINED_MEM=y
CONFIG_RETENTION=y
CONFIG_RETENTION_BOOT_MODE=y
CONFIG_REBOOT=y
CONFIG_LOG=y
CONFIG_LOG_MODE_MINIMAL=y

# Enabling SoftDevice is not strictly needed, though we are building with SoftDevice boards.
CONFIG_SOFTDEVICE=y
```

## src/main.c
```c
/*
 * Copyright (c) 2026 Nordic Semiconductor ASA
 *
 * SPDX-License-Identifier: LicenseRef-Nordic-5-Clause
 */

#include <stdint.h>
#include <zephyr/kernel.h>
#include <zephyr/sys/reboot.h>
#include <zephyr/retention/bootmode.h>
#include <zephyr/logging/log.h>

LOG_MODULE_REGISTER(test, CONFIG_TEST_LOG_LEVEL);

int main(void)
{
	int rc;

	LOG_INF("Waiting...");
	k_sleep(K_SECONDS(3));

	rc = bootmode_set(BOOT_MODE_TYPE_BOOTLOADER);
	LOG_INF("Boot mode set to bootloader");

	if (rc == 0) {
		sys_reboot(SYS_REBOOT_WARM);
	} else {
		LOG_INF("Failed to set boot mode, rc %d", rc);
	}

	return 0;
}
```
