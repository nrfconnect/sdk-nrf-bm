## tests/subsys/kmu/hello_for_kmu/testcase.yaml
```yaml
tests:
  mcuboot.kmu.west.provision.basic:
    integration_platforms:
      - bm_nrf54l15dk/nrf54l05/cpuapp/s115_softdevice/mcuboot
      - bm_nrf54l15dk/nrf54l10/cpuapp/s115_softdevice/mcuboot
      - bm_nrf54l15dk/nrf54l15/cpuapp/s115_softdevice/mcuboot
    platform_allow:
      - bm_nrf54l15dk/nrf54l05/cpuapp/s115_softdevice/mcuboot
      - bm_nrf54l15dk/nrf54l10/cpuapp/s115_softdevice/mcuboot
      - bm_nrf54l15dk/nrf54l15/cpuapp/s115_softdevice/mcuboot
    tags:
      - kmu
    harness: console
    harness_config:
      type: one_line
      regex:
        - "Hello World! (.*)"
    extra_args:
      - SB_CONFIG_BM_BOOTLOADER_MCUBOOT_GENERATE_DEFAULT_KMU_KEYFILE=y
  mcuboot.kmu.west.provision.manual_upload_key:
    integration_platforms:
      - bm_nrf54l15dk/nrf54l05/cpuapp/s115_softdevice/mcuboot
      - bm_nrf54l15dk/nrf54l10/cpuapp/s115_softdevice/mcuboot
      - bm_nrf54l15dk/nrf54l15/cpuapp/s115_softdevice/mcuboot
    platform_allow:
      - bm_nrf54l15dk/nrf54l05/cpuapp/s115_softdevice/mcuboot
      - bm_nrf54l15dk/nrf54l10/cpuapp/s115_softdevice/mcuboot
      - bm_nrf54l15dk/nrf54l15/cpuapp/s115_softdevice/mcuboot
    tags:
      - pytest
      - kmu
    harness: pytest
    harness_config:
      pytest_root:
        - "../pytest/test_kmu_basic.py"
    extra_args:
      - SB_CONFIG_BM_BOOTLOADER_MCUBOOT_GENERATE_DEFAULT_KMU_KEYFILE=n
  mcuboot.kmu.west.provision.key_revocation:
    integration_platforms:
      - bm_nrf54l15dk/nrf54l05/cpuapp/s115_softdevice/mcuboot
      - bm_nrf54l15dk/nrf54l10/cpuapp/s115_softdevice/mcuboot
      - bm_nrf54l15dk/nrf54l15/cpuapp/s115_softdevice/mcuboot
    platform_allow:
      - bm_nrf54l15dk/nrf54l05/cpuapp/s115_softdevice/mcuboot
      - bm_nrf54l15dk/nrf54l10/cpuapp/s115_softdevice/mcuboot
      - bm_nrf54l15dk/nrf54l15/cpuapp/s115_softdevice/mcuboot
    tags:
      - pytest
      - kmu
    timeout: 180
    harness: pytest
    harness_config:
      pytest_root:
        - "../pytest/test_kmu_key_revocation.py::test_if_kmu_keys_revocation_with_three_slots"
        - "../pytest/test_kmu_key_revocation.py::test_if_previous_key_is_revoked_when_flashing_new_image"
        - "../pytest/test_kmu_key_revocation.py::test_if_revocation_of_last_remaining_key_is_not_allowed"
    extra_args:
      - SB_CONFIG_BM_BOOTLOADER_MCUBOOT_GENERATE_DEFAULT_KMU_KEYFILE=n
      - mcuboot_CONFIG_BOOT_KEYS_REVOCATION=y
      - mcuboot_CONFIG_LTO=n
      - mcuboot_CONFIG_BOOT_SIGNATURE_KMU_SLOTS=3
  mcuboot.kmu.west.provision.key_revocation_with_two_slots:
    integration_platforms:
      - bm_nrf54l15dk/nrf54l05/cpuapp/s115_softdevice/mcuboot
      - bm_nrf54l15dk/nrf54l10/cpuapp/s115_softdevice/mcuboot
      - bm_nrf54l15dk/nrf54l15/cpuapp/s115_softdevice/mcuboot
    platform_allow:
      - bm_nrf54l15dk/nrf54l05/cpuapp/s115_softdevice/mcuboot
      - bm_nrf54l15dk/nrf54l10/cpuapp/s115_softdevice/mcuboot
      - bm_nrf54l15dk/nrf54l15/cpuapp/s115_softdevice/mcuboot
    tags:
      - pytest
      - kmu
    timeout: 180
    harness: pytest
    harness_config:
      pytest_root:
        - "../pytest/test_kmu_key_revocation.py::test_if_kmu_keys_revocation_with_two_slots"
        - "../pytest/test_kmu_key_revocation.py::test_if_kmu_keys_revocation_with_two_slots_third_key_valid"
    extra_args:
      - SB_CONFIG_BM_BOOTLOADER_MCUBOOT_GENERATE_DEFAULT_KMU_KEYFILE=n
      - mcuboot_CONFIG_BOOT_KEYS_REVOCATION=y
      - mcuboot_CONFIG_LTO=n
      - mcuboot_CONFIG_BOOT_SIGNATURE_KMU_SLOTS=2
```

## tests/subsys/storage/bm_rmem/testcase.yaml
```yaml
common:
  tags: bm_rmem
  platform_allow:
    - bm_nrf54l15dk/nrf54l15/cpuapp/s115_softdevice
    - bm_nrf54l15dk/nrf54l05/cpuapp/s115_softdevice
    - native_sim
  integration_platforms:
    - bm_nrf54l15dk/nrf54l15/cpuapp/s115_softdevice
    - native_sim
tests:
  tests.subsys.storage.bm_rmem:
    tags:
      - storage
      - bm_rmem
```

## tests/unit/lib/bluetooth/ble_adv/testcase.yaml
```yaml
common:
  sysbuild: false
  platform_allow: native_sim
  tags: unittest
tests:
  lib.ble_adv.mode_none: {}
  lib.ble_adv.mode_slow:
    extra_configs:
      - CONFIG_BLE_ADV_SLOW_ADVERTISING=y
  lib.ble_adv.mode_fast:
    extra_configs:
      - CONFIG_BLE_ADV_FAST_ADVERTISING=y
  lib.ble_adv.mode_fast_slow:
    extra_configs:
      - CONFIG_BLE_ADV_FAST_ADVERTISING=y
      - CONFIG_BLE_ADV_SLOW_ADVERTISING=y
  lib.ble_adv.mode_directed:
    extra_configs:
      - CONFIG_BLE_ADV_DIRECTED_ADVERTISING=y
  lib.ble_adv.mode_directed_slow:
    extra_configs:
      - CONFIG_BLE_ADV_DIRECTED_ADVERTISING=y
      - CONFIG_BLE_ADV_SLOW_ADVERTISING=y
  lib.ble_adv.mode_directed_fast:
    extra_configs:
      - CONFIG_BLE_ADV_DIRECTED_ADVERTISING=y
      - CONFIG_BLE_ADV_FAST_ADVERTISING=y
  lib.ble_adv.mode_directed_fast_slow:
    extra_configs:
      - CONFIG_BLE_ADV_DIRECTED_ADVERTISING=y
      - CONFIG_BLE_ADV_FAST_ADVERTISING=y
      - CONFIG_BLE_ADV_SLOW_ADVERTISING=y
  lib.ble_adv.mode_dhd_directed:
    extra_configs:
      - CONFIG_BLE_ADV_DIRECTED_ADVERTISING_HIGH_DUTY=y
      - CONFIG_BLE_ADV_DIRECTED_ADVERTISING=y
  lib.ble_adv.mode_dhd_directed_slow:
    extra_configs:
      - CONFIG_BLE_ADV_DIRECTED_ADVERTISING_HIGH_DUTY=y
      - CONFIG_BLE_ADV_DIRECTED_ADVERTISING=y
      - CONFIG_BLE_ADV_SLOW_ADVERTISING=y
  lib.ble_adv.mode_dhd_directed_fast:
    extra_configs:
      - CONFIG_BLE_ADV_DIRECTED_ADVERTISING_HIGH_DUTY=y
      - CONFIG_BLE_ADV_DIRECTED_ADVERTISING=y
      - CONFIG_BLE_ADV_FAST_ADVERTISING=y
  lib.ble_adv.mode_dhd_directed_fast_slow:
    extra_configs:
      - CONFIG_BLE_ADV_DIRECTED_ADVERTISING_HIGH_DUTY=y
      - CONFIG_BLE_ADV_DIRECTED_ADVERTISING=y
      - CONFIG_BLE_ADV_FAST_ADVERTISING=y
      - CONFIG_BLE_ADV_SLOW_ADVERTISING=y

  lib.ble_adv.use_allow_list_mode_none:
    extra_configs:
      - CONFIG_BLE_ADV_USE_ALLOW_LIST=y
  lib.ble_adv.use_allow_list_mode_slow:
    extra_configs:
      - CONFIG_BLE_ADV_USE_ALLOW_LIST=y
      - CONFIG_BLE_ADV_SLOW_ADVERTISING=y
  lib.ble_adv.use_allow_list_mode_fast:
    extra_configs:
      - CONFIG_BLE_ADV_USE_ALLOW_LIST=y
      - CONFIG_BLE_ADV_FAST_ADVERTISING=y
  lib.ble_adv.use_allow_list_mode_fast_slow:
    extra_configs:
      - CONFIG_BLE_ADV_USE_ALLOW_LIST=y
      - CONFIG_BLE_ADV_FAST_ADVERTISING=y
      - CONFIG_BLE_ADV_SLOW_ADVERTISING=y
  lib.ble_adv.use_allow_list_mode_directed:
    extra_configs:
      - CONFIG_BLE_ADV_USE_ALLOW_LIST=y
      - CONFIG_BLE_ADV_DIRECTED_ADVERTISING=y
  lib.ble_adv.use_allow_list_mode_directed_slow:
    extra_configs:
      - CONFIG_BLE_ADV_USE_ALLOW_LIST=y
      - CONFIG_BLE_ADV_DIRECTED_ADVERTISING=y
      - CONFIG_BLE_ADV_SLOW_ADVERTISING=y
  lib.ble_adv.use_allow_list_mode_directed_fast:
    extra_configs:
      - CONFIG_BLE_ADV_USE_ALLOW_LIST=y
      - CONFIG_BLE_ADV_DIRECTED_ADVERTISING=y
      - CONFIG_BLE_ADV_FAST_ADVERTISING=y
  lib.ble_adv.use_allow_list_mode_directed_fast_slow:
    extra_configs:
      - CONFIG_BLE_ADV_USE_ALLOW_LIST=y
      - CONFIG_BLE_ADV_DIRECTED_ADVERTISING=y
      - CONFIG_BLE_ADV_FAST_ADVERTISING=y
      - CONFIG_BLE_ADV_SLOW_ADVERTISING=y
  lib.ble_adv.use_allow_list_mode_dhd_directed:
    extra_configs:
      - CONFIG_BLE_ADV_USE_ALLOW_LIST=y
      - CONFIG_BLE_ADV_DIRECTED_ADVERTISING_HIGH_DUTY=y
      - CONFIG_BLE_ADV_DIRECTED_ADVERTISING=y
  lib.ble_adv.use_allow_list_mode_dhd_directed_slow:
    extra_configs:
      - CONFIG_BLE_ADV_USE_ALLOW_LIST=y
      - CONFIG_BLE_ADV_DIRECTED_ADVERTISING_HIGH_DUTY=y
      - CONFIG_BLE_ADV_DIRECTED_ADVERTISING=y
      - CONFIG_BLE_ADV_SLOW_ADVERTISING=y
  lib.ble_adv.use_allow_list_mode_dhd_directed_fast:
    extra_configs:
      - CONFIG_BLE_ADV_USE_ALLOW_LIST=y
      - CONFIG_BLE_ADV_DIRECTED_ADVERTISING_HIGH_DUTY=y
      - CONFIG_BLE_ADV_DIRECTED_ADVERTISING=y
      - CONFIG_BLE_ADV_FAST_ADVERTISING=y
  lib.ble_adv.use_allow_list_mode_dhd_directed_fast_slow:
    extra_configs:
      - CONFIG_BLE_ADV_USE_ALLOW_LIST=y
      - CONFIG_BLE_ADV_DIRECTED_ADVERTISING_HIGH_DUTY=y
      - CONFIG_BLE_ADV_DIRECTED_ADVERTISING=y
      - CONFIG_BLE_ADV_FAST_ADVERTISING=y
      - CONFIG_BLE_ADV_SLOW_ADVERTISING=y
```

## tests/unit/lib/bluetooth/ble_adv_data/testcase.yaml
```yaml
common:
  sysbuild: false
  platform_allow: native_sim
  tags: unittest
tests:
  lib.ble_adv_data: {}
```

## tests/unit/lib/bluetooth/ble_db_discovery/testcase.yaml
```yaml
tests:
  lib.ble_db_discovery:
    platform_allow: native_sim
    tags: unittest
```

## tests/unit/lib/bluetooth/ble_racp/Kconfig
```kconfig
# Redefine this symbol without dependencies, so that tests
# can enable it without having to enable the dependencies too.
config BLE_RACP
	default y

source "Kconfig.zephyr"
```

## tests/unit/lib/bluetooth/nrf_ble_lesc/Kconfig
```kconfig
# Redefine these symbols without dependencies, so that tests
# can enable them without having to enable the dependencies too.
config PM_LESC
	default y

# Redefine Kconfigs used by the tested module that are defined in
# other modules we do not want to enable.
config NRF_SDH_BLE_TOTAL_LINK_COUNT
	default 2

source "Kconfig.zephyr"
```

## tests/unit/subsys/bluetooth/services/ble_bas/Kconfig
```kconfig
# Redefine this symbol without dependencies, so that tests
# can enable it without having to enable the dependencies too.
config BLE_BAS
	default y

# Redefine Kconfigs used by the tested module that are defined in
# other modules we do not want to enable.
config NRF_SDH_BLE_TOTAL_LINK_COUNT
	default 1

source "Kconfig.zephyr"
```

## tests/unit/subsys/bluetooth/services/ble_bas_client/testcase.yaml
```yaml
tests:
  bluetooth.ble_bas_client:
    platform_allow: native_sim
    tags: unittest
```

## tests/unit/subsys/bluetooth/services/ble_hrs_client/testcase.yaml
```yaml
tests:
  bluetooth.ble_hrs_client:
    platform_allow: native_sim
    tags: unittest
```

## tests/unit/subsys/bluetooth/services/ble_nus/Kconfig
```kconfig
# Redefine this symbol without dependencies, so that tests
# can enable it without having to enable the dependencies too.
config BLE_NUS
	default y

# Redefine Kconfigs used by the tested module that are defined in
# other modules we do not want to enable.
config NRF_SDH_BLE_TOTAL_LINK_COUNT
	default 3

config NRF_SDH_BLE_GATT_MAX_MTU_SIZE
	default 498

source "Kconfig.zephyr"
```

## tests/unit/subsys/bluetooth/services/ble_nus_client/testcase.yaml
```yaml
tests:
  bluetooth.ble_nus_client:
    platform_allow: native_sim
    tags: unittest
```

## tests/unit/subsys/settings/bluetooth_rmem/testcase.yaml
```yaml
common:
  sysbuild: false
  platform_allow: native_sim
  tags: unittest
tests:
  subsys.bluetooth_rmem: {}
```

## tests/unit/subsys/storage/bm_storage/testcase.yaml
```yaml
tests:
  subsys.bm_storage:
    platform_allow: native_sim
    tags: unittest
  subsys.bm_storage.scheduler:
    platform_allow: native_sim
    tags: unittest
    extra_configs:
      - CONFIG_BM_SCHEDULER=y
```

## tests/unit/subsys/storage/bm_storage_rram/testcase.yaml
```yaml
tests:
  subsys.bm_storage_rram:
    platform_allow: native_sim
    tags: unittest
```

## tests/unit/subsys/storage/bm_storage_sd/testcase.yaml
```yaml
tests:
  subsys.bm_storage_sd:
    platform_allow: native_sim
    tags: unittest
```
