## CMakeLists.txt
```
#
# Copyright (c) 2026 Nordic Semiconductor ASA
#
# SPDX-License-Identifier: LicenseRef-Nordic-5-Clause
#

cmake_minimum_required(VERSION 3.20.0)

find_package(Zephyr REQUIRED HINTS $ENV{ZEPHYR_BASE})

project(bm_storage_rram)

zephyr_compile_definitions(
  NRF54L15_XXAA
  NRF_APPLICATION
  NRFX_DECLARE_ONLY
)

cmock_handle(${ZEPHYR_HAL_NORDIC_MODULE_DIR}/nrfx/drivers/include/nrfx_rramc.h
  WORD_EXCLUDE "NRFX_STATIC_INLINE"
  FUNC_EXCLUDE "nrfy_rramc.*"
)

zephyr_include_directories(
  ${ZEPHYR_HAL_NORDIC_MODULE_DIR}/nrfx
  ${ZEPHYR_HAL_NORDIC_MODULE_DIR}/nrfx/drivers/include
  ${ZEPHYR_HAL_NORDIC_MODULE_DIR}/nrfx/bsp/stable/templates
  ${ZEPHYR_HAL_NORDIC_MODULE_DIR}/nrfx/bsp/stable
  ${ZEPHYR_BASE}/modules/hal_nordic/nrfx
  ${ZEPHYR_CMSIS_MODULE_DIR}/CMSIS/Core/Include
)

# Generate and add test file
test_runner_generate(src/unity_test.c)
target_sources(app PRIVATE src/unity_test.c)
```

## Kconfig
```
#
# Copyright (c) 2026 Nordic Semiconductor ASA
#
# SPDX-License-Identifier: LicenseRef-Nordic-5-Clause
#

# These are redefined here to override dependencies
# and avoid pulling them in, since they are mocked

config BM_STORAGE
	bool "Storage (testing)"

choice BM_STORAGE_BACKEND
	prompt "Backend"

config BM_STORAGE_BACKEND_RRAM
	bool "RRAM"

endchoice

source "Kconfig.zephyr"
```

## prj.conf
```kconfig
CONFIG_UNITY=y

CONFIG_BM_STORAGE=y
CONFIG_BM_STORAGE_BACKEND_RRAM=y
```

## src/unity_test.c
```c
/*
 * Copyright (c) 2026 Nordic Semiconductor ASA
 *
 * SPDX-License-Identifier: LicenseRef-Nordic-5-Clause
 */
#include <unity.h>
#include <errno.h>
#include <stdint.h>
#include <string.h>

#include <bm/storage/bm_storage.h>

#include "cmock_nrfx_rramc.h"

/* RRAM backend uses 16-byte program unit. */
#define BLOCK_SIZE 16

/* Arbitrary partition, must be 32-bit word aligned. */
#define PARTITION_START 0x4200
#define PARTITION_SIZE  (BLOCK_SIZE * 2)

extern const struct bm_storage_info bm_storage_info;

static struct bm_storage_evt storage_event;
static bool storage_event_received;

static void bm_storage_evt_handler(struct bm_storage_evt *evt)
{
	storage_event_received = true;
	memcpy(&storage_event, evt, sizeof(*evt));

	switch (evt->id) {
	case BM_STORAGE_EVT_WRITE_RESULT:
		break;
	case BM_STORAGE_EVT_ERASE_RESULT:
		break;
	default:
		break;
	}
}

void test_bm_storage_rram_init_efault(void)
{
	int err;
	struct bm_storage storage = {0};
	struct bm_storage_config config = {
		.evt_handler = bm_storage_evt_handler,
		.start_addr = PARTITION_START,
		.end_addr = PARTITION_START + PARTITION_SIZE,
	};

	err = bm_storage_init(NULL, NULL);
	TEST_ASSERT_EQUAL(-EFAULT, err);

	err = bm_storage_init(&storage, NULL);
	TEST_ASSERT_EQUAL(-EFAULT, err);

	err = bm_storage_init(NULL, &config);
	TEST_ASSERT_EQUAL(-EFAULT, err);
}

void test_bm_storage_rram_init(void)
{
	int err;
	struct bm_storage storage = {0};
	struct bm_storage_config config = {
		.evt_handler = bm_storage_evt_handler,
		.start_addr = PARTITION_START,
		.end_addr = PARTITION_START + PARTITION_SIZE,
	};

	__cmock_nrfx_rramc_init_ExpectAnyArgsAndReturn(0);
	__cmock_nrfx_rramc_init_IgnoreArg_p_config();
	__cmock_nrfx_rramc_init_IgnoreArg_handler();

	err = bm_storage_init(&storage, &config);
	TEST_ASSERT_EQUAL(0, err);
	TEST_ASSERT_TRUE(storage.initialized);

	__cmock_nrfx_rramc_uninit_Expect();

	err = bm_storage_uninit(&storage);
	TEST_ASSERT_EQUAL(err, 0);
}

void test_bm_storage_rram_uninit_efault(void)
{
	int err;

	err = bm_storage_uninit(NULL);
	TEST_ASSERT_EQUAL(-EFAULT, err);
}

void test_bm_storage_rram_uninit_eperm(void)
{
	int err;
	struct bm_storage storage = {0};

	/* Storage is uninitialized. */
	err = bm_storage_uninit(&storage);
	TEST_ASSERT_EQUAL(-EPERM, err);
}

void test_bm_storage_rram_init_twice(void)
{
	int err;
	struct bm_storage storage = {0};
	struct bm_storage_config config = {
		.evt_handler = bm_storage_evt_handler,
		.start_addr = PARTITION_START,
		.end_addr = PARTITION_START + PARTITION_SIZE,
	};

	__cmock_nrfx_rramc_init_ExpectAnyArgsAndReturn(0);
	__cmock_nrfx_rramc_init_IgnoreArg_p_config();
	__cmock_nrfx_rramc_init_IgnoreArg_handler();

	err = bm_storage_init(&storage, &config);
	TEST_ASSERT_EQUAL(0, err);

	__cmock_nrfx_rramc_uninit_Expect();

	err = bm_storage_uninit(&storage);
	TEST_ASSERT_EQUAL(0, err);

	__cmock_nrfx_rramc_init_ExpectAnyArgsAndReturn(0);
	__cmock_nrfx_rramc_init_IgnoreArg_p_config();
	__cmock_nrfx_rramc_init_IgnoreArg_handler();

	/* Re-initialization after uninit must succeed. */
	err = bm_storage_init(&storage, &config);
	TEST_ASSERT_EQUAL(0, err);
	TEST_ASSERT_TRUE(storage.initialized);

	__cmock_nrfx_rramc_uninit_Expect();

	err = bm_storage_uninit(&storage);
	TEST_ASSERT_EQUAL(0, err);
}

void test_bm_storage_rram_init_two_instances(void)
{
	int err;
	struct bm_storage storage = {0};
	struct bm_storage storage1 = {0};
	struct bm_storage_config config = {
		.evt_handler = bm_storage_evt_handler,
		.start_addr = PARTITION_START,
		.end_addr = PARTITION_START + PARTITION_SIZE,
	};

	__cmock_nrfx_rramc_init_ExpectAnyArgsAndReturn(0);
	__cmock_nrfx_rramc_init_IgnoreArg_p_config();
	__cmock_nrfx_rramc_init_IgnoreArg_handler();

	err = bm_storage_init(&storage, &config);
	TEST_ASSERT_EQUAL(0, err);

	err = bm_storage_init(&storage1, &config);
	TEST_ASSERT_EQUAL(0, err);

	err = bm_storage_uninit(&storage);
	TEST_ASSERT_EQUAL(0, err);

	__cmock_nrfx_rramc_uninit_Expect();

	err = bm_storage_uninit(&storage1);
	TEST_ASSERT_EQUAL(0, err);
}

void test_bm_storage_rram_write_eperm(void)
{
	int err;
	uint8_t buf[BLOCK_SIZE] = {0};
	struct bm_storage storage = {0};

	/* Storage is uninitialized. */
	err = bm_storage_write(&storage, PARTITION_START, buf, sizeof(buf), NULL);
	TEST_ASSERT_EQUAL(-EPERM, err);
}

void test_bm_storage_rram_write_einval(void)
{
	int err;
	/* Buffer size is not a multiple of the program unit (16). */
	uint8_t buf[BLOCK_SIZE - 1];
	struct bm_storage storage = {0};
	struct bm_storage_config config = {
		.evt_handler = bm_storage_evt_handler,
		.start_addr = PARTITION_START,
		.end_addr = PARTITION_START + PARTITION_SIZE,
	};

	__cmock_nrfx_rramc_init_ExpectAnyArgsAndReturn(0);
	__cmock_nrfx_rramc_init_IgnoreArg_p_config();
	__cmock_nrfx_rramc_init_IgnoreArg_handler();

	err = bm_storage_init(&storage, &config);
	TEST_ASSERT_EQUAL(0, err);

	err = bm_storage_write(&storage, PARTITION_START, buf, sizeof(buf), NULL);
	TEST_ASSERT_EQUAL(-EINVAL, err);

	__cmock_nrfx_rramc_uninit_Expect();

	err = bm_storage_uninit(&storage);
	TEST_ASSERT_EQUAL(err, 0);
}

void test_bm_storage_rram_write_efault(void)
{
	int err;
	struct bm_storage storage = {0};
	struct bm_storage_config config = {
		.evt_handler = bm_storage_evt_handler,
		.start_addr = PARTITION_START,
		.end_addr = PARTITION_START + PARTITION_SIZE,
	};

	__cmock_nrfx_rramc_init_ExpectAnyArgsAndReturn(0);
	__cmock_nrfx_rramc_init_IgnoreArg_p_config();
	__cmock_nrfx_rramc_init_IgnoreArg_handler();

	err = bm_storage_init(&storage, &config);
	TEST_ASSERT_EQUAL(0, err);

	err = bm_storage_write(&storage, PARTITION_START, NULL, BLOCK_SIZE, NULL);
	TEST_ASSERT_EQUAL(-EFAULT, err);

	__cmock_nrfx_rramc_uninit_Expect();

	err = bm_storage_uninit(&storage);
	TEST_ASSERT_EQUAL(0, err);
}

void test_bm_storage_rram_write(void)
{
	int err;
	bool is_busy;
	uint8_t buf[BLOCK_SIZE];
	struct bm_storage storage = {0};
	struct bm_storage_config config = {
		.evt_handler = bm_storage_evt_handler,
		.start_addr = PARTITION_START,
		.end_addr = PARTITION_START + PARTITION_SIZE,
	};

	__cmock_nrfx_rramc_init_ExpectAnyArgsAndReturn(0);
	__cmock_nrfx_rramc_init_IgnoreArg_p_config();
	__cmock_nrfx_rramc_init_IgnoreArg_handler();

	err = bm_storage_init(&storage, &config);
	TEST_ASSERT_EQUAL(0, err);

	__cmock_nrfx_rramc_bytes_write_ExpectAnyArgs();
	__cmock_nrfx_rramc_bytes_write_IgnoreArg_address();
	__cmock_nrfx_rramc_bytes_write_IgnoreArg_src();
	__cmock_nrfx_rramc_bytes_write_IgnoreArg_num_bytes();

	err = bm_storage_write(&storage, PARTITION_START, buf, sizeof(buf), NULL);
	TEST_ASSERT_EQUAL(0, err);

	/* RRAM backend dispatches events synchronously. */
	TEST_ASSERT_TRUE(storage_event_received);
	TEST_ASSERT_EQUAL(BM_STORAGE_EVT_WRITE_RESULT, storage_event.id);
	TEST_ASSERT_EQUAL(BM_STORAGE_EVT_DISPATCH_SYNC, storage_event.dispatch_type);
	TEST_ASSERT_EQUAL(0, storage_event.result);
	TEST_ASSERT_EQUAL(PARTITION_START, storage_event.addr);
	TEST_ASSERT_EQUAL_PTR(buf, storage_event.src);
	TEST_ASSERT_EQUAL(sizeof(buf), storage_event.len);

	/* Not busy after sync write completed. */
	is_busy = bm_storage_is_busy(&storage);
	TEST_ASSERT_FALSE(is_busy);

	__cmock_nrfx_rramc_uninit_Expect();

	err = bm_storage_uninit(&storage);
	TEST_ASSERT_EQUAL(0, err);
}

void test_bm_storage_rram_read_eperm(void)
{
	int err;
	uint8_t buf[BLOCK_SIZE] = {0};
	struct bm_storage storage = {0};

	/* Storage is uninitialized. */
	err = bm_storage_read(&storage, PARTITION_START, buf, sizeof(buf));
	TEST_ASSERT_EQUAL(-EPERM, err);
}

void test_bm_storage_rram_read_einval(void)
{
	int err;
	uint8_t buf[BLOCK_SIZE] = {0};
	struct bm_storage storage = {0};
	struct bm_storage_config config = {
		.evt_handler = bm_storage_evt_handler,
		.start_addr = PARTITION_START,
		.end_addr = PARTITION_START + PARTITION_SIZE,
	};

	__cmock_nrfx_rramc_init_ExpectAnyArgsAndReturn(0);
	__cmock_nrfx_rramc_init_IgnoreArg_p_config();
	__cmock_nrfx_rramc_init_IgnoreArg_handler();

	err = bm_storage_init(&storage, &config);
	TEST_ASSERT_EQUAL(0, err);

	err = bm_storage_read(&storage, PARTITION_START, buf, 0);
	TEST_ASSERT_EQUAL(-EINVAL, err);

	__cmock_nrfx_rramc_uninit_Expect();

	err = bm_storage_uninit(&storage);
	TEST_ASSERT_EQUAL(0, err);
}

void test_bm_storage_rram_read(void)
{
	int err;
	uint8_t buf[BLOCK_SIZE] = {0};
	struct bm_storage storage = {0};
	struct bm_storage_config config = {
		.evt_handler = bm_storage_evt_handler,
		.start_addr = PARTITION_START,
		.end_addr = PARTITION_START + PARTITION_SIZE,
	};

	__cmock_nrfx_rramc_init_ExpectAnyArgsAndReturn(0);
	__cmock_nrfx_rramc_init_IgnoreArg_p_config();
	__cmock_nrfx_rramc_init_IgnoreArg_handler();

	err = bm_storage_init(&storage, &config);
	TEST_ASSERT_EQUAL(0, err);

	__cmock_nrfx_rramc_buffer_read_Expect(buf, PARTITION_START, sizeof(buf));

	err = bm_storage_read(&storage, PARTITION_START, buf, sizeof(buf));
	TEST_ASSERT_EQUAL(0, err);

	__cmock_nrfx_rramc_uninit_Expect();

	err = bm_storage_uninit(&storage);
	TEST_ASSERT_EQUAL(0, err);
}

void test_bm_storage_rram_read_efault(void)
{
	int err;
	uint8_t buf[BLOCK_SIZE] = {0};
	struct bm_storage storage = {0};
	struct bm_storage_config config = {
		.evt_handler = bm_storage_evt_handler,
		.start_addr = PARTITION_START,
		.end_addr = PARTITION_START + PARTITION_SIZE,
	};

	__cmock_nrfx_rramc_init_ExpectAnyArgsAndReturn(0);
	__cmock_nrfx_rramc_init_IgnoreArg_p_config();
	__cmock_nrfx_rramc_init_IgnoreArg_handler();

	err = bm_storage_init(&storage, &config);
	TEST_ASSERT_EQUAL(0, err);

	/* Read address is past the end of the partition. */
	err = bm_storage_read(&storage, PARTITION_START + PARTITION_SIZE, buf, sizeof(buf));
	TEST_ASSERT_EQUAL(-EFAULT, err);

	__cmock_nrfx_rramc_uninit_Expect();

	err = bm_storage_uninit(&storage);
	TEST_ASSERT_EQUAL(0, err);
}

void test_bm_storage_rram_erase_eperm(void)
{
	int err;
	struct bm_storage storage = {0};

	/* Storage is uninitialized. */
	err = bm_storage_erase(&storage, PARTITION_START, BLOCK_SIZE, NULL);
	TEST_ASSERT_EQUAL(-EPERM, err);
}

void test_bm_storage_rram_erase_enotsup(void)
{
	int err;
	struct bm_storage storage = {0};
	struct bm_storage_config config = {
		.evt_handler = bm_storage_evt_handler,
		.start_addr = PARTITION_START,
		.end_addr = PARTITION_START + PARTITION_SIZE,
	};

	__cmock_nrfx_rramc_init_ExpectAnyArgsAndReturn(0);
	__cmock_nrfx_rramc_init_IgnoreArg_p_config();
	__cmock_nrfx_rramc_init_IgnoreArg_handler();

	err = bm_storage_init(&storage, &config);
	TEST_ASSERT_EQUAL(0, err);

	/* RRAM backend sets no_explicit_erase = true. */
	err = bm_storage_erase(&storage, PARTITION_START, BLOCK_SIZE, NULL);
	TEST_ASSERT_EQUAL(-ENOTSUP, err);

	__cmock_nrfx_rramc_uninit_Expect();

	err = bm_storage_uninit(&storage);
	TEST_ASSERT_EQUAL(0, err);
}

void test_bm_storage_rram_is_busy(void)
{
	int err;
	bool is_busy = false;
	struct bm_storage storage = {0};
	struct bm_storage_config config = {
		.evt_handler = bm_storage_evt_handler,
		.start_addr = PARTITION_START,
		.end_addr = PARTITION_START + PARTITION_SIZE,
	};

	is_busy = bm_storage_is_busy(NULL);
	TEST_ASSERT_FALSE(is_busy);

	is_busy = bm_storage_is_busy(&storage);
	TEST_ASSERT_FALSE(is_busy);

	__cmock_nrfx_rramc_init_ExpectAnyArgsAndReturn(0);
	__cmock_nrfx_rramc_init_IgnoreArg_p_config();
	__cmock_nrfx_rramc_init_IgnoreArg_handler();

	err = bm_storage_init(&storage, &config);
	TEST_ASSERT_EQUAL(0, err);

	/* Initialized and idle. */
	is_busy = bm_storage_is_busy(&storage);
	TEST_ASSERT_FALSE(is_busy);

	__cmock_nrfx_rramc_uninit_Expect();

	err = bm_storage_uninit(&storage);
	TEST_ASSERT_EQUAL(0, err);
}

void setUp(void)
{
}

void tearDown(void)
{
	memset(&storage_event, 0x00, sizeof(storage_event));
	storage_event_received = false;
}

extern int unity_main(void);

int main(void)
{
	return unity_main();
}
```
