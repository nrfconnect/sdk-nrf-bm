## subsys/storage/bm_storage/Kconfig
```kconfig
#
# Copyright (c) 2025 Nordic Semiconductor
#
# SPDX-License-Identifier: LicenseRef-Nordic-5-Clause
#

menuconfig BM_STORAGE
	bool "Bare Metal storage"
	help
	  Bare Metal storage library.

if BM_STORAGE

choice BM_STORAGE_BACKEND
	prompt "Storage backend"

config BM_STORAGE_BACKEND_RRAM
	bool "RRAM"
	depends on !SOFTDEVICE
	help
	  A backend using the RRAMC peripheral directly.

config BM_STORAGE_BACKEND_SD
	bool "SoftDevice"
	depends on SOFTDEVICE
	depends on NRF_SDH
	depends on RING_BUFFER
	help
	  A backend using the SoftDevice.

config BM_STORAGE_BACKEND_NATIVE_SIM
	bool "Simulated (native)"
	depends on BOARD_NATIVE_SIM
	depends on ZTEST
	help
	  A backend designed to be used for tests.

endchoice

if BM_STORAGE_BACKEND_SD

rsource "sd/Kconfig"

endif # BM_STORAGE_BACKEND_SD

if BM_STORAGE_BACKEND_NATIVE_SIM

rsource "native_sim/Kconfig"

endif # BM_STORAGE_BACKEND_NATIVE_SIM

endif # BM_STORAGE
```

## subsys/storage/bm_storage/native_sim/Kconfig
```kconfig
#
# Copyright (c) 2026 Nordic Semiconductor
#
# SPDX-License-Identifier: LicenseRef-Nordic-5-Clause
#

menu "Native sim backend"

config BM_STORAGE_BACKEND_NATIVE_SIM_ASYNC
	bool "Asynchronous execution of storage operations"

endmenu
```

## subsys/storage/bm_storage/sd/Kconfig
```kconfig
#
# Copyright (c) 2026 Nordic Semiconductor
#
# SPDX-License-Identifier: LicenseRef-Nordic-5-Clause
#

menu "SoftDevice backend"

config BM_STORAGE_BACKEND_SD_QUEUE_SIZE
	int "SoftDevice storage backend queue size"
	default 4

config BM_STORAGE_BACKEND_SD_MAX_RETRIES
	int "Maximum number of attempts at executing an operation when the SoftDevice is busy"
	range 0 255
	default 8
	help
	  Increase this value if events frequently return -ETIMEDOUT.
	  The SoftDevice might fail to schedule flash access due to high BLE activity.

endmenu
```

## subsys/storage/flash_map/Kconfig
```kconfig
#
# Copyright (c) 2025 Nordic Semiconductor
#
# SPDX-License-Identifier: LicenseRef-Nordic-5-Clause
#

if FLASH_MAP_CUSTOM

menu "Flash map"

config FLASH_MAP_CUSTOM_NCS_BM_MCUMGR
	bool "Bare metal MCUmgr flash map"
	depends on NCS_BM_MCUMGR
	help
	  This option enables the custom MCUmgr flash map for NCS bare metal which specifies the
	  update app/installer partition.

	  This option is used by the firmware loader application only.

endmenu

endif # FLASH_MAP_CUSTOM
```

## sysbuild/Kconfig.bm
```kconfig
#
# Copyright (c) 2025 Nordic Semiconductor
#
# SPDX-License-Identifier: LicenseRef-Nordic-5-Clause
#

choice BM_BOOTLOADER
	prompt "Bootloader selection"

config BM_BOOTLOADER_NONE
	bool "None"
	help
	  Do not include a bootloader image in the build.

config BM_BOOTLOADER_MCUBOOT
	bool "MCUboot"
	help
	  Include MCUboot image as the bootloader image to use.

endchoice

if BM_BOOTLOADER_MCUBOOT

menu "MCUboot configuration"

choice BM_BOOTLOADER_MCUBOOT_SIGNATURE_TYPE
	prompt "Signature type"
	default BM_BOOTLOADER_MCUBOOT_SIGNATURE_TYPE_ED25519 if SOC_SERIES_NRF54LX
	default BM_BOOTLOADER_MCUBOOT_SIGNATURE_TYPE_RSA

config BM_BOOTLOADER_MCUBOOT_SIGNATURE_TYPE_NONE
	bool "No signature; use only hash check"

config BM_BOOTLOADER_MCUBOOT_SIGNATURE_TYPE_RSA
	bool "RSA signatures"

config BM_BOOTLOADER_MCUBOOT_SIGNATURE_TYPE_ECDSA_P256
	bool "Elliptic curve digital signatures with curve P-256"

config BM_BOOTLOADER_MCUBOOT_SIGNATURE_TYPE_ED25519
	bool "Edwards curve digital signatures using ed25519"

endchoice

config BM_CRACEN_MICROCODE_LOAD_ONCE
	bool "Load CRACEN microcode once only"
	depends on BM_BOOTLOADER_MCUBOOT_SIGNATURE_TYPE_ED25519
	default y
	help
	  Enable CRACEN microcode loading in MCUBoot, while disabling elsewhere.

config BM_BOOTLOADER_MCUBOOT_SIGNATURE_KEY_FILE
	string "Signing PEM key file" if !BM_BOOTLOADER_MCUBOOT_SIGNATURE_TYPE_NONE
	default "$(ZEPHYR_MCUBOOT_MODULE_DIR)/root-ec-p256.pem" if BM_BOOTLOADER_MCUBOOT_SIGNATURE_TYPE_ECDSA_P256
	default "$(ZEPHYR_MCUBOOT_MODULE_DIR)/root-ed25519.pem" if BM_BOOTLOADER_MCUBOOT_SIGNATURE_TYPE_ED25519
	default "$(ZEPHYR_MCUBOOT_MODULE_DIR)/root-rsa-2048.pem" if BM_BOOTLOADER_MCUBOOT_SIGNATURE_TYPE_RSA
	default ""
	help
	  Absolute path to signing key file to use with MCUBoot.

config BM_BOOTLOADER_MCUBOOT_SIGNATURE_USING_KMU
	bool "Use KMU stored keys for signature verification"
	depends on SOC_SERIES_NRF54LX && BM_BOOTLOADER_MCUBOOT_SIGNATURE_TYPE_ED25519
	help
	  The device needs to be provisioned with the proper set of keys.

config BM_BOOTLOADER_MCUBOOT_GENERATE_DEFAULT_KMU_KEYFILE
	bool "Generate default keyfile for provisioning during build"
	depends on BM_BOOTLOADER_MCUBOOT_SIGNATURE_USING_KMU
	default y
	help
	  If enabled, the build system will generate keyfile.json file in the build directory.

menu "Firmware loader entrance modes"
	depends on !BM_FIRMWARE_LOADER_NONE

config BM_BOOTLOADER_MCUBOOT_FIRMWARE_LOADER_ENTRANCE_GPIO
	bool "GPIO"
	default y

config BM_BOOTLOADER_MCUBOOT_FIRMWARE_LOADER_ENTRANCE_PIN_RESET
	bool "Check for device reset by pin"

config BM_BOOTLOADER_MCUBOOT_FIRMWARE_LOADER_ENTRANCE_BOOT_MODE
	bool "Check boot mode via retention subsystem"

endmenu

config BM_APP_CAN_SETUP_FIRMWARE_LOADER_NAME
	bool "Remote setup firmware loader BLE Advertising Name [EXPERIMENTAL]"
	depends on !BM_FIRMWARE_LOADER_NONE
	select EXPERIMENTAL
	help
	  If enable, the application and the firmware loader will be configured
	  for supporting setup of the firmware loader BLE name using the settings retention
	  memory backend. The settings key for writing the name is `fw_loader/adv_name`.

choice BM_BOOTLOADER_MCUBOOT_IMG_HASH_ALG
	prompt "Hashing algorithm"
	default BM_BOOT_IMG_HASH_ALG_PURE if BM_BOOTLOADER_MCUBOOT_SIGNATURE_TYPE_ED25519 && SOC_SERIES_NRF54LX
	default BM_BOOT_IMG_HASH_ALG_SHA256

config BM_BOOT_IMG_HASH_ALG_SHA256
	bool "SHA256"
	depends on !BM_BOOTLOADER_MCUBOOT_SIGNATURE_USING_KMU

config BM_BOOT_IMG_HASH_ALG_SHA512
	bool "SHA512"
	depends on SOC_SERIES_NRF54LX
	depends on !BM_BOOTLOADER_MCUBOOT_SIGNATURE_USING_KMU

config BM_BOOT_IMG_HASH_ALG_PURE
	bool "Pure (hash of data directly without hash)"
	depends on BM_BOOTLOADER_MCUBOOT_SIGNATURE_TYPE_ED25519 && SOC_SERIES_NRF54LX

endchoice

config BM_BOOT_BOOTCONF_LOCK_WRITES
	bool "Protect bootloader's NVM from writes"
	depends on SOC_NRF54L15_CPUAPP || SOC_NRF54L10_CPUAPP || SOC_NRF54L05_CPUAPP
	help
	  Sets RRAMC's BOOTCONF region protection to disable writes.

endmenu

endif # BM_BOOTLOADER_MCUBOOT

if !BM_BOOTLOADER_NONE

config BM_BOOTLOADER_IMAGE_NAME
	string
	default "mcuboot" if BM_BOOTLOADER_MCUBOOT
	help
	  Name of bootloader image.

config BM_BOOTLOADER_IMAGE_PATH
	string
	default "${ZEPHYR_MCUBOOT_MODULE_DIR}/boot/zephyr" if BM_BOOTLOADER_MCUBOOT
	help
	  Source directory of bootloader image.

choice BM_FIRMWARE_LOADER
	prompt "Firmware loader selection"

config BM_FIRMWARE_LOADER_NONE
	bool "None"
	help
	  Do not include a firmware loader image in the build.

config BM_FIRMWARE_LOADER_BT_MCUMGR
	bool "Bluetooth MCUmgr"
	help
	  Include Bluetooth MCUmgr image as the firmware loader image to use (uses Softdevice).

config BM_FIRMWARE_LOADER_UART_MCUMGR
	bool "UART MCUmgr"
	help
	  Include UART MCUmgr image as the firmware loader image to use.

endchoice

if !BM_FIRMWARE_LOADER_NONE

config BM_FIRMWARE_LOADER_IMAGE_NAME
	string
	default "firmware_loader"
	help
	  Name of firmware loader image.

config BM_FIRMWARE_LOADER_IMAGE_PATH
	string
	default "$(ZEPHYR_NRF_BM_MODULE_DIR)/applications/firmware_loader/ble_mcumgr" if BM_FIRMWARE_LOADER_BT_MCUMGR
	default "$(ZEPHYR_NRF_BM_MODULE_DIR)/applications/firmware_loader/uart_mcumgr" if BM_FIRMWARE_LOADER_UART_MCUMGR
	help
	  Source directory of firmware loader image.

endif

endif

choice SOFTDEVICE_SELECTION
	prompt "Softdevice selection"

config SOFTDEVICE_NONE
	bool "None"

config SOFTDEVICE_S115
	bool "S115"
	depends on SOC_SERIES_NRF54LX

config SOFTDEVICE_S145
	bool "S145"
	depends on SOC_SERIES_NRF54LX

endchoice

config SOFTDEVICE_FILE
	string
	default "$(ZEPHYR_NRF_BM_MODULE_DIR)/components/softdevice/v9/nrf54l/s115/s115_nrf54l05_9.0.0_softdevice.hex" if SOFTDEVICE_S115 && SOC_NRF54L05
	default "$(ZEPHYR_NRF_BM_MODULE_DIR)/components/softdevice/v9/nrf54l/s115/s115_nrf54l10_9.0.0_softdevice.hex" if SOFTDEVICE_S115 && SOC_NRF54L10
	default "$(ZEPHYR_NRF_BM_MODULE_DIR)/components/softdevice/v9/nrf54l/s115/s115_nrf54l15_9.0.0_softdevice.hex" if SOFTDEVICE_S115 && SOC_NRF54L15
	default "$(ZEPHYR_NRF_BM_MODULE_DIR)/components/softdevice/v9/nrf54l/s145/s145_nrf54l05_9.0.0_softdevice.hex" if SOFTDEVICE_S145 && SOC_NRF54L05
	default "$(ZEPHYR_NRF_BM_MODULE_DIR)/components/softdevice/v9/nrf54l/s145/s145_nrf54l10_9.0.0_softdevice.hex" if SOFTDEVICE_S145 && SOC_NRF54L10
	default "$(ZEPHYR_NRF_BM_MODULE_DIR)/components/softdevice/v9/nrf54l/s145/s145_nrf54l15_9.0.0_softdevice.hex" if SOFTDEVICE_S145 && SOC_NRF54L15
	help
	  Specifies the path to the softdevice hex file.

config METADATA_SIZE
	hex
	default 0x200 if SOC_SERIES_NRF54LX
	help
	  Specifies the size of the metadata partition.

config METADATA_ENTRY_SIZE
	int
	default 32
	help
	  Specifies the size of each metadata entry.

config INSTALLER_HEX_OUTPUT
	bool "Installer hex output [DEBUG]"
	help
	  Will output a hex file of the installer image, this is for debug usage only.
```

## sysbuild/Kconfig.sysbuild
```kconfig
config NCS_BM
	bool "NCS Bare Metal"
	default y

if NCS_BM

rsource "Kconfig.bm"

endif # NCS_BM
```

## tests/Kconfig
```kconfig
#
# Copyright (c) 2026 Nordic Semiconductor ASA
#
# SPDX-License-Identifier: LicenseRef-Nordic-5-Clause
#

config TEST_SDH_EVT_DISPATCH
	bool "SoftDevice event dispatch test utility"
	depends on UNITY
```

## tests/lib/bm_timer/testcase.yaml
```yaml
common:
  tags:
    - bm_timer
  platform_allow:
    - bm_nrf54l15dk/nrf54l15/cpuapp/s115_softdevice
    - bm_nrf54l15dk/nrf54l10/cpuapp/s115_softdevice
    - bm_nrf54l15dk/nrf54l05/cpuapp/s115_softdevice
  integration_platforms:
    - bm_nrf54l15dk/nrf54l15/cpuapp/s115_softdevice
tests:
  tests.lib.bm_timer:
    tags:
      - bm_timer
```

## tests/lib/bm_zms/testcase.yaml
```yaml
common:
  tags: bm_zms
  skip: true
  platform_allow:
    - bm_nrf54l15dk/nrf54l05/cpuapp/s115_softdevice
    - bm_nrf54l15dk/nrf54l10/cpuapp/s115_softdevice
    - bm_nrf54l15dk/nrf54l15/cpuapp/s115_softdevice
tests:
  lib.bm_zms:
    tags: bm_zms
  lib.bm_zms.cache:
    extra_args:
      - CONFIG_BM_ZMS_LOOKUP_CACHE=y
      - CONFIG_BM_ZMS_LOOKUP_CACHE_SIZE=64
  lib.bm_zms.data_crc:
    extra_args:
      - CONFIG_BM_ZMS_DATA_CRC=y
  lib.bm_zms.softdevice:
    extra_args:
      - CONFIG_SOFTDEVICE=y
      - CONFIG_NRF_SDH=y
```

## tests/lib/peer_manager/gatt_cache_manager/testcase.yaml
```yaml
tests:
  lib.peer_manager.gatt_cache_manager:
    platform_allow: native_sim
    tags: unittest
```

## tests/lib/peer_manager/gatts_cache_manager/testcase.yaml
```yaml
tests:
  lib.peer_manager.gatts_cache_manager:
    platform_allow: native_sim
    tags: unittest
```

## tests/lib/peer_manager/nrf_ble_lesc/testcase.yaml
```yaml
tests:
  lib.peer_manager.nrf_ble_lesc:
    platform_allow: native_sim
    tags: unittest
```

## tests/subsys/bluetooth/services/ble_bms/Kconfig
```kconfig
# Clear dependencies for BLE_BMS and enable it to allow
# testing the features without enabling the library.
config BLE_BMS
	default y

# Redefine Kconfigs used by the tested module that is defined in
# other modules we do not want to enable.
config BLE_QWR_MAX_ATTR
	default 1

config NRF_SDH_BLE_TOTAL_LINK_COUNT
	default 1

source "Kconfig.zephyr"
```
