## subsys/softdevice_handler/Kconfig
```kconfig
#
# Copyright (c) 2024 Nordic Semiconductor ASA
#
# SPDX-License-Identifier: LicenseRef-Nordic-5-Clause
#
menuconfig NRF_SDH
	bool "SoftDevice handler"
	depends on SOFTDEVICE

if NRF_SDH

config NRF_SDH_BLE
	bool "Bluetooth LE events"
	default y

choice
	prompt "Dispatch model"
	default NRF_SDH_DISPATCH_MODEL_SCHED

config NRF_SDH_DISPATCH_MODEL_IRQ
	bool "Interrupt"
	help
	  SoftDevice events are passed to the application in
	  the SoftDevice event interrupt context.

config NRF_SDH_DISPATCH_MODEL_SCHED
	bool "Scheduler"
	depends on BM_SCHEDULER
	help
	  SoftDevice events are passed to the application using the scheduler.

config NRF_SDH_DISPATCH_MODEL_POLL
	bool "Manual (poll)"
	help
	  In this mode, a user application can also implement SD_EVT_IRQHandler()
	  to receive a notification about incoming events.

endchoice

config NRF_SDH_DISPATCH_MODEL
	int
	default 0 if NRF_SDH_DISPATCH_MODEL_IRQ
	default 1 if NRF_SDH_DISPATCH_MODEL_SCHED
	default 2 if NRF_SDH_DISPATCH_MODEL_POLL

menu "Clock configuration"

choice
	prompt "Low-frequency clock source"
	default NRF_SDH_CLOCK_LF_SRC_XO
	default NRF_SDH_CLOCK_LF_SRC_RC

config NRF_SDH_CLOCK_LF_SRC_RC
	depends on NRF_GRTC_TIMER_SOURCE_LFLPRC
	bool "LFRC"

config NRF_SDH_CLOCK_LF_SRC_XO
	bool "LFXO"
	depends on $(dt_nodelabel_enabled,lfxo)
	depends on NRF_GRTC_TIMER_SOURCE_LFXO
endchoice

config NRF_SDH_CLOCK_LF_SRC
	int
	default 0 if NRF_SDH_CLOCK_LF_SRC_RC
	default 1 if NRF_SDH_CLOCK_LF_SRC_XO

config NRF_SDH_CLOCK_LF_RC_CTIV
	int "Calibration timer interval (1/4 second units)" if NRF_SDH_CLOCK_LF_SRC_RC
	range 1 32 if NRF_SDH_CLOCK_LF_SRC_RC
	default 16 if NRF_SDH_CLOCK_LF_SRC_RC
	default 0
	help
	  To avoid excessive clock drift, 0.5 degrees Celsius is the
	  maximum temperature change allowed in one calibration timer
	  interval. The interval should be selected to ensure this.

config NRF_SDH_CLOCK_LF_RC_TEMP_CTIV
	int "How often to calibrate if the temperature hasn't changed" if NRF_SDH_CLOCK_LF_SRC_RC
	range 0 33 if NRF_SDH_CLOCK_LF_SRC_RC
	default 2 if NRF_SDH_CLOCK_LF_SRC_RC
	default 0
	help
	  How often (in number of calibration intervals) the RC oscillator
	  shall be calibrated if the temperature hasn't changed.
	  0: Always calibrate even if the temperature hasn't changed.
	  1: Invalid
	  2-33: Check the temperature and only calibrate if it has changed.
	        However, always calibrate when this many intervals have passed.

choice
	prompt "Clock accuracy"
	default NRF_SDH_CLOCK_LF_ACCURACY_500_PPM if NRF_SDH_CLOCK_LF_SRC_RC
	default NRF_SDH_CLOCK_LF_ACCURACY_250_PPM

config NRF_SDH_CLOCK_LF_ACCURACY_500_PPM
	bool "500 ppm"

config NRF_SDH_CLOCK_LF_ACCURACY_250_PPM
	bool "250 ppm"

config NRF_SDH_CLOCK_LF_ACCURACY_150_PPM
	bool "150 ppm"

config NRF_SDH_CLOCK_LF_ACCURACY_100_PPM
	bool "100 ppm"

config NRF_SDH_CLOCK_LF_ACCURACY_75_PPM
	bool "75 ppm"

config NRF_SDH_CLOCK_LF_ACCURACY_50_PPM
	bool "50 ppm"

config NRF_SDH_CLOCK_LF_ACCURACY_30_PPM
	bool "30 ppm"

config NRF_SDH_CLOCK_LF_ACCURACY_20_PPM
	bool "20 ppm"

config NRF_SDH_CLOCK_LF_ACCURACY_10_PPM
	bool "10 ppm"

config NRF_SDH_CLOCK_LF_ACCURACY_5_PPM
	bool "5 ppm"

config NRF_SDH_CLOCK_LF_ACCURACY_2_PPM
	bool "2 ppm"

config NRF_SDH_CLOCK_LF_ACCURACY_1_PPM
	bool "1 ppm"
endchoice

config NRF_SDH_CLOCK_LF_ACCURACY
	int
	default 0 if NRF_SDH_CLOCK_LF_ACCURACY_250_PPM
	default 1 if NRF_SDH_CLOCK_LF_ACCURACY_500_PPM
	default 2 if NRF_SDH_CLOCK_LF_ACCURACY_150_PPM
	default 3 if NRF_SDH_CLOCK_LF_ACCURACY_100_PPM
	default 4 if NRF_SDH_CLOCK_LF_ACCURACY_75_PPM
	default 5 if NRF_SDH_CLOCK_LF_ACCURACY_50_PPM
	default 6 if NRF_SDH_CLOCK_LF_ACCURACY_30_PPM
	default 7 if NRF_SDH_CLOCK_LF_ACCURACY_20_PPM
	default 8 if NRF_SDH_CLOCK_LF_ACCURACY_10_PPM
	default 9 if NRF_SDH_CLOCK_LF_ACCURACY_5_PPM
	default 10 if NRF_SDH_CLOCK_LF_ACCURACY_2_PPM
	default 11 if NRF_SDH_CLOCK_LF_ACCURACY_1_PPM
	default 0

config NRF_SDH_CLOCK_HFINT_CALIBRATION_INTERVAL
	int "HFINT calibration interval in seconds"
	range 1 255
	default 60

config NRF_SDH_CLOCK_HFCLK_LATENCY
	int "Ramp-up time of the high-frequency crystal oscillator in microseconds"
	range 0 $(UINT16_MAX)
	default 1500

endmenu

if NRF_SDH_BLE

menu "Default Bluetooth LE configuration"

config NRF_SDH_BLE_CONN_TAG
	int "Connection tag"
	range 1 255
	default 99
	help
	  Connection tag to use for Bluetooth LE configuration.

config NRF_SDH_BLE_PERIPHERAL_LINK_COUNT
	int "Maximum number of peripheral links"
	depends on SOFTDEVICE_PERIPHERAL
	range 0 NRF_SDH_BLE_TOTAL_LINK_COUNT
	default 1

config NRF_SDH_BLE_CENTRAL_LINK_COUNT
	int "Maximum number of central links"
	depends on SOFTDEVICE_CENTRAL
	range 0 NRF_SDH_BLE_TOTAL_LINK_COUNT
	default 0

config NRF_SDH_BLE_TOTAL_LINK_COUNT
	int "Maximum number of total concurrent connections"
	range 0 2 if SOFTDEVICE_S115
	range 0 5 if SOFTDEVICE_S145
	range 1 64
	default 1

config NRF_SDH_BLE_GAP_EVENT_LENGTH
	int "GAP event length (1.25 ms units)"
	range 2 3200
	default 3
	help
	  The event length in milliseconds must be shorter than the connection interval.
	  Must be 6 or larger when coded PHY is used.

config NRF_SDH_BLE_GATT_MAX_MTU_SIZE
	int "Maximum MTU size"
	range 23 $(UINT16_MAX)
	default 23
	help
	  Maximum size of an ATT packet the SoftDevice can send or receive.
	  Increasing this number will increase the size of internal buffers in the SoftDevice
	  and hence, the amount of dynamic RAM required by the SoftDevice.
	  The minimum size is BLE_GATT_ATT_MTU_DEFAULT.

config NRF_SDH_BLE_GATTS_ATTR_TAB_SIZE
	int "Attribute Table size in bytes"
	range 248 $(UINT32_MAX)
	default 1408
	help
	  Size of the Attribute Table in the SoftDevice. Increasing this number allows for more
	  services and characteristics to be added to the Attribute Table in the SoftDevice.
	  Increasing this number will increase the amount of dynamic RAM required by the SoftDevice.
	  The minimum size is BLE_GATTS_ATTR_TAB_SIZE_MIN. The size must be a multiple of 4.

config NRF_SDH_BLE_VS_UUID_COUNT
	int "Number of vendor-specific UUIDs"
	default 0

config NRF_SDH_BLE_SERVICE_CHANGED
	bool "Include the Service Changed characteristic in the Attribute Table"

config NRF_SDH_BLE_LOG_SD_RAM_USAGE
	bool "Log RAM usage on BLE enable"
	help
	  The amount of RAM needed by the SoftDevice changes based on the configuration.
	  This enables logging of SoftDevice RAM usage and also the SoftDevice RAM end address.
	  The reported SoftDevice RAM end address can be used to tweak the application RAM start
	  address. For instance to maximize RAM for the application.

endmenu

endif # NRF_SDH_BLE

config NRF_SDH_SOC_RAND_SEED
	bool "Automatically seed SoftDevice random"
	depends on NRF_SECURITY
	depends on MBEDTLS_PSA_CRYPTO_C
	default y
	help
	  Automatically seed SoftDevice using CRACEN to generate the random seed.

config NRF_SDH_STR_TABLES
	bool "Build string tables for SoftDevice events"
	default y
	help
	  Compile a table of stringified SoftDevice events for nrf_sdh_ble_evt_to_str() and
	  nrf_sdh_soc_evt_to_str(). Disable to save non-volatile memory.

config NRF_SDH_LOG_SD_INFO
	bool "Log SoftDevice information on enable"
	help
	  Log SoftDevice ID, version, firmware ID and unique string when enabling the SoftDevice.
	  Log Link Layer version when enabling Bluetooth LE.

module=NRF_SDH
module-str= SoftDevice handler
source "$(ZEPHYR_BASE)/subsys/logging/Kconfig.template.log_config"

endif # NRF_SDH
```

## subsys/storage/Kconfig
```kconfig
#
# Copyright (c) 2025 Nordic Semiconductor
#
# SPDX-License-Identifier: LicenseRef-Nordic-5-Clause
#

menu "Storage"

# zephyr-keep-sorted-start
rsource "bm_rmem/Kconfig"
rsource "bm_storage/Kconfig"
rsource "flash_map/Kconfig"
# zephyr-keep-sorted-stop

endmenu
```

## subsys/storage/bm_rmem/Kconfig
```kconfig
#
# Copyright (c) 2026 Nordic Semiconductor
#
# SPDX-License-Identifier: LicenseRef-Nordic-5-Clause
#

# Workaround for not being able to have commas in macro arguments
DT_CHOSEN_NCSBM_CLIPBOARD_PARTITION := ncsbm,clipboard-partition

config BM_RMEM_CLIPBOARD
	bool "Inter application RAM Clipboard"
	depends on $(dt_chosen_enabled,$(DT_CHOSEN_NCSBM_CLIPBOARD_PARTITION))
	help
	  If enabled, instance of simple inter application
	  clipboard storage on retained RAM area is supported.
	  The storage is using RAM memory region described in the DTS node
	  assigned by ncsbm,clipboard-partition chosen.
```
