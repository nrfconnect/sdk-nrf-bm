## subsys/mgmt/mcumgr/grp/os_mgmt/Kconfig
```kconfig
# Copyright Runtime.io 2018. All rights reserved.
# Copyright Nordic Semiconductor ASA 2020-2022. All rights reserved.
# SPDX-License-Identifier: Apache-2.0

# The Kconfig file is dedicated to OS management group of
# of MCUmgr subsystem and provides Kconfig options to configure
# group commands behaviour and other aspects.
#
# Options defined in this file should be prefixed:
#  MCUMGR_GRP_OS_ -- general group options;
#
# When adding Kconfig options, that control the same feature,
# try to group them together by the same stem after prefix.

menuconfig MCUMGR_GRP_OS
	bool "MCUmgr handlers for OS management"
	imply REBOOT
	help
	  Enables MCUmgr handlers for OS management

if MCUMGR_GRP_OS

if REBOOT

config MCUMGR_GRP_OS_RESET_HOOK
	bool "Reset hook"
	depends on REBOOT
	depends on MCUMGR_MGMT_NOTIFICATION_HOOKS
	help
	  Allows applications to control and get notifications of when a reset
	  command has been issued via an MCUmgr command. With this option
	  disabled, modules will reboot when the command is received without
	  notification, when this is enabled and a handler is registered, the
	  application will be notified that a reset command has been received
	  and will allow the application to perform any required operations
	  before accepting or declining the reset request.

config MCUMGR_GRP_OS_RESET_BOOT_MODE
	bool "Boot mode"
	depends on RETENTION_BOOT_MODE
	help
	  Allows applications to set the boot mode using the retention boot mode module which
	  allows for booting other images e.g. as part of a bootloader. This is done with an
	  optional field in the reset command which specifies the value of the boot mode.

endif

config MCUMGR_GRP_OS_ECHO
	bool "Support for echo command"
	default y
	select MCUMGR_SMP_CBOR_MIN_DECODING_LEVEL_2

config MCUMGR_GRP_OS_MCUMGR_PARAMS
	bool "MCUMGR Parameters retrieval command"

config MCUMGR_GRP_OS_INFO
	bool "Support for info command"
	help
	  Can be used similarly to the unix/linux uname command for retrieving system information
	  including kernel version, processor architecture and board name.

config MCUMGR_GRP_OS_MCUMGR_PARAMS_ROLE
	bool "MCUMGR Parameter Role in response"
	depends on MCUMGR_GRP_OS_MCUMGR_PARAMS
	default y

config MCUMGR_GRP_OS_MCUMGR_PARAMS_ROLE_VALUE
	int "MCUMGR Parameter Role value"
	default 80 if !MCUMGR_GPR_IMG
	default 0
	depends on MCUMGR_GRP_OS_MCUMGR_PARAMS_ROLE
	help
	  Value for `inst_role` field in response to MCUmgr Parameters request.

if MCUMGR_GRP_OS_INFO

config MCUMGR_GRP_OS_INFO_MAX_RESPONSE_SIZE
	int "Maximum response size for info command"
	default 256
	range 32 512
	help
	  The maximum size of the response to the info command, will use a stack buffer of this
	  size to store the data in. If the output response is too big then the output will not be
	  present in the response, which will just contain the result code (rc) of memory error.

config MCUMGR_GRP_OS_INFO_CUSTOM_HOOKS
	bool "Custom info hooks"
	depends on MCUMGR_MGMT_NOTIFICATION_HOOKS
	help
	  Supports adding custom command/character processing to the info command by using
	  registered callbacks. Data can be appended to the struct provided in the callback.

config MCUMGR_GRP_OS_INFO_BUILD_DATE_TIME
	bool "Show build date and time"
	help
	  Will allow returning the build date and time of the firmware by using the info with
	  format option 'b' (will also be returned with all responses by using 'a').

	  Note: This will invalidate reproducible builds of the firmware as it will embed the
	  build date/time in the output firmware image.

endif

config MCUMGR_GRP_OS_BOOTLOADER_INFO
	bool "Bootloader information"
	help
	  Allows to query MCUmgr about bootloader used by device and various bootloader
	  parameters.

config MCUMGR_GRP_OS_BOOTLOADER_INFO_HOOK
	bool "Bootloader info hooks"
	depends on MCUMGR_MGMT_NOTIFICATION_HOOKS
	help
	  Supports adding custom responses to the bootloader info command by using registered
	  callbacks. Data can be appended to the struct provided in the callback.

module = MCUMGR_GRP_OS
module-str = mcumgr_grp_os
source "subsys/logging/Kconfig.template.log_config"

endif
```

## subsys/mgmt/mcumgr/transport/Kconfig
```kconfig
# Copyright Runtime.io 2018. All rights reserved.
# Copyright Nordic Semiconductor ASA 2020-2022. All rights reserved.
# SPDX-License-Identifier: Apache-2.0

# The Kconfig file is dedicated to transport subdirectory of MCUmgr
# subsystem and provides Kconfig options to control aspects of
# transport, in general, that are not otherwise controlled by
# options belonging to transport specifically.
#
# Options defined in this file should be prefixed:
#  MCUMGR_TRANSPORT_ -- general transport options;
#  MCUMGR_TRANSPORT_NETBUF -- for Net Buf related configuration.

config MCUMGR_TRANSPORT_REASSEMBLY
	bool "Reassembly support"
	help
	  Enable structures and functions needed for packet reassembly by SMP backend.

config MCUMGR_TRANSPORT_NETBUF_COUNT
	int "Number of MCUmgr buffers"
	default 4
	help
	  The number of net_bufs to allocate for mcumgr.  These buffers are
	  used for both requests and responses.

config MCUMGR_TRANSPORT_NETBUF_SIZE
	int "Size of each MCUmgr buffer"
	default 2475 if MCUMGR_TRANSPORT_REASSEMBLY
	default 384
	help
	  The size, in bytes, of each MCUmgr buffer.  This value must satisfy
	  the following relation:
	  MCUMGR_TRANSPORT_NETBUF_SIZE >= transport-specific-MTU + transport-overhead
	  In case when MCUMGR_TRANSPORT_SHELL is enabled this value should be set to
	  at least MCUMGR_GRP_SHELL_BACKEND_DUMMY_BUF_SIZE + 32.

module = MCUMGR_TRANSPORT
module-str = mcumgr_transport
source "subsys/logging/Kconfig.template.log_config"
```

## subsys/mgmt/mcumgr/transport/Kconfig.bm_uart
```kconfig
# Copyright Nordic Semiconductor ASA 2025. All rights reserved.
# SPDX-License-Identifier: LicenseRef-Nordic-5-Clause

# The Kconfig file is dedicated to the BM UART transport of MCUmgr
# subsystem and provides Kconfig options to control aspects of
# the transport.
#
# Options defined in this file should be prefixed:
#  MCUMGR_TRANSPORT_BM_UART_

menuconfig MCUMGR_TRANSPORT_BM_UART
	bool "Bare Metal UART MCUmgr SMP transport"
	depends on BASE64
	depends on CRC
	help
	  Enables handling of SMP commands received over UART.

if MCUMGR_TRANSPORT_BM_UART

config MCUMGR_TRANSPORT_BM_UART_UARTE_HWFC
	bool "UARTE HWFC"
	help
	  Enable hardware flow control on the UARTE peripheral used by the application.

config MCUMGR_TRANSPORT_BM_UART_UARTE_PARITY
	bool "UARTE parity"
	help
	  Enable parity on the UARTE peripheral used by the application.

config MCUMGR_TRANSPORT_BM_UART_UARTE_IRQ_PRIO
	int "UARTE IRQ priority"
	default 3

config MCUMGR_TRANSPORT_BM_UART_RX_BUF_SIZE
	int "Size of receive buffer for mcumgr fragments received over UART, in bytes"
	default 128
	help
	  Specifies the size of the mcumgr UART receive buffer, in bytes. This
	  value must be large enough to accommodate any line sent by an mcumgr
	  client.

# Duplicate Zephyr symbol without console dependency to allow usage of Zephyr header file
config UART_MCUMGR_RX_BUF_SIZE
	int
	default MCUMGR_TRANSPORT_BM_UART_RX_BUF_SIZE

config MCUMGR_TRANSPORT_BM_UART_RX_BUF_COUNT
	int "Number of receive buffers for mcumgr fragments received over UART"
	default 8
	help
	  Specifies the number of the mcumgr UART receive buffers.  Receive
	  buffers hold received mcumgr fragments prior to reassembly.  This
	  setting's value must satisfy the following relation:
	  UART_MCUMGR_RX_BUF_COUNT * UART_MCUMGR_RX_BUF_SIZE >=
	  MCUMGR_TRANSPORT_UART_MTU

endif # MCUMGR_TRANSPORT_BM_UART
```

## subsys/nfc/lib/Kconfig
```kconfig
#
# Copyright (c) 2025 Nordic Semiconductor ASA
#
# SPDX-License-Identifier: LicenseRef-Nordic-5-Clause
#
config BM_NFC_PLATFORM
	bool "Common NFC configuration for Bare Metal"
	depends on NCS_BM
	default y if NFC_T2T_NRFXLIB || NFC_T4T_NRFXLIB
	select NRFX_NFCT
	help
	  Enable common configuration for the NFC

if BM_NFC_PLATFORM

config BM_NFCT_IRQ_PRIORITY
	int "NFCT interrupt priority for Bare Metal"
	range 2 7
	default 5 if SOFTDEVICE
	default 3
	help
	  Sets NFC interrupt priority.
	  Levels are from 2 (highest priority) to 7 (lowest priority).
	  Interrupt priority level must be greater than 4 (SoftDevice low priority)
	  if you want to call into SoftDevice from the NFC driver.


module = BM_NFC_PLATFORM
module-str = nfc_platform
source "$(ZEPHYR_BASE)/subsys/logging/Kconfig.template.log_config"

endif # BM_NFC_PLATFORM
```

## subsys/nfc/ndef/Kconfig
```kconfig
#
# Copyright (c) 2026 Nordic Semiconductor ASA
#
# SPDX-License-Identifier: LicenseRef-Nordic-5-Clause
#

config BM_NFC_NDEF
	bool "NDEF libraries for Bare Metal"
	help
	  Enable NFC Data Exchange Format libraries

config BM_NFC_NDEF_PAYLOAD_TYPE_COMMON
	bool "Standard NDEF Record Type definitions for Bare Metal"
	help
	  Enable NFC Data Exchange Format Record Type definitions

if BM_NFC_NDEF

config BM_NFC_NDEF_MSG
	bool "NDEF Message generator library for Bare Metal"

config BM_NFC_NDEF_RECORD
	bool "NDEF Record generator library for Bare Metal"

config BM_NFC_NDEF_LE_OOB_REC
	bool "NDEF LE OOB record generator library for Bare Metal"
	select BM_NFC_NDEF_PAYLOAD_TYPE_COMMON
	depends on SOFTDEVICE

config BM_NFC_NDEF_TEXT_RECORD
	bool "Encoding data for a text record for NFC Tag for Bare Metal"

config BM_NFC_NDEF_URI_MSG
	bool "NDEF URI messages generator library for Bare Metal"

config BM_NFC_NDEF_URI_REC
	bool "NDEF URI record generator library for Bare Metal"

config BM_NFC_NDEF_CH_MSG
	bool "NDEF pairing Connection Handover message generator library for Bare Metal"
	select BM_NFC_NDEF_CH_REC
	help
	  Enable NDEF Connection Handover message generator library

config BM_NFC_NDEF_CH_REC
	bool "NDEF Connection Handover records generator library for Bare Metal"
	help
	  Enable NDEF Connection Handover records generator library

config BM_NFC_NDEF_LAUNCHAPP_MSG
	bool "NDEF Launch App message library for Bare Metal"
	select BM_NFC_NDEF_LAUNCHAPP_REC
	help
	  Enable NDEF Launch App message generator library

config BM_NFC_NDEF_LAUNCHAPP_REC
	bool "NDEF Launch App records for Bare Metal"
	help
	  Enable NDEF Launch App records library

endif # BM_NFC_NDEF

if BM_NFC_NDEF_CH_MSG

config BM_NFC_NDEF_CH_MAJOR_VERSION
	int "Connection Handover major version"
	default 1
	help
	  The major version of the Connection Handover specification.

config BM_NFC_NDEF_CH_MINOR_VERSION
	int "Connection Handover minor version"
	default 5
	help
	  The minor version of the Connection Handover specification.

endif # BM_NFC_NDEF_CH_MSG
```

## subsys/nfc/t4t/Kconfig
```kconfig
#
# Copyright (c) 2026 Nordic Semiconductor ASA
#
# SPDX-License-Identifier: LicenseRef-Nordic-5-Clause
#

config BM_NFC_T4T_NDEF_FILE
	bool "NFC Type 4 Tag NDEF File for Bare Metal"
	default y if NFC_T4T_NRFXLIB && BM_NFC_NDEF_MSG
	help
	  Enable NFC Type 4 Tag NDEF File generator library.
```

## subsys/nfc/tnep/Kconfig
```kconfig
#
# Copyright (c) 2026 Nordic Semiconductor ASA
#
# SPDX-License-Identifier: LicenseRef-Nordic-5-Clause
#

if NFC_TNEP_TAG

choice NFC_TNEP_TAG_SIGNALLING
	prompt "NFC TNEP Tag signalling method"
	default NFC_TNEP_TAG_SIGNALLING_BM if NCS_BM

config NFC_TNEP_TAG_SIGNALLING_BM
	bool "NFC TNEP Tag signalling using Bare Metal primitives"
	select POLL

endchoice

endif # NFC_TNEP_TAG
```

## subsys/settings/Kconfig
```kconfig
#
# Copyright (c) 2025 Nordic Semiconductor
#
# SPDX-License-Identifier: LicenseRef-Nordic-5-Clause
#

menu "Settings"
	depends on SETTINGS

config NCS_BM_SETTINGS_BLUETOOTH_NAME
	bool "Bluetooth name [EXPERIMENTAL]"
	select EXPERIMENTAL
	help
	  If enabled, settings handlers for support BLE advertising name
	  sharing under `fw_loader/adv_name` key are included into the build.

endmenu

config NCS_BM_FLAT_SETTINGS_BLUETOOTH_NAME
	bool "Bluetooth name settings clipboard"
	select NCS_BM_RMEM_CLIPBOARD
	depends on !SETTINGS
	# Enable runtime API in settings.h
	# To be removed once API will be fixed in zephyr-rtos
	select SETTINGS_RUNTIME
	help
	  If enabled, settings handlers for support BLE advertising name
	  setup under `fw_loader/adv_name` key are included into the build.
	  Data are stored to retention clipboard which can be read directly by
	  the firmware_loader.

if NCS_BM_FLAT_SETTINGS_BLUETOOTH_NAME

module = NCS_BM_FLAT_SETTINGS
module-str = ncs_bm_flat_settings
source "subsys/logging/Kconfig.template.log_config"

# hiden option
# This is for suppresing warning on implicit declaration of API function
# which prototypes were cut-out in zephyr-rtos settighs.h
# To be removed once API will be fixed in zephyr-rtos
config SETTINGS_RUNTIME
	help
	  Enables runtime storage back-end API.

endif
```

## subsys/shell/Kconfig
```kconfig
#
# Copyright (c) 2026 Nordic Semiconductor
#
# SPDX-License-Identifier: LicenseRef-Nordic-5-Clause
#

menu "Shell"

# Disable the shell log backend
config SHELL_LOG_BACKEND
	default n

rsource "backends/Kconfig"

endmenu
```

## subsys/shell/backends/Kconfig.bm_uarte
```kconfig
#
# Copyright (c) 2026 Nordic Semiconductor
#
# SPDX-License-Identifier: LicenseRef-Nordic-5-Clause
#

config SHELL_BACKEND_BM_UARTE
	bool "UARTE shell backend [Experimental]"
	select RING_BUFFER
	select EXPERIMENTAL
	help
	  When enabled, the backend uses the nrfx UARTE driver as the shell transport layer.

if SHELL_BACKEND_BM_UARTE

config SHELL_BACKEND_BM_UARTE_RX_RBUF_SIZE
	int "Receive ring buffer size in bytes"
	default 128
	help
	  The size of the receive ring buffer the receive double buffer
	  is copied to.

config SHELL_BACKEND_BM_UARTE_RX_DBUF_SIZE
	int "Receive double buffer size in bytes"
	default 128
	help
	  The total size of the receive double buffer.

config SHELL_BACKEND_BM_UARTE_IRQ_PRIO
	int "IRQ priority"
	range 3 7
	default 5

config SHELL_BACKEND_BM_UARTE_USE_HWFC
	bool "Use hardware flow control"

config SHELL_BACKEND_BM_UARTE_PARITY_INCLUDED
	bool "Use parity"

# Disable zephyrs default serial (UART) backend
config SHELL_BACKEND_SERIAL
	default n

# Only minimal subset of shell is supported without threads
config SHELL_MINIMAL
	default y

endif
```

## subsys/softdevice/Kconfig
```kconfig
#
# Copyright (c) 2024 Nordic Semiconductor
#
# SPDX-License-Identifier: LicenseRef-Nordic-5-Clause
#
menu "SoftDevice"

config SOFTDEVICE
	bool "SoftDevice is present"
	depends on ZERO_LATENCY_IRQS
	imply NRF_SDH

config SOFTDEVICE_PERIPHERAL
	bool

config SOFTDEVICE_CENTRAL
	bool

config SOFTDEVICE_DATA_LENGTH_UPDATE
	bool

config SOFTDEVICE_QOS_CHANNEL_SURVEY_REPORT
	bool

if SOFTDEVICE

choice SOFTDEVICE_VARIANT
	prompt "SoftDevice variant"

config SOFTDEVICE_S115
	bool "s115 SoftDevice"
	depends on SOC_SERIES_NRF54L
	select SOFTDEVICE_PERIPHERAL
	select SOFTDEVICE_DATA_LENGTH_UPDATE

config SOFTDEVICE_S145
	bool "s145 SoftDevice"
	depends on SOC_SERIES_NRF54L
	select SOFTDEVICE_PERIPHERAL
	select SOFTDEVICE_CENTRAL
	select SOFTDEVICE_DATA_LENGTH_UPDATE

endchoice # SOFTDEVICE_VARIANT

config SOFTDEVICE_VARIANT_STR
	string
	default "s115" if SOFTDEVICE_S115
	default "s145" if SOFTDEVICE_S145
	help
	  SoftDevice variant used to select the SoftDevice API include path
	  `components/softdevice/<soctarget>/<softdevice>/<softdevice>_API/include`

config SOFTDEVICE_SOC_VARIANT_STR
	string
	default "nrf54l" if SOC_NRF54L15 || SOC_NRF54L10 || SOC_NRF54L05
	default "nrf54lv" if SOC_NRF54LV10A
	help
	  SoC series variant used to select the SoftDevice API include path
	  `components/softdevice/<soctarget>/<softdevice>/<softdevice>_API/include`

endif

endmenu

config CLOCK_CONTROL
	default n if SOFTDEVICE
```
