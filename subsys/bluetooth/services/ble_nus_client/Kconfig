## subsys/bluetooth/services/ble_nus_client/Kconfig
```kconfig
#
# Copyright (c) 2026 Nordic Semiconductor ASA
#
# SPDX-License-Identifier: LicenseRef-Nordic-5-Clause
#
menuconfig BLE_NUS_CLIENT
	bool "Nordic UART service client [EXPERIMENTAL]"
	depends on SOFTDEVICE_CENTRAL
	depends on NRF_SDH_BLE
	depends on BLE_DB_DISCOVERY
	depends on BLE_GATT_QUEUE
	select EXPERIMENTAL
	help
	  BLE NUS service client service.

if BLE_NUS_CLIENT

module=BLE_NUS_CLIENT
module-str=BLE Nordic UART client
source "$(ZEPHYR_BASE)/subsys/logging/Kconfig.template.log_config"

endif
```

## subsys/bluetooth/services/nrf_ble_cgms/Kconfig.cgms
```kconfig
#
# Copyright (c) 2025 Nordic Semiconductor ASA
#
# SPDX-License-Identifier: LicenseRef-Nordic-5-Clause
#
menuconfig BLE_CGMS
	bool "Continuous glucose measurement service"
	select EXPERIMENTAL

if BLE_CGMS

config NRF_BLE_CGMS_BLE_OBSERVER_PRIO
	int "Softdevice event observer priority"
	default 0

module=BLE_CGMS
module-dep=LOG
module-str=BLE CGMS
source "${ZEPHYR_BASE}/subsys/logging/Kconfig.template.log_config"

endif
```

## subsys/bm_installs/Kconfig
```kconfig
#
# Copyright (c) 2025 Nordic Semiconductor ASA
#
# SPDX-License-Identifier: LicenseRef-Nordic-5-Clause
#

menu "BM install"

config BM_INSTALL_IMAGES
	int "Install images (DO NOT ALTER)"
	default -1
	help
	  Special field, set by sysbuild automatically, do not alter.

config BM_INSTALL_ENTRY_SIZE
	int "Entry size (DO NOT ALTER)"
	default -1
	help
	  Special field, set by sysbuild automatically, do not alter.

config BM_INSTALL_ENTRIES
	int "Entries (DO NOT ALTER)"
	default -1
	help
	  Special field, set by sysbuild automatically, do not alter.

config BM_METADATA_WRITE
	bool "Metadata write functions (DO NOT ALTER)"
	select FLASH
	select FLASH_MAP
	help
	  Special field, set by sysbuild automatically, do not alter.

module = BM_INSTALL
module-str = BM_install
source "subsys/logging/Kconfig.template.log_config"

config BM_REQUIREMENTS
	bool
	default y if BM_INSTALL_IMAGES != -1
	select CRC

endmenu
```

## subsys/fs/Kconfig
```kconfig
#
# Copyright (c) 2025 Nordic Semiconductor
#
# SPDX-License-Identifier: LicenseRef-Nordic-5-Clause
#

menu "File Systems"

# zephyr-keep-sorted-start
rsource "bm_zms/Kconfig"
# zephyr-keep-sorted-stop

endmenu
```

## subsys/fs/bm_zms/Kconfig
```kconfig
#
# Copyright (c) 2025 Nordic Semiconductor ASA
#
# SPDX-License-Identifier: LicenseRef-Nordic-5-Clause
#

menuconfig BM_ZMS
	bool "Bare Metal Zephyr Memory Storage"
	select CRC
	select RING_BUFFER
	select BM_STORAGE
	help
	  Bare Metal Zephyr Memory Storage library.

if BM_ZMS

config BM_ZMS_LOOKUP_CACHE
	bool "BM_ZMS lookup cache"
	help
	  Enable BM_ZMS cache to reduce the BM_ZMS data lookup time.
	  Each cache entry holds an address of the most recent allocation
	  table entry (ATE) for all BM_ZMS IDs that fall into that cache position.

config BM_ZMS_LOOKUP_CACHE_SIZE
	int "BM_ZMS lookup cache size"
	range 1 65536
	default 128
	depends on BM_ZMS_LOOKUP_CACHE
	help
	  Number of entries in the BM_ZMS lookup cache.
	  Every additional entry in cache will use 8 bytes of RAM.

config BM_ZMS_DATA_CRC
	bool "BM_ZMS data CRC"

config BM_ZMS_CUSTOMIZE_BLOCK_SIZE
	bool "Customize the size of the buffer used internally for reads and writes"
	help
	  BM_ZMS uses an internal buffer to read/write and compare stored data.
	  Increasing the size of this buffer should be done carefully in order to not
	  overflow the stack.
	  Increasing it makes BM_ZMS able to work with storage devices
	  that have a larger `write-block-size` (which decreases the performance of BM_ZMS).

config BM_ZMS_CUSTOM_BLOCK_SIZE
	int "BM_ZMS internal buffer size"
	depends on BM_ZMS_CUSTOMIZE_BLOCK_SIZE
	default 32
	help
	  Changes the internal buffer size of BM_ZMS.

config BM_ZMS_OP_QUEUE_SIZE
	int "BM_ZMS operations queue size"
	default 16
	help
	  defines the maximum number of operations that can be queued in BM_ZMS

module=BM_ZMS
module-str=BM_ZMS
source "subsys/logging/Kconfig.template.log_config"

endif # BM_ZMS
```

## subsys/logging/Kconfig
```kconfig
#
# Copyright (c) 2025 Nordic Semiconductor
#
# SPDX-License-Identifier: LicenseRef-Nordic-5-Clause
#
menu "Logging"

if LOG

if !LOG_MODE_MINIMAL

if !LOG_FRONTEND_ONLY

rsource "backends/Kconfig"

endif # !LOG_FRONTEND_ONLY

endif # !LOG_MODE_MINIMAL

endif # LOG

endmenu
```

## subsys/logging/backends/Kconfig.bm_uarte
```kconfig
#
# Copyright (c) 2025 Nordic Semiconductor
#
# SPDX-License-Identifier: LicenseRef-Nordic-5-Clause
#

menuconfig LOG_BACKEND_BM_UARTE
	bool "UARTE log backend"
	select LOG_BACKEND_SUPPORTS_FORMAT_TIMESTAMP
	help
	  When enabled, the backend uses the nrfx UARTE driver to output logs and printk.

if LOG_BACKEND_BM_UARTE

# Disable the zephyr UART backend by default when the Bare Metal UARTE log backend is used.
config LOG_BACKEND_UART
	default n

# Disable deprecated symbol
config DEPRECATED_UART_NRFX_UARTE_LEGACY_SHIM
	bool
	default n

config LOG_BACKEND_BM_UARTE_BUFFER_SIZE
	int "Maximum number of bytes to buffer in RAM before flushing"
	default 200
	help
	  In deferred logging mode, sets the maximum number of bytes which can be buffered in
	  RAM before log_output_flush is automatically called on the UART backend.  The buffer
	  will also be flushed after each log message.

	  In immediate logging mode, processed log messages are not buffered and are always
	  output one byte at a time.

config LOG_BACKEND_BM_UARTE_IRQ_PRIO
	int "IRQ priority"
	range 3 7
	default 5

config LOG_BACKEND_BM_UARTE_USE_HWFC
	bool "Use hardware flow control"

config LOG_BACKEND_BM_UARTE_PARITY_INCLUDED
	bool "Use parity"

backend = BM_UARTE
backend-str = Bare Metal uarte
source "subsys/logging/Kconfig.template.log_format_config"

endif # BM_UARTE_CONSOLE
```

## subsys/logging/backends/Kconfig.lite_uarte
```kconfig
#
# Copyright (c) 2025 Nordic Semiconductor
#
# SPDX-License-Identifier: LicenseRef-Nordic-5-Clause
#

menuconfig LOG_BACKEND_LITE_UARTE
	bool "Lite UARTE console"
	select LOG_BACKEND_SUPPORTS_FORMAT_TIMESTAMP
	help
	  When enabled backend is using nrfx UARTE driver to output logs and printk.

if LOG_BACKEND_LITE_UARTE

# When this is available we disable the zephyr UART backend by default
config LOG_BACKEND_UART
	default n

config DEPRECATED_UART_NRFX_UARTE_LEGACY_SHIM
	bool
	default n

config LOG_BACKEND_LITE_UARTE_BUFFER_SIZE
	int "Maximum number of bytes to buffer in RAM before flushing"
	default 1
	help
	  In deferred logging mode, sets the maximum number of bytes which can be buffered in
	  RAM before log_output_flush is automatically called on the UART backend.  The buffer
	  will also be flushed after each log message.

	  In immediate logging mode, processed log messages are not buffered and are always
	  output one byte at a time.

config LOG_BACKEND_LITE_UARTE_IRQ_PRIO
	int "IRQ priority"
	range 3 7
	default 3

config LOG_BACKEND_LITE_UARTE_USE_HWFC
	bool "Use hardware flow control"

config LOG_BACKEND_LITE_UARTE_PARITY_INCLUDED
	bool "Use parity"

backend = LITE_UARTE
backend-str = lite uarte
source "subsys/logging/Kconfig.template.log_format_config"

endif # LITE_UARTE_CONSOLE
```

## subsys/mgmt/mcumgr/Kconfig
```kconfig
# Copyright Runtime.io 2018. All rights reserved.
# Copyright Nordic Semiconductor ASA 2020-2022. All rights reserved.
# SPDX-License-Identifier: Apache-2.0

menuconfig NCS_BM_MCUMGR
	bool "NCS BM MCUmgr Support"
	depends on NET_BUF
	depends on ZCBOR
	help
	  This option enables the MCUmgr management library.

if NCS_BM_MCUMGR

module = NCS_BM_MCUMGR
module-str = ncs_bm_mcumgr
source "subsys/logging/Kconfig.template.log_config"

rsource "mgmt/Kconfig"

rsource "smp/Kconfig"

config MCUMGR_SMP_LEGACY_RC_BEHAVIOUR
	bool "Legacy rc (result code) response behaviour"
	depends on MCUMGR_SMP_SUPPORT_ORIGINAL_PROTOCOL
	help
	  This will enable legacy result code response behaviour of having rc
	  present in responses when the status is 0. With this option disabled,
	  mcumgr acts with new behaviour and will only return rc is the result
	  code is non-zero (i.e. an error occurred).

	  If a command only returns a result code, this will mean that the
	  response will be empty with the new behaviour enabled, as opposed to
	  the old behaviour where the rc field will be present in the response.

menu "Command Handlers"

rsource "grp/Kconfig"

endmenu

menu "Transports and Transport Related Configuration Options"

rsource "transport/Kconfig"

endmenu

endif # NCS_BM_MCUMGR
```

## subsys/mgmt/mcumgr/grp/Kconfig
```kconfig
# Copyright Runtime.io 2018. All rights reserved.
# Copyright Nordic Semiconductor ASA 2020-2022. All rights reserved.
# SPDX-License-Identifier: Apache-2.0

rsource "img_mgmt/Kconfig"

rsource "os_mgmt/Kconfig"
```

## subsys/mgmt/mcumgr/grp/img_mgmt/Kconfig
```kconfig
# Copyright Runtime.io 2018. All rights reserved.
# Copyright Nordic Semiconductor ASA 2020-2022. All rights reserved.
# SPDX-License-Identifier: Apache-2.0

# The Kconfig file is dedicated to Application Image management group of
# of MCUmgr subsystem and provides Kconfig options to configure
# group commands behaviour and other aspects.
#
# Options defined in this file should be prefixed:
#  MCUMGR_GRP_IMG_ -- general group options;
#
# When adding Kconfig options, that control the same feature,
# try to group them together by the same stem after prefix.

menuconfig MCUMGR_GRP_IMG
	bool "MCUmgr handlers for image management"
	depends on FLASH
	depends on IMG_MANAGER
	depends on !MCUBOOT_BOOTLOADER_MODE_SINGLE_APP
	select MPU_ALLOW_FLASH_WRITE if ARM_MPU
	select MCUMGR_SMP_CBOR_MIN_DECODING_LEVEL_2
	select MCUMGR_SMP_CBOR_MIN_ENCODING_LEVEL_3 if ZCBOR_CANONICAL
	imply IMG_ERASE_PROGRESSIVELY
	help
	  Enables MCUmgr handlers for image management

if MCUMGR_GRP_IMG

config MCUMGR_GRP_IMG_UPDATABLE_IMAGE_NUMBER
	int "Number of supported images"
	default UPDATEABLE_IMAGE_NUMBER
	range 1 3
	help
	  Sets how many application images are supported (pairs of secondary and primary slots).
	  Setting this to 2 requires MCUMGR_TRANSPORT_NETBUF_SIZE to be at least 512b.
	  NOTE: The UPDATEABLE_IMAGE_NUMBER of MCUBOOT configuration, even for Zephyr build,
	  needs to be set to the same value; this is due to the fact that the MCUmgr uses
	  boot_util and the UPDATEABLE_IMAGE_NUMBER controls number of images supported
	  by that library.

config MCUMGR_GRP_IMG_VERBOSE_ERR
	bool "Verbose error responses when uploading application image"
	select MCUMGR_SMP_VERBOSE_ERR_RESPONSE
	help
	  Add additional "rsn" key to SMP responses, where provided, explaining
	  non-0 "rc" codes.

config MCUMGR_GRP_IMG_ALLOW_CONFIRM_NON_ACTIVE_IMAGE_SECONDARY
	bool "Allow to confirm secondary slot of non-active image"
	default y
	help
	  Allows to confirm secondary (non-active) slot of non-active image.
	  Normally it should not be allowed to confirm any slots of non-active
	  image, via MCUmgr commands, to prevent confirming something that is
	  broken and may not boot in other slot; instead application should
	  have means to test and confirm the image.

config MCUMGR_GRP_IMG_ALLOW_CONFIRM_NON_ACTIVE_IMAGE_ANY
	bool "Allow to confirm slots of non-active image"
	select MCUMGR_GRP_IMG_ALLOW_CONFIRM_NON_ACTIVE_IMAGE_SECONDARY
	help
	  Allows to confirm any slot of non-active image.
	  Normally it should not be allowed to confirm any slots of non-active
	  image, via MCUmgr commands, to prevent confirming something that is
	  broken and may not boot in other slot; instead application should
	  have means to test and confirm the image.

if !MCUBOOT_BOOTLOADER_MODE_DIRECT_XIP

config MCUMGR_GRP_IMG_ALLOW_ERASE_PENDING
	bool "Allow to erase pending slot"
	default y
	help
	  Allows erasing secondary slot which is marked for test or confirmed; this allows
	  erasing slots that have been set for next boot but the device has not
	  reset yet, so has not yet been swapped.

endif

config MCUMGR_GRP_IMG_VERSION_CMP_USE_BUILD_NUMBER
	bool "Use build number while comparing image version"
	help
	  By default, the image version comparison relies only on version major,
	  minor and revision. Enable this option to take into account the build
	  number as well.

config MCUMGR_GRP_IMG_UPLOAD_CHECK_HOOK
	bool "Upload check hook"
	depends on MCUMGR_MGMT_NOTIFICATION_HOOKS
	help
	  This will enable the upload check hook which will send image upload requests to
	  registered callbacks to check with the user application if an upload should be accepted
	  or rejected.

config MCUMGR_GRP_IMG_STATUS_HOOKS
	bool "Status hooks"
	depends on MCUMGR_MGMT_NOTIFICATION_HOOKS
	help
	  This will enable DFU status hooks which can be checked by the application to monitor DFU
	  uploads. Note that these are status checking only, to allow inspecting of a file upload
	  or prevent it, CONFIG_MCUMGR_GRP_IMG_UPLOAD_CHECK_HOOK must be used.

choice MCUMGR_GRP_IMG_TOO_LARGE_CHECK
	prompt "Image size check overhead"
	default MCUMGR_GRP_IMG_TOO_LARGE_DISABLED
	help
	  MCUboot images should be limited to the maximum size that the bootloader can swap, in
	  order to know this size, additional information is needed from the MCUboot
	  configuration, otherwise an image can be uploaded that is too large for the bootloader
	  to swap, this selects which method to use.

	  Note: setting this to a non-disabled option will prevent uploading of padded and
	  confirmed images, if support for that is required then this feature should be left as
	  disabled.

config MCUMGR_GRP_IMG_TOO_LARGE_DISABLED
	bool "Disabled"
	help
	  Will not take MCUboot configuration into account when checking for maximum file size.

config MCUMGR_GRP_IMG_TOO_LARGE_SYSBUILD
	bool "Via Sysbuild from MCUboot configuration"
	depends on ROM_END_OFFSET > 0 || MCUBOOT_UPDATE_FOOTER_SIZE > 0
	help
	  Will use the image overhead size calculated during Sysbuild image configuration.

config MCUMGR_GRP_IMG_TOO_LARGE_BOOTLOADER_INFO
	bool "Via retention bootloader info"
	depends on RETENTION_BOOTLOADER_INFO_OUTPUT_FUNCTION
	help
	  Will fetch the maximum image size from the bootloader info retention subsystem module.

endchoice

config MCUMGR_GRP_IMG_IMAGE_SLOT_STATE_HOOK
	bool "Image slot state hook"
	depends on MCUMGR_MGMT_NOTIFICATION_HOOKS
	help
	  Allows applications to add additional fields to responses for the image slot state
	  command.

config MCUMGR_GRP_IMG_IMAGE_SLOT_STATE_STATES
	int
	prompt "Predicted maximum number of entries per group" if MCUMGR_GRP_IMG_IMAGE_SLOT_STATE_HOOK
	default 15
	help
	  This is used for defining CBOR map holding group data.
	  The value does not affect memory allocation, it is used by zcbor
	  to figure out how to encode map depending on its predicted size.

config MCUMGR_GRP_IMG_SLOT_INFO
	bool "Slot info"
	default y if MCUMGR_GRP_IMG_UPDATABLE_IMAGE_NUMBER > 1
	help
	  This will enable the slot information function which will return information about all
	  images and slots that the application can see.

config MCUMGR_GRP_IMG_SLOT_INFO_HOOKS
	bool "Slot info hooks"
	depends on MCUMGR_GRP_IMG_SLOT_INFO && MCUMGR_MGMT_NOTIFICATION_HOOKS
	help
	  This will enable the slot info function hooks which can be used to add additional
	  information to responses.

module = MCUMGR_GRP_IMG
module-str = MCUMGR_GRP_IMG
source "subsys/logging/Kconfig.template.log_config"

endif
```
