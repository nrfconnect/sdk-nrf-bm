## boards/nordic/bm_nrf54l15dk/Kconfig.defconfig
```kconfig
#
# Copyright (c) 2025 Nordic Semiconductor
#
# SPDX-License-Identifier: LicenseRef-Nordic-5-Clause
#

choice NRF_GRTC_TIMER_SOURCE
	default NRF_GRTC_TIMER_SOURCE_LFLPRC if !$(dt_nodelabel_enabled,lfxo)
endchoice
```

## boards/nordic/bm_nrf54lc10dk/Kconfig.bm_nrf54lc10dk
```kconfig
#
# Copyright (c) 2026 Nordic Semiconductor ASA
#
# SPDX-License-Identifier: LicenseRef-Nordic-5-Clause
#

config BOARD_BM_NRF54LC10DK
	select SOC_NRF54LC10A_CPUAPP if BOARD_BM_NRF54LC10DK_NRF54LC10A_CPUAPP_S115_SOFTDEVICE || \
					BOARD_BM_NRF54LC10DK_NRF54LC10A_CPUAPP_S115_SOFTDEVICE_MCUBOOT || \
					BOARD_BM_NRF54LC10DK_NRF54LC10A_CPUAPP_S145_SOFTDEVICE || \
					BOARD_BM_NRF54LC10DK_NRF54LC10A_CPUAPP_S145_SOFTDEVICE_MCUBOOT
```

## boards/nordic/bm_nrf54lc10dk/board.yml
```yaml
board:
  name: bm_nrf54lc10dk
  full_name: Bare Metal nrf54lc10A DK
  vendor: nordic
  socs:
    - name: nrf54lc10a
      variants:
        - name: s115_softdevice
          cpucluster: cpuapp
          variants:
            - name: mcuboot
        - name: s145_softdevice
          cpucluster: cpuapp
          variants:
            - name: mcuboot
runners:
  run_once:
    '--recover':
      - runners:
          - nrfjprog
          - nrfutil
        run: first
        groups:
          - boards:
              - bm_nrf54lc10dk/nrf54lc10a/cpuapp
              - bm_nrf54lc10dk/nrf54lc10a/cpuapp/s115_softdevice
              - bm_nrf54lc10dk/nrf54lc10a/cpuapp/s115_softdevice/mcuboot
              - bm_nrf54lc10dk/nrf54lc10a/cpuapp/s145_softdevice
              - bm_nrf54lc10dk/nrf54lc10a/cpuapp/s145_softdevice/mcuboot
    '--erase':
      - runners:
          - nrfjprog
          - jlink
          - nrfutil
        run: first
        groups:
          - boards:
              - bm_nrf54lc10dk/nrf54lc10a/cpuapp
              - bm_nrf54lc10dk/nrf54lc10a/cpuapp/s115_softdevice
              - bm_nrf54lc10dk/nrf54lc10a/cpuapp/s115_softdevice/mcuboot
              - bm_nrf54lc10dk/nrf54lc10a/cpuapp/s145_softdevice
              - bm_nrf54lc10dk/nrf54lc10a/cpuapp/s145_softdevice/mcuboot
    '--reset':
      - runners:
          - nrfjprog
          - jlink
          - nrfutil
        run: last
        groups:
          - boards:
              - bm_nrf54lc10dk/nrf54lc10a/cpuapp
              - bm_nrf54lc10dk/nrf54lc10a/cpuapp/s115_softdevice
              - bm_nrf54lc10dk/nrf54lc10a/cpuapp/s115_softdevice/mcuboot
              - bm_nrf54lc10dk/nrf54lc10a/cpuapp/s145_softdevice
              - bm_nrf54lc10dk/nrf54lc10a/cpuapp/s145_softdevice/mcuboot
```

## boards/nordic/bm_nrf54lm20dk/Kconfig.defconfig
```kconfig
#
# Copyright (c) 2026 Nordic Semiconductor ASA
#
# SPDX-License-Identifier: LicenseRef-Nordic-5-Clause
#

choice NRF_GRTC_TIMER_SOURCE
	default NRF_GRTC_TIMER_SOURCE_LFLPRC if !$(dt_nodelabel_enabled,lfxo)
endchoice
```

## drivers/Kconfig
```kconfig
#
# Copyright (c) 2025 Nordic Semiconductor
#
# SPDX-License-Identifier: LicenseRef-Nordic-5-Clause
#
menu "Device Drivers"

# zephyr-keep-sorted-start
rsource "bm_lpuarte/Kconfig"
rsource "console/Kconfig"
rsource "flash/Kconfig"
# zephyr-keep-sorted-stop

endmenu
```

## lib/Kconfig
```kconfig
#
# Copyright (c) 2024 Nordic Semiconductor
#
# SPDX-License-Identifier: LicenseRef-Nordic-5-Clause
#
menu "Libraries"

# zephyr-keep-sorted-start
rsource "bluetooth/Kconfig"
rsource "bm_buttons/Kconfig"
rsource "bm_gpiote/Kconfig"
rsource "bm_scheduler/Kconfig"
rsource "bm_spi_mngr/Kconfig"
rsource "bm_timer/Kconfig"
rsource "boot_banner/Kconfig"
rsource "sensorsim/Kconfig"
rsource "zephyr_queue/Kconfig"
# zephyr-keep-sorted-stop

endmenu
```

## lib/bluetooth/ble_scan/Kconfig
```kconfig
#
# Copyright (c) 2025 Nordic Semiconductor
#
# SPDX-License-Identifier: LicenseRef-Nordic-5-Clause
#

menuconfig BLE_SCAN
	bool "Bluetooth LE Scan"
	depends on SOFTDEVICE_CENTRAL
	depends on NRF_SDH_BLE
	depends on BLE_ADV_DATA

if BLE_SCAN

config BLE_SCAN_BUFFER_SIZE
	int "Scan buffer size"
	default 32
	help
	  Maximum size for an advertising set.

config BLE_SCAN_NAME_MAX_LEN
	int "Scan name maximum length"
	default 32
	help
	  Maximum size for the name to search in the advertisement report,
	  including NULL-termination.

config BLE_SCAN_SHORT_NAME_MAX_LEN
	int "Scan short name maximum length"
	default 32
	help
	  Maximum size of the short name to search for in the advertisement report,
	  including NULL-termination.

config BLE_SCAN_MANUFACTURER_DATA_MAX_LEN
	int "Scan manufacturer data maximum length"
	default 32
	help
	  Maximum size for the manufacturer data to search in the advertisement report.

config BLE_SCAN_FILTER
	bool "Scan filter"
	default y
	help
	  Enabling filters for the scanning module.

if BLE_SCAN_FILTER

config BLE_SCAN_NAME_COUNT
	int "Scan name count"
	default 1
	help
	  Maximum number of name filters.

config BLE_SCAN_APPEARANCE_COUNT
	int "Scan appearance count"
	default 0
	help
	  Maximum number of appearance filters.

config BLE_SCAN_ADDRESS_COUNT
	int "Scan address count"
	default 0
	help
	  Maximum number of address filters.

config BLE_SCAN_SHORT_NAME_COUNT
	int "Scan short name count"
	default 0
	help
	  Maximum number of short name filters.

config BLE_SCAN_UUID_COUNT
	int "Scan UUID count"
	default 0
	help
	  Maximum number of filters for UUIDs.

config BLE_SCAN_MANUFACTURER_DATA_COUNT
	int "Scan manufacturer data count"
	default 0
	help
	  Maximum number of manufacturer data filters.

endif # BLE_SCAN_FILTER

config BLE_SCAN_INTERVAL
	int "Scanning interval (0.625 ms units)"
	range 4 65535
	default 160
	help
	  The scan interval in 0.625-millisecond units. Min 2.5 ms. Max 40.96 sec.
	  This value is used when default scan parameters are configured.

config BLE_SCAN_DURATION
	int "Scanning duration (10 ms units)"
	range 0 65535
	default 0
	help
	  Duration of a scanning session in 10-millisecond units. Min 10 ms. Max 655.35 sec.
	  If set to 0, the scanning continues until it is explicitly disabled.
	  This value is used when default scan parameters are configured.

config BLE_SCAN_WINDOW
	int "Scanning window (0.625 ms units)"
	range 4 BLE_SCAN_INTERVAL
	default 80
	help
	  The scan window in 0.625-millisecond units. Min 2.5 ms. Max CONFIG_BLE_SCAN_INTERVAL.
	  This value is used when default scan parameters are configured.

menu "Connection parameters for new connections (defaults)"

config BLE_SCAN_PERIPHERAL_LATENCY
	int "Peripheral latency"
	range 0 499
	default 0
	help
	  Number of connection events that peripheral is allowed to skip.
	  This value is used for new connections when default connection parameters are configured.

config BLE_SCAN_MIN_CONNECTION_INTERVAL
	int "Minimum connection interval (1.25 ms units)"
	range 6 3200
	default 6
	help
	  Minimum connection interval in 1.25-millisecond units. Min 7.5 ms. Max 4 sec.
	  This value is used for new connections when default connection parameters are configured.

config BLE_SCAN_MAX_CONNECTION_INTERVAL
	int "Maximum connection interval (1.25 ms units)"
	range BLE_SCAN_MIN_CONNECTION_INTERVAL 3200
	default 256
	help
	  Maximum connection interval in 1.25-millisecond units.
	  Min CONFIG_BLE_SCAN_MIN_CONNECTION_INTERVAL. Max 4 sec.
	  This value is used for new connections when default connection parameters are configured.

config BLE_SCAN_SUPERVISION_TIMEOUT
	int "Connection supervision timeout (10 ms units)"
	range 10 3200
	default 100
	help
	  Connection supervision timeout in 10-millisecond units. Min 100 ms. Max 32 sec.
	  This value is used for new connections when default connection parameters are configured.

endmenu

module=BLE_SCAN
module-str=BLE Scan
source "$(ZEPHYR_BASE)/subsys/logging/Kconfig.template.log_config"

endif # BLE_SCAN
```

## lib/bm_spi_mngr/Kconfig
```kconfig
#
# Copyright (c) 2026 Nordic Semiconductor ASA
#
# SPDX-License-Identifier: LicenseRef-Nordic-5-Clause
#

config BM_SPI_MNGR
	bool "SPI transaction manager"
	depends on NRFX_SPIM
	select RING_BUFFER
	help
	  A library for queuing SPI controller transactions (multi-transfer sequences) on one SPIM
	  instance.
```

## modules/hal_nordic/nrfx/Kconfig
```kconfig
# Copyright (c) 2016-2025 Nordic Semiconductor ASA
# SPDX-License-Identifier: Apache-2.0

# This file partially overrides the nrfx Kconfigs in zephyr/modules/hal_nordic/nrfx/Konfig to allow
# all options to be set without having the peripherals defined in Device Tree.

menu "nrfx drivers"
	depends on HAS_NRFX

config NRFX_CLOCK
	bool "CLOCK driver"

config NRFX_COMP
	bool "COMP driver"

config NRFX_EGU0
	bool "EGU0 driver instance"
	select NRFX_EGU

config NRFX_EGU1
	bool "EGU1 driver instance"
	select NRFX_EGU

config NRFX_EGU2
	bool "EGU2 driver instance"
	select NRFX_EGU

config NRFX_EGU3
	bool "EGU3 driver instance"
	select NRFX_EGU

config NRFX_EGU4
	bool "EGU4 driver instance"
	select NRFX_EGU

config NRFX_EGU5
	bool "EGU5 driver instance"
	select NRFX_EGU

config NRFX_EGU10
	bool "EGU10 driver instance"
	select NRFX_EGU

config NRFX_EGU20
	bool "EGU20 driver instance"
	select NRFX_EGU

config NRFX_EGU020
	bool "EGU020 driver instance"
	select NRFX_EGU

config NRFX_EGU130
	bool "EGU130 driver instance"
	select NRFX_EGU

config NRFX_GRTC
	bool "GRTC driver"

config NRFX_IPC
	bool "IPC driver"

config NRFX_LPCOMP
	bool "LPCOMP driver"
	depends on !SOC_NRF52810 && !SOC_NRF52811 && !SOC_NRF52820

config NRFX_MRAMC
	bool "MRAMC driver"

config NRFX_NFCT
	bool "NFCT driver"
	select NRFX_TIMER

config NRFX_NVMC
	bool "NVMC driver"

config NRFX_POWER
	bool "POWER driver"

config NRFX_QSPI
	bool "QSPI driver"

config NRFX_RNG
	bool "RNG driver"

config NRFX_RRAMC
	bool "RRAMC driver"

config NRFX_SAADC
	bool "SAADC driver"
	depends on !SOC_SERIES_NRF51

config NRFX_SPIM
	bool "SPIM driver"

config NRFX_SPIS
	bool "SPIS driver"

config NRFX_TBM
	bool "TBM driver"

config NRFX_TEMP
	bool "TEMP driver"

config NRFX_USBREG
	bool "USBREG driver"

config NRFX_WDT
	bool "WDT driver"

endmenu # "nrfx drivers"
```

## subsys/memfault/Kconfig
```kconfig
#
# Copyright (c) 2026 Nordic Semiconductor ASA
#
# SPDX-License-Identifier: LicenseRef-Nordic-5-Clause
#

config BM_MEMFAULT_LOCK
	bool "NCS BM Memfault platform lock (irq_lock-based)"
	default y
	depends on NCS_BM && MEMFAULT && !MULTITHREADING
	help
	  Use an irq_lock()-based implementation of memfault_lock()/memfault_unlock()
	  for bare-metal builds without Zephyr multithreading.

	  Memfault calls may originate from both the main loop and ISRs. This option
	  replaces the default Zephyr k_mutex-based lock with a critical-section lock.

	  See doc/nrf-bm/libraries/memfault.rst for rules on which Memfault APIs
	  may be called from each execution context.
```

## subsys/nfc/Kconfig
```kconfig
#
# Copyright (c) 2025 Nordic Semiconductor
#
# SPDX-License-Identifier: LicenseRef-Nordic-5-Clause
#

menu "NFC for Bare Metal"

# zephyr-keep-sorted-start
rsource "lib/Kconfig"
rsource "ndef/Kconfig"
rsource "t4t/Kconfig"
# zephyr-keep-sorted-stop

endmenu
```

## subsys/shell/backends/Kconfig
```kconfig
#
# Copyright (c) 2026 Nordic Semiconductor
#
# SPDX-License-Identifier: LicenseRef-Nordic-5-Clause
#

menu "Backends"

if SHELL_BACKENDS

rsource "Kconfig.bm_uarte"

endif # SHELL_BACKENDS

endmenu
```

## subsys/softperipheral/Kconfig
```kconfig
#
# Copyright (c) 2026 Nordic Semiconductor
#
# SPDX-License-Identifier: LicenseRef-Nordic-5-Clause
#

menuconfig BM_SOFTPERIPHERAL
	bool "Softperipheral is present"
	depends on NRFX_GPIOTE

if BM_SOFTPERIPHERAL

choice BM_SOFTPERIPHERAL_SELECTION
	prompt "Softperipheral selection"
	default BM_SOFTPERIPHERAL_NONE

config BM_SOFTPERIPHERAL_NONE
	bool "None"

config BM_SOFTPERIPHERAL_SCAN
	bool "sCAN"

config BM_SOFTPERIPHERAL_SEMMC
	bool "sEMMC"

config BM_SOFTPERIPHERAL_SQSPI
	bool "sQSPI"

endchoice # BM_SOFTPERIPHERAL_SELECTION

rsource "sCAN/Kconfig"
rsource "sEMMC/Kconfig"
rsource "sQSPI/Kconfig"

endif # BM_SOFTPERIPHERAL
```

## subsys/softperipheral/sCAN/Kconfig
```kconfig
#
# Copyright (c) 2026 Nordic Semiconductor
#
# SPDX-License-Identifier: LicenseRef-Nordic-5-Clause
#

if BM_SOFTPERIPHERAL_SCAN

menu "sCAN"

config BM_SOFTPERIPHERAL_SCAN_RXFILTER_MAX_BUFFER_SIZE
	int "Maximum size of the RXFILTER buffer"
	default 4

config BM_SOFTPERIPHERAL_SCAN_MAX_DATA_LENGTH
	int "Maximum number of bytes to send in a TX attempt"
	default 8

endmenu

endif # BM_SOFTPERIPHERAL_SCAN
```

## subsys/softperipheral/sEMMC/Kconfig
```kconfig
#
# Copyright (c) 2026 Nordic Semiconductor
#
# SPDX-License-Identifier: LicenseRef-Nordic-5-Clause
#

if BM_SOFTPERIPHERAL_SEMMC

menu "sEMMC"

config BM_SOFTPERIPHERAL_SEMMC_RESPONSE_SIZE
	int "Word size of eMMC response"
	default 4

config BM_SOFTPERIPHERAL_SEMMC_TRANSFERS_PER_REQUEST
	int "Transfers per request"
	default 1

endmenu

endif # BM_SOFTPERIPHERAL_SEMMC
```

## subsys/softperipheral/sQSPI/Kconfig
```kconfig
#
# Copyright (c) 2026 Nordic Semiconductor
#
# SPDX-License-Identifier: LicenseRef-Nordic-5-Clause
#

if BM_SOFTPERIPHERAL_SQSPI

menu "sQSPI"

config BM_SOFTPERIPHERAL_SQSPI_MAX_NUM_DATA_LINES
	int "Maximum data lines"
	range 1 8
	default 2

config BM_SOFTPERIPHERAL_SQSPI_TRANSFERS_PER_REQUEST
	int "Transfers per request"
	default 1

endmenu

endif # BM_SOFTPERIPHERAL_SQSPI
```

## tests/subsys/bootloader/upgrade/mcuboot_recovery_retention/testcase.yaml
```yaml
tests:
  boot.mcuboot_recovery_retention.uart:
    sysbuild: true
    integration_platforms:
      - bm_nrf54l15dk/nrf54l05/cpuapp/s115_softdevice/mcuboot
    platform_allow:
      - bm_nrf54l15dk/nrf54l05/cpuapp/s115_softdevice/mcuboot
      - bm_nrf54l15dk/nrf54l10/cpuapp/s115_softdevice/mcuboot
      - bm_nrf54l15dk/nrf54l15/cpuapp/s115_softdevice/mcuboot
      - bm_nrf54lv10dk/nrf54lv10a/cpuapp/s115_softdevice/mcuboot
      - bm_nrf54lv10dk/nrf54lv10a/cpuapp/s145_softdevice/mcuboot
      - bm_nrf54lm20dk/nrf54lm20a/cpuapp/s115_softdevice/mcuboot
      - bm_nrf54lm20dk/nrf54lm20a/cpuapp/s145_softdevice/mcuboot
    extra_args:
      - SB_CONFIG_BM_FIRMWARE_LOADER_UART_MCUMGR=y
    tags:
      - pytest
      - dfu
    timeout: 700
    harness: pytest
    harness_config:
      pytest_root:
        - "../pytest/test_dfu.py"

  boot.mcuboot_recovery_retention.uart.installer_delays:
    sysbuild: true
    integration_platforms:
      - bm_nrf54l15dk/nrf54l15/cpuapp/s115_softdevice/mcuboot
    platform_allow:
      - bm_nrf54l15dk/nrf54l05/cpuapp/s115_softdevice/mcuboot
      - bm_nrf54l15dk/nrf54l10/cpuapp/s115_softdevice/mcuboot
      - bm_nrf54l15dk/nrf54l15/cpuapp/s115_softdevice/mcuboot
      - bm_nrf54lv10dk/nrf54lv10a/cpuapp/s115_softdevice/mcuboot
      - bm_nrf54lv10dk/nrf54lv10a/cpuapp/s145_softdevice/mcuboot
      - bm_nrf54lm20dk/nrf54lm20a/cpuapp/s115_softdevice/mcuboot
      - bm_nrf54lm20dk/nrf54lm20a/cpuapp/s145_softdevice/mcuboot
    extra_args:
      - SB_CONFIG_BM_FIRMWARE_LOADER_UART_MCUMGR=y
      - installer_CONFIG_APP_BM_INSTALLER_SELF_DELAYS=y
      - installer_CONFIG_APP_BM_INSTALLER_PRIOR_SELF_DESTRUCTION_DELAY_MS=3000
    tags:
      - pytest
      - dfu
    timeout: 600
    harness: pytest
    harness_config:
      pytest_root:
        - "../pytest/test_dfu_installer.py"
```
