## tests/subsys/fs/bm_zms/testcase.yaml
```yaml
common:
  tags: bm_zms
tests:
  subsys.bm_zms:
    platform_allow:
      - native_sim
    integration_platforms:
      - native_sim
    extra_args:
      - CONFIG_BM_STORAGE_BACKEND_NATIVE_SIM=y
  subsys.bm_zms.cache:
    platform_allow:
      - native_sim
    integration_platforms:
      - native_sim
    extra_args:
      - CONFIG_BM_STORAGE_BACKEND_NATIVE_SIM=y
      - CONFIG_BM_ZMS_LOOKUP_CACHE=y
      - CONFIG_BM_ZMS_LOOKUP_CACHE_SIZE=64
  subsys.bm_zms.data_crc:
    platform_allow:
      - native_sim
    integration_platforms:
      - native_sim
    extra_args:
      - CONFIG_BM_STORAGE_BACKEND_NATIVE_SIM=y
      - CONFIG_BM_ZMS_DATA_CRC=y
  subsys.bm_zms.async:
    platform_allow:
      - native_sim
    integration_platforms:
      - native_sim
    extra_args:
      - CONFIG_BM_STORAGE_BACKEND_NATIVE_SIM=y
      - CONFIG_BM_STORAGE_BACKEND_NATIVE_SIM_ASYNC=y
  subsys.bm_zms.softdevice:
    platform_allow:
      - bm_nrf54l15dk/nrf54l05/cpuapp/s115_softdevice
      - bm_nrf54l15dk/nrf54l15/cpuapp/s115_softdevice
    extra_args:
      - CONFIG_SOFTDEVICE=y
  subsys.bm_zms.softdevice.cache:
    platform_allow:
      - bm_nrf54l15dk/nrf54l05/cpuapp/s115_softdevice
      - bm_nrf54l15dk/nrf54l15/cpuapp/s115_softdevice
    extra_args:
      - CONFIG_SOFTDEVICE=y
      - CONFIG_BM_ZMS_LOOKUP_CACHE=y
      - CONFIG_BM_ZMS_LOOKUP_CACHE_SIZE=64
  subsys.bm_zms.softdevice.data_crc:
    platform_allow:
      - bm_nrf54l15dk/nrf54l05/cpuapp/s115_softdevice
      - bm_nrf54l15dk/nrf54l15/cpuapp/s115_softdevice
    extra_args:
      - CONFIG_SOFTDEVICE=y
      - CONFIG_BM_ZMS_DATA_CRC=y
```

## west.yml
```yaml
# The west manifest file for NCS Bare Metal

manifest:
  defaults:
    remote: ncs

  remotes:
    - name: ncs
      url-base: https://github.com/nrfconnect

  projects:
    - name: nrf
      repo-path: sdk-nrf
      revision: v3.4.1
      import:
        name-allowlist:
          - cmsis
          - cmsis_6
          - dragoon
          - hal_nordic
          - lz4
          - mbedtls
          - mcuboot
          - memfault-firmware-sdk
          - nrfxlib
          - picolibc
          - oberon-psa-crypto
          - qcbor
          - segger
          - tinycrypt
          - zephyr
          - cmock
          - zcbor

  self:
    path: nrf-bm
```
