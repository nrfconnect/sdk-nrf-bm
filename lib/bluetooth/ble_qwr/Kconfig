## modules/Kconfig
```kconfig
#
# Copyright (c) 2025 Nordic Semiconductor
#
# SPDX-License-Identifier: LicenseRef-Nordic-5-Clause
#

menu "Modules"

# zephyr-keep-sorted-start
rsource "hal_nordic/Kconfig"
# zephyr-keep-sorted-stop

endmenu
```

## modules/hal_nordic/Kconfig
```kconfig
#
# Copyright (c) 2025 Nordic Semiconductor
#
# SPDX-License-Identifier: LicenseRef-Nordic-5-Clause
#

# zephyr-keep-sorted-start
rsource "nrfx/Kconfig"
# zephyr-keep-sorted-stop
```

## modules/mcuboot/Kconfig
```kconfig
#
# Copyright (c) 2024 Nordic Semiconductor ASA
#
# SPDX-License-Identifier: LicenseRef-Nordic-5-Clause
#

rsource "$(ZEPHYR_NRF_MODULE_DIR)/modules/mcuboot/Kconfig"

if MCUBOOT

config SOFTDEVICE_FILE
	string "SoftDevice file (DO NOT ALTER)"

config SOFTDEVICE_PAD_HEADER
	bool "Pad SoftDevice header (DO NOT ALTER)"

config SOFTDEVICE_VERSION
	string "SoftDevice signing version (DO NOT ALTER)"
	default "0.0.0+0"

config SOFTDEVICE_START_OFFSET
	hex
	default 0x800 if SOC_SERIES_NRF54L
	default 0x200

endif # MCUBOOT
```

## modules/nrf/Kconfig
```kconfig
#
# Copyright (c) 2025 Nordic Semiconductor ASA
#
# SPDX-License-Identifier: LicenseRef-Nordic-5-Clause
#

if !NCS_BM || MCUBOOT || ARCH_POSIX

source "$ZEPHYR_NRF_MODULE_DIR/Kconfig.nrf"

endif # !NCS_BM || MCUBOOT || ARCH_POSIX
```

## modules/nrf/sysbuild/Kconfig
```kconfig
#
# Copyright (c) 2025 Nordic Semiconductor ASA
#
# SPDX-License-Identifier: LicenseRef-Nordic-5-Clause
#

if !NCS_BM

source "$ZEPHYR_NRF_MODULE_DIR/sysbuild/Kconfig.sysbuild"

endif # !NCS_BM
```

## samples/Kconfig
```kconfig
#
# Copyright (c) 2024 Nordic Semiconductor
#
# SPDX-License-Identifier: LicenseRef-Nordic-5-Clause
#

# This file provides a basic set of Kconfig requirements for samples in this repo

# All these samples shall run without multithreading
config MULTITHREADING
	default n if (!UNITY && !(ZTEST && BOARD_NATIVE_SIM))

# Software ISR table is not needed if multithreading is not used
config GEN_SW_ISR_TABLE
	default n if !MULTITHREADING

# Prevent moving SoftDevice RAM region
# Need this when building without sysbuild
config PARTITION_MANAGER_ENABLED
	default n
```

## samples/nfc/record_text/Kconfig
```kconfig
#
# Copyright (c) 2025 Nordic Semiconductor ASA
#
# SPDX-License-Identifier: LicenseRef-Nordic-5-Clause
#

menu "NFC Text Record sample"

module=APP_NFC_TEXT_RECORD
module-str=NFC Text Record Sample
source "$(ZEPHYR_BASE)/subsys/logging/Kconfig.template.log_config"

endmenu # "NFC Text Record sample"

source "Kconfig.zephyr"
```
