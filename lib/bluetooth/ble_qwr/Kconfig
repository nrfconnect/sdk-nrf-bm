## lib/bluetooth/ble_qwr/Kconfig
```kconfig
#
# Copyright (c) 2025 Nordic Semiconductor
#
# SPDX-License-Identifier: LicenseRef-Nordic-5-Clause
#
menuconfig BLE_QWR
	bool "Queued writes"
	depends on SOFTDEVICE
	depends on NRF_SDH_BLE

if BLE_QWR

config BLE_QWR_MAX_ATTR
	int "Maximum queued writes attributes"
	default 0
	help
	   Maximum queued writes attributes

module=BLE_QWR
module-str=BLE QWR
source "$(ZEPHYR_BASE)/subsys/logging/Kconfig.template.log_config"

endif
```

## lib/bluetooth/ble_radio_notification/Kconfig
```kconfig
#
# Copyright (c) 2025 Nordic Semiconductor
#
# SPDX-License-Identifier: LicenseRef-Nordic-5-Clause
#
menuconfig BLE_RADIO_NOTIFICATION
	bool "Bluetooth LE Radio Notification"
	depends on SOFTDEVICE

if BLE_RADIO_NOTIFICATION

choice BLE_RADIO_NOTIFICATION_TYPE
	prompt "Radio notification type"
	default BLE_RADIO_NOTIFICATION_ON_BOTH

config BLE_RADIO_NOTIFICATION_ON_ACTIVE
	bool "On active"

config BLE_RADIO_NOTIFICATION_ON_INACTIVE
	bool "On inactive"

config BLE_RADIO_NOTIFICATION_ON_BOTH
	bool "On both active and inactive"

endchoice # BLE_RADIO_NOTIFICATION_TYPE

config BLE_RADIO_NOTIFICATION_IRQ_PRIO
	int "Bluetooth LE Radio Notification IRQ priority"
	range 5 7
	default 5
	help
	  Sets the interrupt priority of the Bluetooth LE radio notification event (SWI02).
	  Levels are from 5 (highest priority) to 7 (lowest priority).
	  Interrupt priority level must be greater than 4 (SoftDevice low priority).

module=BLE_RADIO_NOTIFICATION
module-str=BLE Radio Notification
source "$(ZEPHYR_BASE)/subsys/logging/Kconfig.template.log_config"

endif # BLE_RADIO_NOTIFICATION
```

## lib/bm_buttons/Kconfig
```kconfig
#
# Copyright (c) 2025 Nordic Semiconductor
#
# SPDX-License-Identifier: LicenseRef-Nordic-5-Clause
#

menuconfig BM_BUTTONS
	bool "Buttons library"
	depends on BM_TIMER
	help
	  A library to manage buttons.

if BM_BUTTONS

config BM_BUTTONS_NUM_PINS
	int "Number of available pins for buttons"
	range 1 24 if SOC_SERIES_NRF54LX
	default 24 if SOC_SERIES_NRF54LX

module=BM_BUTTONS
module-str=Buttons library
source "$(ZEPHYR_BASE)/subsys/logging/Kconfig.template.log_config"

endif
```

## lib/bm_fifo/Kconfig
```kconfig
#
# Copyright (c) 2025 Nordic Semiconductor
#
# SPDX-License-Identifier: LicenseRef-Nordic-5-Clause
#
menuconfig BM_FIFO
	bool "FIFO queue library"
	help
	  A simple FIFO queue using a circular buffer.

if BM_FIFO

module=BM_FIFO
module-dep=LOG
module-str=FIFO library
source "${ZEPHYR_BASE}/subsys/logging/Kconfig.template.log_config"

endif
```

## lib/bm_gpiote/Kconfig
```kconfig
#
# Copyright (c) 2026 Nordic Semiconductor
#
# SPDX-License-Identifier: LicenseRef-Nordic-5-Clause
#

menuconfig BM_GPIOTE
	bool "GPIOTE library"
	depends on NRFX_GPIOTE
	help
	  A library to manage GPIOTE.

if BM_GPIOTE

config BM_GPIOTE_IRQ_PRIO
	int "GPIOTE IRQ priority"
	range 2 7
	default 5 if SOFTDEVICE
	default 3
	help
	  Sets the interrupt priority of the GPIOTE peripherals used by the library.
	  Levels are from 2 (highest priority) to 7 (lowest priority).
	  Interrupt priority level must be greater than 4 (softdevice low priority)
	  if you want to call into softdevice from the gpiote driver.

module=BM_GPIOTE
module-str=GPIOTE library
source "$(ZEPHYR_BASE)/subsys/logging/Kconfig.template.log_config"

endif
```

## lib/bm_queue/Kconfig
```kconfig
#
# Copyright (c) 2025 Nordic Semiconductor
#
# SPDX-License-Identifier: LicenseRef-Nordic-5-Clause
#
menuconfig BM_QUEUE
	bool "Queue library"
	help
	  A simple, dynamic queue using singly linked lists.

if BM_QUEUE

config BM_QUEUE_K_QUEUE_COMPAT
	bool "Export k_queue compatible API"
	depends on !MULTITHREADING
	help
	  Export a k_queue compatible API for compatibility with Zephyr subsystems.

module=BM_QUEUE
module-dep=LOG
module-str=Queue library
source "${ZEPHYR_BASE}/subsys/logging/Kconfig.template.log_config"

endif
```

## lib/bm_scheduler/Kconfig
```kconfig
#
# Copyright (c) 2024 Nordic Semiconductor
#
# SPDX-License-Identifier: LicenseRef-Nordic-5-Clause
#
menuconfig BM_SCHEDULER
	bool "Event scheduler"
	# Memory management is available without multi-threading
	depends on KERNEL_MEM_POOL
	help
	  A library to defer event processing to main().

if BM_SCHEDULER

config BM_SCHEDULER_BUF_SIZE
	int "Event buffer size"
	# Maximum BLE event length is 500 (w/ 247 MTU)
	default 512
	help
	  Size of the buffer that events will be copied into.
	  This is a dedicated heap.

module=BM_SCHEDULER
module-str=Event scheduler
source "$(ZEPHYR_BASE)/subsys/logging/Kconfig.template.log_config"

endif
```

## lib/bm_timer/Kconfig
```kconfig
#
# Copyright (c) 2025 Nordic Semiconductor
#
# SPDX-License-Identifier: LicenseRef-Nordic-5-Clause
#
menuconfig BM_TIMER
	bool "Timer library"
	depends on SOFTDEVICE || CLOCK_CONTROL
	help
	  A library to create and use multiple timer instances
	  based on a single RTC peripheral.

if BM_TIMER

config BM_TIMER_IRQ_PRIO
	int "Timer interrupt priority (NVIC level)"
	range 0 8
	default 5 if SOFTDEVICE
	default 3
	help
	  Interrupt priority level must be greater than 4 (softdevice low priority)
	  when softdevice is used.

module=BM_TIMER
module-dep=LOG
module-str=Bare Metal Timer
source "${ZEPHYR_BASE}/subsys/logging/Kconfig.template.log_config"

endif # BM_TIMER
```

## lib/bm_util/Kconfig
```kconfig
#
# Copyright (c) 2025 Nordic Semiconductor
#
# SPDX-License-Identifier: LicenseRef-Nordic-5-Clause
#

menuconfig BM_UTIL
	bool "Utilities library"
	help
	  A library with common utilities.
```

## lib/bm_zms/Kconfig
```kconfig
#
# Copyright (c) 2025 Nordic Semiconductor ASA
#
# SPDX-License-Identifier: LicenseRef-Nordic-5-Clause
#

menuconfig BM_ZMS
	bool "Bare Metal Zephyr Memory Storage [EXPERIMENTAL]"
	select CRC
	select RING_BUFFER
	select BM_STORAGE
	select EXPERIMENTAL
	help
	  Bare Metal Zephyr Memory Storage library.

if BM_ZMS

config BM_ZMS_LOOKUP_CACHE
	bool "BM_ZMS lookup cache"
	help
	  Enable BM_ZMS cache to reduce the BM_ZMS data lookup time.
	  Each cache entry holds an address of the most recent allocation
	  table entry (ATE) for all BM_ZMS IDs that fall into that cache position.

config BM_ZMS_LOOKUP_CACHE_SIZE
	int "BM_ZMS lookup cache size"
	range 1 65536
	default 128
	depends on BM_ZMS_LOOKUP_CACHE
	help
	  Number of entries in the BM_ZMS lookup cache.
	  Every additional entry in cache will use 8 bytes of RAM.

config BM_ZMS_DATA_CRC
	bool "BM_ZMS data CRC"

config BM_ZMS_CUSTOMIZE_BLOCK_SIZE
	bool "Customize the size of the buffer used internally for reads and writes"
	help
	  BM_ZMS uses an internal buffer to read/write and compare stored data.
	  Increasing the size of this buffer should be done carefully in order to not
	  overflow the stack.
	  Increasing it makes BM_ZMS able to work with storage devices
	  that have a larger `write-block-size` (which decreases the performance of BM_ZMS).

config BM_ZMS_CUSTOM_BLOCK_SIZE
	int "BM_ZMS internal buffer size"
	depends on BM_ZMS_CUSTOMIZE_BLOCK_SIZE
	default 32
	help
	  Changes the internal buffer size of BM_ZMS.

config BM_ZMS_LOOKUP_CACHE_FOR_SETTINGS
	bool "BM_ZMS Storage lookup cache optimized for settings"
	depends on BM_ZMS_LOOKUP_CACHE && SETTINGS_BM_ZMS
	help
	  Enable usage of lookup cache based on hashes to get, the best BM_ZMS performance,
	  provided that the BM_ZMS is used only for the purpose of providing the settings
	  backend. This option should NOT be enabled if the BM_ZMS is also written to
	  directly, outside the settings layer.

config BM_ZMS_MAX_USERS
	int "BM_ZMS maximum users"
	default 8
	help
	  Defines the maximum number of event handlers that can be registred by the user.

config BM_ZMS_OP_QUEUE_SIZE
	int "BM_ZMS operations queue size"
	default 16
	help
	  defines the maximum number of operations that can be queued in BM_ZMS

module=BM_ZMS
module-dep=LOG
module-str=BM_ZMS
source "subsys/logging/Kconfig.template.log_config"

endif # BM_ZMS
```

## lib/boot_banner/Kconfig
```kconfig
#
# Copyright (c) 2025 Nordic Semiconductor ASA
#
# SPDX-License-Identifier: LicenseRef-Nordic-5-Clause
#

menuconfig NCS_BARE_METAL_BOOT_BANNER
	bool "NCS Bare Metal boot banner"
	depends on !NCS_BOOT_BANNER
	default y
	select PRINTK
	select EARLY_CONSOLE
	help
	  This option provides an enhanced boot banner output that can include application name
	  and version (if set), NCS Bare Metal version and underlying Zephyr version.

if NCS_BARE_METAL_BOOT_BANNER

config NCS_BARE_METAL_APPLICATION_BOOT_BANNER_STRING
	string "Boot banner string" if "$(APP_VERSION_EXTENDED_STRING)" != ""
	default "My Application" if "$(APP_VERSION_EXTENDED_STRING)" != ""
	help
	  Use this option to set the application boot banner.

config NCS_BARE_METAL_BOOT_BANNER_STRING
	string
	default "nRF Connect SDK Bare Metal"

config NCS_BARE_METAL_ZEPHYR_BOOT_BANNER
	bool "Include Zephyr OS banner"

config NCS_BARE_METAL_ZEPHYR_BOOT_BANNER_STRING
	string
	default "Zephyr OS [no multithreading]"
	depends on NCS_BARE_METAL_ZEPHYR_BOOT_BANNER

endif # NCS_BOOT_BANNER
```

## lib/conn_state/Kconfig
```kconfig
#
# Copyright (c) 2025 Nordic Semiconductor
#
# SPDX-License-Identifier: LicenseRef-Nordic-5-Clause
#
menuconfig CONN_STATE
	bool "Event scheduler"
	help
	  A library to defer event processing to main().

if CONN_STATE

config BLE_CONN_STATE_USER_FLAG_COUNT
	int "User flag count"
	range 0 24
	default 24
	help
	   The number of available user flags.

config BLE_CONN_STATE_DEFAULT_FLAG_COLLECTION_COUNT
	int "Default flag collection count"
	default 6
	help
	   The number of flags kept for each connection, excluding user flags.

module=CONN_STATE
module-dep=LOG
module-str=Connection state
source "${ZEPHYR_BASE}/subsys/logging/Kconfig.template.log_config"

endif
```

## lib/event_scheduler/Kconfig
```kconfig
#
# Copyright (c) 2024 Nordic Semiconductor
#
# SPDX-License-Identifier: LicenseRef-Nordic-5-Clause
#
menuconfig EVENT_SCHEDULER
	bool "Event scheduler"
	help
	  A library to defer event processing to main().

if EVENT_SCHEDULER

config EVENT_SCHEDULER_BUF_SIZE
	int "Event buffer size"
	# Maximum BLE event length is 500 (w/ 247 MTU)
	default 512
	help
	  Size of the buffer that events will be copied into.
	  This is a dedicated heap.

module=EVENT_SCHEDULER
module-dep=LOG
module-str=Event scheduler
source "${ZEPHYR_BASE}/subsys/logging/Kconfig.template.log_config"

endif
```

## lib/lite_buttons/Kconfig
```kconfig
#
# Copyright (c) 2025 Nordic Semiconductor
#
# SPDX-License-Identifier: LicenseRef-Nordic-5-Clause
#

menuconfig LITE_BUTTONS
	bool "Buttons library"
	depends on NRFX_GPIOTE0
	depends on LITE_TIMER
	help
	  A library to manage buttons.

if LITE_BUTTONS

config LITE_BUTTONS_NUM_PINS
	int "Number of available pins for buttons"
	range 1 32 if SOC_SERIES_NRF52X
	range 1 24 if SOC_SERIES_NRF54LX
	default 32 if SOC_SERIES_NRF52X
	default 24 if SOC_SERIES_NRF54LX

module=LITE_BUTTONS
module-dep=LOG
module-str=Lite Buttons
source "${ZEPHYR_BASE}/subsys/logging/Kconfig.template.log_config"

endif
```

## lib/lite_timer/Kconfig
```kconfig
#
# Copyright (c) 2025 Nordic Semiconductor
#
# SPDX-License-Identifier: LicenseRef-Nordic-5-Clause
#
menuconfig LITE_TIMER
	bool "Timer library"
	depends on SOFTDEVICE || CLOCK_CONTROL
	help
	  A library to create and use multiple timer instances
	  based on a single RTC peripheral.

if LITE_TIMER

config LITE_TIMER_IRQ_PRIO
	int "Timer interrupt priority (NVIC level)"
	range 0 8
	default 5 if SOFTDEVICE
	default 3
	help
	  Interrupt priority level must be greater than 4 (softdevice low priority)
	  when softdevice is used.

module=LITE_TIMER
module-dep=LOG
module-str=Lite Timer
source "${ZEPHYR_BASE}/subsys/logging/Kconfig.template.log_config"

endif # LITE_TIMER
```

## lib/nrf_ble_qwr/Kconfig
```kconfig
#
# Copyright (c) 2025 Nordic Semiconductor
#
# SPDX-License-Identifier: LicenseRef-Nordic-5-Clause
#
menuconfig NRF_BLE_QWR
	bool "Queued writes"

if NRF_BLE_QWR

config NRF_BLE_QWR_MAX_ATTR
	int "Maximum queued writes attributes"
	default 0
	help
	   Maximum queued writes attributes

config NRF_BLE_QWR_BLE_OBSERVER_PRIO
	int "BLE observer priority"
	default 2

module=NRF_BLE_QWR
module-dep=LOG
module-str=nRF Lite BLE QWR
source "${ZEPHYR_BASE}/subsys/logging/Kconfig.template.log_config"

endif
```

## lib/peer_manager/Kconfig
```kconfig
#
# Copyright (c) 2025 Nordic Semiconductor
#
# SPDX-License-Identifier: LicenseRef-Nordic-5-Clause
#

menuconfig PEER_MANAGER
	bool "Peer Manager"
	depends on SOFTDEVICE
	depends on NRF_SDH
	depends on BLE_CONN_STATE
	depends on BM_TIMER
	depends on BM_ZMS
	select EXPERIMENTAL
	help
	  Peer Manager library.

if PEER_MANAGER

config PM_BM_ZMS_SECTOR_SIZE
	int "BM_ZMS sector size"
	default 1024

config PM_BLE_OBSERVER_PRIO
	int "BLE events priority"
	default 1
	help
	  Priority with which BLE events are dispatched to the Peer Manager module.

config PM_MAX_REGISTRANTS
	int "Maximum number of event handlers that can be registered"
	default 3

config PM_FLASH_BUFFERS
	int "Number of internal buffers for non-volatile storage operations"
	default 4
	help
	  Decrease this value to reduce RAM usage.

config PM_SERVICE_CHANGED
	bool "Service changed management for GATT server"
	default y
	help
	  Disable this option to reduce memory usage if not using a GATT server, or using a server
	  without a service changed characteristic.

config PM_PEER_RANKS
	bool "Peer rank management"
	default y
	help
	  Disable this option to reduce memory usage if not using the peer rank API.

config PM_LESC
	bool "LE Secure Connections (LESC) support"
	depends on PSA_WANT_ALG_ECDH
	depends on PSA_WANT_GENERATE_RANDOM
	depends on PSA_WANT_KEY_TYPE_ECC_KEY_PAIR_GENERATE
	depends on PSA_WANT_KEY_TYPE_ECC_KEY_PAIR_IMPORT
	depends on PSA_WANT_KEY_TYPE_ECC_KEY_PAIR_EXPORT
	depends on PSA_WANT_ECC_SECP_R1_256
	depends on (MBEDTLS_PSA_STATIC_KEY_SLOTS && MBEDTLS_PSA_KEY_SLOT_COUNT >= 1) || \
		   MBEDTLS_ENABLE_HEAP

	help
	  If enabled, you need to call nrf_ble_lesc_request_handler() in the main loop to
	  respond to LESC-related BLE events. If LESC support is not required, disable this option
	  to reduce memory usage.

if PM_LESC

config PM_LESC_GENERATE_NEW_KEYS
	bool "Generate new LESC key pair after every pairing attempt"
	help
	  New LESC keys are generated on the auth status event.

config PM_LESC_PRIVATE_KEY_EXPORT
	bool "Export private key for debugging purposes"
	help
	  Export private key.
	  This is for for debugging purposes only and is not to be used in production!

endif # PM_LESC

config PM_RA_PROTECTION
	bool "Protection against repeated pairing attempts"
	help
	  Enable protection against repeated Bluetooth pairing attempts from the same device.
	  Offending peers will be temporarily blacklisted with increasing backoff times to
	  prevent pairing spam or brute-force attacks.

if PM_RA_PROTECTION

config PM_RA_PROTECTION_TRACKED_PEERS_NUM
	int "Maximum number of peers whose authorization status can be tracked"
	default 8

config PM_RA_PROTECTION_MIN_WAIT_INTERVAL
	int "Minimum waiting interval (in ms) before a new pairing attempt can be initiated"
	default 4000

config PM_RA_PROTECTION_MAX_WAIT_INTERVAL
	int "Maximum waiting interval (in ms) before a new pairing attempt can be initiated"
	default 64000

config PM_RA_PROTECTION_REWARD_PERIOD
	int "Reward period (in ms)"
	default 10000
	help
	  The waiting interval is gradually decreased when no new failed pairing attempts are made
	  during reward period.

endif # PM_RA_PROTECTION

config PM_HANDLER_SEC_DELAY_MS
	int "Delay before starting security"
	default 0
	help
	  This might be necessary for interoperability reasons, especially as peripheral.

module=PEER_MANAGER
module-str=Peer Manager
source "${ZEPHYR_BASE}/subsys/logging/Kconfig.template.log_config"

endif # PEER_MANAGER
```

## lib/zephyr_queue/Kconfig
```kconfig
#
# Copyright (c) 2025 Nordic Semiconductor ASA
#
# SPDX-License-Identifier: LicenseRef-Nordic-5-Clause
#

config ZEPHYR_QUEUE
	bool "Zephyr queue implementation"
	help
	  Includes support for the k_queue_* functions from upstream zephyr
```
