## boards/nordic/bm_nrf54ls05dk/bm_nrf54ls05dk_nrf54ls05b_cpuapp_s115_softdevice_defconfig
```kconfig
#
# Copyright (c) 2026 Nordic Semiconductor ASA
#
# SPDX-License-Identifier: LicenseRef-Nordic-5-Clause
#

# Enable console
CONFIG_CONSOLE=y
CONFIG_BM_UARTE_CONSOLE=y

# Remove boot banner
CONFIG_NCS_BOOT_BANNER=n
CONFIG_BOOT_BANNER=n

# Enable MPU
CONFIG_ARM_MPU=y

# Enable hardware stack protection
CONFIG_HW_STACK_PROTECTION=y

# MPU-based null-pointer dereferencing detection cannot
# be applied as the (0x0 - 0x400) is unmapped for this target.
CONFIG_NULL_POINTER_EXCEPTION_DETECTION_NONE=y

# Enable Cache
CONFIG_CACHE_MANAGEMENT=y
CONFIG_EXTERNAL_CACHE=y

# Start SYSCOUNTER on driver init
CONFIG_NRF_GRTC_START_SYSCOUNTER=y

# Disable partition manager
CONFIG_PARTITION_MANAGER_ENABLED=n

# Disable multithreading
CONFIG_MULTITHREADING=n
CONFIG_ZERO_LATENCY_IRQS=y

# Disable generation of the redundant SW ISR table
CONFIG_GEN_SW_ISR_TABLE=n

# Allow FLASH writes
CONFIG_MPU_ALLOW_FLASH_WRITE=y

# Shrink
CONFIG_GPIO=n

# Enable all NRFX drivers
CONFIG_NRFX_CLOCK=y
CONFIG_NRFX_CLOCK_LFXO_TWO_STAGE_ENABLED=y
CONFIG_NRFX_EGU10=y
CONFIG_NRFX_EGU20=y
CONFIG_NRFX_GPIOTE20=y
CONFIG_NRFX_GPIOTE30=y
CONFIG_NRFX_GPPI=y
CONFIG_NRFX_POWER=y
CONFIG_NRFX_PWM=y
CONFIG_NRFX_QDEC=y
CONFIG_NRFX_RRAMC=y
CONFIG_NRFX_SAADC=y
CONFIG_NRFX_SPIS=y
CONFIG_NRFX_SPIM=y
CONFIG_NRFX_SYSTICK=y
CONFIG_NRFX_TEMP=y
CONFIG_NRFX_TIMER=y
CONFIG_NRFX_TWIM=y
CONFIG_NRFX_TWIS=y
CONFIG_NRFX_UARTE=y
CONFIG_NRFX_WDT=y
# Disable all Peripheral Resource Sharing (PRS) boxes
CONFIG_NRFX_PRS_BOX_0=n
CONFIG_NRFX_PRS_BOX_1=n
CONFIG_NRFX_PRS_BOX_2=n
```

## boards/nordic/bm_nrf54ls05dk/board.yml
```yaml
board:
  name: bm_nrf54ls05dk
  full_name: Bare Metal nRF54LS05 DK
  vendor: nordic
  socs:
    - name: nrf54ls05b
      variants:
        - name: s115_softdevice
          cpucluster: cpuapp
          variants:
            - name: mcuboot
        - name: s145_softdevice
          cpucluster: cpuapp
          variants:
            - name: mcuboot
runners:
  run_once:
    '--recover':
      - runners:
          - nrfjprog
          - nrfutil
        run: first
        groups:
          - boards:
              - bm_nrf54ls05dk/nrf54ls05b/cpuapp
              - bm_nrf54ls05dk/nrf54ls05b/cpuapp/s115_softdevice
              - bm_nrf54ls05dk/nrf54ls05b/cpuapp/s115_softdevice/mcuboot
              - bm_nrf54ls05dk/nrf54ls05b/cpuapp/s145_softdevice
              - bm_nrf54ls05dk/nrf54ls05b/cpuapp/s145_softdevice/mcuboot
    '--erase':
      - runners:
          - nrfjprog
          - jlink
          - nrfutil
        run: first
        groups:
          - boards:
              - bm_nrf54ls05dk/nrf54ls05b/cpuapp
              - bm_nrf54ls05dk/nrf54ls05b/cpuapp/s115_softdevice
              - bm_nrf54ls05dk/nrf54ls05b/cpuapp/s115_softdevice/mcuboot
              - bm_nrf54ls05dk/nrf54ls05b/cpuapp/s145_softdevice
              - bm_nrf54ls05dk/nrf54ls05b/cpuapp/s145_softdevice/mcuboot
    '--reset':
      - runners:
          - nrfjprog
          - jlink
          - nrfutil
        run: last
        groups:
          - boards:
              - bm_nrf54ls05dk/nrf54ls05b/cpuapp
              - bm_nrf54ls05dk/nrf54ls05b/cpuapp/s115_softdevice
              - bm_nrf54ls05dk/nrf54ls05b/cpuapp/s115_softdevice/mcuboot
              - bm_nrf54ls05dk/nrf54ls05b/cpuapp/s145_softdevice
              - bm_nrf54ls05dk/nrf54ls05b/cpuapp/s145_softdevice/mcuboot
```

## boards/nordic/bm_nrf54lv10dk/Kconfig
```kconfig
#
# Copyright (c) 2026 Nordic Semiconductor ASA
#
# SPDX-License-Identifier: LicenseRef-Nordic-5-Clause
#

config BOARD_BM_NRF54LV10DK
	select BOARD_LATE_INIT_HOOK
```

## boards/nordic/bm_nrf54lv10dk/Kconfig.bm_nrf54lv10dk
```kconfig
#
# Copyright (c) 2026 Nordic Semiconductor ASA
#
# SPDX-License-Identifier: LicenseRef-Nordic-5-Clause
#

config BOARD_BM_NRF54LV10DK
	select SOC_NRF54LV10A_CPUAPP if BOARD_BM_NRF54LV10DK_NRF54LV10A_CPUAPP_S115_SOFTDEVICE || \
					BOARD_BM_NRF54LV10DK_NRF54LV10A_CPUAPP_S115_SOFTDEVICE_MCUBOOT || \
					BOARD_BM_NRF54LV10DK_NRF54LV10A_CPUAPP_S145_SOFTDEVICE || \
					BOARD_BM_NRF54LV10DK_NRF54LV10A_CPUAPP_S145_SOFTDEVICE_MCUBOOT
```

## boards/nordic/bm_nrf54lv10dk/Kconfig.defconfig
```kconfig
#
# Copyright (c) 2026 Nordic Semiconductor ASA
#
# SPDX-License-Identifier: LicenseRef-Nordic-5-Clause
#

config ROM_START_OFFSET
	default 0x800 if BOOTLOADER_MCUBOOT

choice NRF_GRTC_TIMER_SOURCE
	default NRF_GRTC_TIMER_SOURCE_LFLPRC if !$(dt_nodelabel_enabled,lfxo)
endchoice
```

## boards/nordic/bm_nrf54lv10dk/Kconfig.sysbuild
```kconfig
#
# Copyright (c) 2026 Nordic Semiconductor ASA
#
# SPDX-License-Identifier: LicenseRef-Nordic-5-Clause
#

config PARTITION_MANAGER
	default n

if BOARD_BM_NRF54LV10DK_NRF54LV10A_CPUAPP_S115_SOFTDEVICE || \
	BOARD_BM_NRF54LV10DK_NRF54LV10A_CPUAPP_S115_SOFTDEVICE_MCUBOOT

choice SOFTDEVICE_SELECTION
	default SOFTDEVICE_S115
endchoice

endif # BOARD_BM_NRF54LV10DK_NRF54LV10A_CPUAPP_S115_SOFTDEVICE || \
	# BOARD_BM_NRF54LV10DK_NRF54LV10A_CPUAPP_S115_SOFTDEVICE_MCUBOOT

if BOARD_BM_NRF54LV10DK_NRF54LV10A_CPUAPP_S145_SOFTDEVICE || \
	BOARD_BM_NRF54LV10DK_NRF54LV10A_CPUAPP_S145_SOFTDEVICE_MCUBOOT

choice SOFTDEVICE_SELECTION
	default SOFTDEVICE_S145
endchoice

endif # BOARD_BM_NRF54LV10DK_NRF54LV10A_CPUAPP_S145_SOFTDEVICE || \
	# BOARD_BM_NRF54LV10DK_NRF54LV10A_CPUAPP_S145_SOFTDEVICE_MCUBOOT


# Kconfigs for all MCUboot board variants
if BOARD_BM_NRF54LV10DK_NRF54LV10A_CPUAPP_S115_SOFTDEVICE_MCUBOOT || \
	BOARD_BM_NRF54LV10DK_NRF54LV10A_CPUAPP_S145_SOFTDEVICE_MCUBOOT

choice BM_BOOTLOADER
	default BM_BOOTLOADER_MCUBOOT
endchoice

choice BM_BOOTLOADER_MCUBOOT_SIGNATURE_TYPE
	default BM_BOOTLOADER_MCUBOOT_SIGNATURE_TYPE_ED25519
endchoice

config BM_BOOTLOADER_MCUBOOT_SIGNATURE_USING_KMU
	default y

choice BM_BOOTLOADER_MCUBOOT_IMG_HASH_ALG
	default BM_BOOT_IMG_HASH_ALG_PURE
endchoice

choice BM_FIRMWARE_LOADER
	default BM_FIRMWARE_LOADER_BT_MCUMGR
endchoice

config BM_BOOTLOADER_MCUBOOT_FIRMWARE_LOADER_ENTRANCE_BOOT_MODE
	default y

endif # BOARD_BM_NRF54LV10DK_NRF54LV10A_CPUAPP_S115_SOFTDEVICE_MCUBOOT ||
	# BOARD_BM_NRF54LV10DK_NRF54LV10A_CPUAPP_S145_SOFTDEVICE_MCUBOOT
```

## boards/nordic/bm_nrf54lv10dk/board.yml
```yaml
board:
  name: bm_nrf54lv10dk
  full_name: Bare Metal nRF54LV10A DK
  vendor: nordic
  socs:
    - name: nrf54lv10a
      variants:
        - name: s115_softdevice
          cpucluster: cpuapp
          variants:
            - name: mcuboot
        - name: s145_softdevice
          cpucluster: cpuapp
          variants:
            - name: mcuboot
runners:
  run_once:
    '--recover':
      - runners:
          - nrfjprog
          - nrfutil
        run: first
        groups:
          - boards:
              - bm_nrf54lv10dk/nrf54lv10a/cpuapp
              - bm_nrf54lv10dk/nrf54lv10a/cpuapp/s115_softdevice
              - bm_nrf54lv10dk/nrf54lv10a/cpuapp/s115_softdevice/mcuboot
              - bm_nrf54lv10dk/nrf54lv10a/cpuapp/s145_softdevice
              - bm_nrf54lv10dk/nrf54lv10a/cpuapp/s145_softdevice/mcuboot
    '--erase':
      - runners:
          - nrfjprog
          - jlink
          - nrfutil
        run: first
        groups:
          - boards:
              - bm_nrf54lv10dk/nrf54lv10a/cpuapp
              - bm_nrf54lv10dk/nrf54lv10a/cpuapp/s115_softdevice
              - bm_nrf54lv10dk/nrf54lv10a/cpuapp/s115_softdevice/mcuboot
              - bm_nrf54lv10dk/nrf54lv10a/cpuapp/s145_softdevice
              - bm_nrf54lv10dk/nrf54lv10a/cpuapp/s145_softdevice/mcuboot
    '--reset':
      - runners:
          - nrfjprog
          - jlink
          - nrfutil
        run: last
        groups:
          - boards:
              - bm_nrf54lv10dk/nrf54lv10a/cpuapp
              - bm_nrf54lv10dk/nrf54lv10a/cpuapp/s115_softdevice
              - bm_nrf54lv10dk/nrf54lv10a/cpuapp/s115_softdevice/mcuboot
              - bm_nrf54lv10dk/nrf54lv10a/cpuapp/s145_softdevice
              - bm_nrf54lv10dk/nrf54lv10a/cpuapp/s145_softdevice/mcuboot
```
