## Kconfig.nrf-lite
```kconfig
#
# Copyright (c) 2024 Nordic Semiconductor ASA
#
# SPDX-License-Identifier: LicenseRef-Nordic-5-Clause
#

config NRF_LITE
	bool
	default y

rsource "lib/Kconfig"
#rsource "samples/Kconfig"
rsource "subsys/Kconfig"
```

## applications/softdevice/Kconfig
```kconfig
#
# Copyright (c) 2025 Nordic Semiconductor ASA
#
# SPDX-License-Identifier: LicenseRef-Nordic-5-Clause
#

config SOFTDEVICE_FILE
	string "SoftDevice file (informative only, do not change)"

source "Kconfig.zephyr"
```

## boards/nordic/bm_nrf54l05_template/Kconfig.bm_nrf54l05_template
```kconfig
#
# Copyright (c) 2025 Nordic Semiconductor
#
# SPDX-License-Identifier: LicenseRef-Nordic-5-Clause
#

# Update to match your board name
config BOARD_BM_NRF54L05_TEMPLATE
	select SOC_NRF54L05_CPUAPP
```

## boards/nordic/bm_nrf54l05_template/Kconfig.sysbuild
```kconfig
# Copyright (c) 2025 Nordic Semiconductor ASA
# SPDX-License-Identifier: Apache-2.0

# No changes needed to this file

menuconfig PARTITION_MANAGER
	bool "Partition Manager"
	default n
```

## boards/nordic/bm_nrf54l05_template/board.yml
```yaml
board:
  name: bm_nrf54l05_template # Your board name
  full_name: Bare Metal nRF54L05 Template Board # Your full board name
  vendor: nordic
  socs:
  - name: nrf54l05
    variants:
    - name: no_softdevice
      cpucluster: cpuapp
    - name: s115
      cpucluster: cpuapp
```

## boards/nordic/bm_nrf54l10_template/board.yml
```yaml
board:
  name: bm_nrf54l10_template # Your board name
  full_name: Bare Metal nRF54L10 Template Board # Your full board name
  vendor: nordic
  socs:
  - name: nrf54l10
    variants:
    - name: no_softdevice
      cpucluster: cpuapp
    - name: s115
      cpucluster: cpuapp
```

## boards/nordic/bm_nrf54l15_template/Kconfig.bm_nrf54l15_template
```kconfig
#
# Copyright (c) 2025 Nordic Semiconductor
#
# SPDX-License-Identifier: LicenseRef-Nordic-5-Clause
#

# Update to match your board name
config BOARD_BM_NRF54L15_TEMPLATE
	select SOC_NRF54L15_CPUAPP
```

## boards/nordic/bm_nrf54l15_template/Kconfig.sysbuild
```kconfig
# No changes needed to this file

menuconfig PARTITION_MANAGER
	bool "Partition Manager"
	default n
```

## boards/nordic/bm_nrf54l15_template/board.yml
```yaml
board:
  name: bm_nrf54l15_template # Your board name
  full_name: Bare Metal nRF54L15 Template Board # Your full board name
  vendor: nordic
  socs:
  - name: nrf54l15
    variants:
    - name: no_softdevice
      cpucluster: cpuapp
    - name: softdevice_s115
      cpucluster: cpuapp
```

## boards/nordic/bm_nrf54l15dk/Kconfig
```kconfig
#
# Copyright (c) 2025 Nordic Semiconductor
#
# SPDX-License-Identifier: LicenseRef-Nordic-5-Clause
#

config BOARD_BM_NRF54L15DK
	select BOARD_LATE_INIT_HOOK

# Temporary fix to remove a build warning in MCUboot.
config NRF_RTC_TIMER_USER_CHAN_COUNT
	int "Unused"
	default 0
```

## boards/nordic/bm_nrf54l15dk/Kconfig.bm_nrf54l15dk
```kconfig
#
# Copyright (c) 2025 Nordic Semiconductor
#
# SPDX-License-Identifier: LicenseRef-Nordic-5-Clause
#

config BOARD_BM_NRF54L15DK
	select SOC_NRF54L05_CPUAPP if BOARD_BM_NRF54L15DK_NRF54L05_CPUAPP_S115_SOFTDEVICE || BOARD_BM_NRF54L15DK_NRF54L05_CPUAPP_S115_SOFTDEVICE_MCUBOOT || BOARD_BM_NRF54L15DK_NRF54L05_CPUAPP_SOFTDEVICE_S145
	select SOC_NRF54L10_CPUAPP if BOARD_BM_NRF54L15DK_NRF54L10_CPUAPP_S115_SOFTDEVICE || BOARD_BM_NRF54L15DK_NRF54L10_CPUAPP_S115_SOFTDEVICE_MCUBOOT || BOARD_BM_NRF54L15DK_NRF54L10_CPUAPP_SOFTDEVICE_S145
	select SOC_NRF54L15_CPUAPP if BOARD_BM_NRF54L15DK_NRF54L15_CPUAPP_S115_SOFTDEVICE || BOARD_BM_NRF54L15DK_NRF54L15_CPUAPP_S115_SOFTDEVICE_MCUBOOT || BOARD_BM_NRF54L15DK_NRF54L15_CPUAPP_SOFTDEVICE_S145
```

## boards/nordic/bm_nrf54l15dk/Kconfig.sysbuild
```kconfig
#
# Copyright (c) 2025 Nordic Semiconductor
#
# SPDX-License-Identifier: LicenseRef-Nordic-5-Clause
#

config PARTITION_MANAGER
	default n

if BOARD_BM_NRF54L15DK_NRF54L05_CPUAPP_S115_SOFTDEVICE || \
	BOARD_BM_NRF54L15DK_NRF54L10_CPUAPP_S115_SOFTDEVICE || \
	BOARD_BM_NRF54L15DK_NRF54L15_CPUAPP_S115_SOFTDEVICE || \
	BOARD_BM_NRF54L15DK_NRF54L05_CPUAPP_S115_SOFTDEVICE_MCUBOOT || \
	BOARD_BM_NRF54L15DK_NRF54L10_CPUAPP_S115_SOFTDEVICE_MCUBOOT || \
	BOARD_BM_NRF54L15DK_NRF54L15_CPUAPP_S115_SOFTDEVICE_MCUBOOT

choice SOFTDEVICE_SELECTION
	default SOFTDEVICE_S115
endchoice

if BOARD_BM_NRF54L15DK_NRF54L05_CPUAPP_S115_SOFTDEVICE_MCUBOOT || \
	BOARD_BM_NRF54L15DK_NRF54L10_CPUAPP_S115_SOFTDEVICE_MCUBOOT || \
	BOARD_BM_NRF54L15DK_NRF54L15_CPUAPP_S115_SOFTDEVICE_MCUBOOT

choice BM_BOOTLOADER
	default BM_BOOTLOADER_MCUBOOT
endchoice

choice BM_BOOTLOADER_MCUBOOT_SIGNATURE_TYPE
	default BM_BOOTLOADER_MCUBOOT_SIGNATURE_TYPE_ED25519
endchoice

config BM_BOOTLOADER_MCUBOOT_SIGNATURE_USING_KMU
	default y

choice BM_BOOTLOADER_MCUBOOT_IMG_HASH_ALG
	default BM_BOOT_IMG_HASH_ALG_PURE
endchoice

choice BM_FIRMWARE_LOADER
	default BM_FIRMWARE_LOADER_BT_MCUMGR
endchoice

config BM_BOOTLOADER_MCUBOOT_FIRMWARE_LOADER_ENTRANCE_BOOT_MODE
	default y

endif # BOARD_BM_NRF54L15DK_NRF54L05_CPUAPP_S115_SOFTDEVICE_MCUBOOT ||
	# BOARD_BM_NRF54L15DK_NRF54L10_CPUAPP_S115_SOFTDEVICE_MCUBOOT ||
	# BOARD_BM_NRF54L15DK_NRF54L15_CPUAPP_S115_SOFTDEVICE_MCUBOOT

endif # BOARD_BM_NRF54L15DK_NRF54L05_CPUAPP_S115_SOFTDEVICE ||
	# BOARD_BM_NRF54L15DK_NRF54L10_CPUAPP_S115_SOFTDEVICE ||
	# BOARD_BM_NRF54L15DK_NRF54L15_CPUAPP_S115_SOFTDEVICE ||
	# BOARD_BM_NRF54L15DK_NRF54L05_CPUAPP_S115_SOFTDEVICE_MCUBOOT ||
	# BOARD_BM_NRF54L15DK_NRF54L10_CPUAPP_S115_SOFTDEVICE_MCUBOOT ||
	# BOARD_BM_NRF54L15DK_NRF54L15_CPUAPP_S115_SOFTDEVICE_MCUBOOT
```

## boards/nordic/bm_nrf54l15dk/bm_nrf54l15dk_nrf54l10_cpuapp_s145_softdevice_defconfig
```kconfig
#
# Copyright (c) 2025 Nordic Semiconductor
#
# SPDX-License-Identifier: LicenseRef-Nordic-5-Clause
#

# Enable console
CONFIG_CONSOLE=y
CONFIG_BM_UARTE_CONSOLE=y

# Remove boot banner
CONFIG_NCS_BOOT_BANNER=n
CONFIG_BOOT_BANNER=n

# Enable MPU
CONFIG_ARM_MPU=y

# Enable hardware stack protection
CONFIG_HW_STACK_PROTECTION=y

# MPU-based null-pointer dereferencing detection cannot
# be applied as the (0x0 - 0x400) is unmapped for this target.
CONFIG_NULL_POINTER_EXCEPTION_DETECTION_NONE=y

# Enable Cache
CONFIG_CACHE_MANAGEMENT=y
CONFIG_EXTERNAL_CACHE=y

# Start SYSCOUNTER on driver init
CONFIG_NRF_GRTC_START_SYSCOUNTER=y

# Disable partition manager
CONFIG_PARTITION_MANAGER_ENABLED=n

# Disable multithreading
CONFIG_MULTITHREADING=n
CONFIG_ZERO_LATENCY_IRQS=y

# Disable generation of the redundant SW ISR table
CONFIG_GEN_SW_ISR_TABLE=n

# Allow FLASH writes
CONFIG_MPU_ALLOW_FLASH_WRITE=y

# Shrink
CONFIG_GPIO=n

# Enable all NRFX drivers
CONFIG_NRFX_CLOCK=y
CONFIG_NRFX_CLOCK_LFXO_TWO_STAGE_ENABLED=y
CONFIG_NRFX_COMP=y
CONFIG_NRFX_EGU10=y
CONFIG_NRFX_EGU20=y
CONFIG_NRFX_GPIOTE20=y
CONFIG_NRFX_GPIOTE30=y
CONFIG_NRFX_GPPI=y
CONFIG_NRFX_GRTC=y
CONFIG_NRFX_I2S=y
CONFIG_NRFX_NFCT=y
CONFIG_NRFX_PDM=y
CONFIG_NRFX_POWER=y
CONFIG_NRFX_PWM=y
CONFIG_NRFX_QDEC=y
CONFIG_NRFX_RRAMC=y
CONFIG_NRFX_SAADC=y
CONFIG_NRFX_SPIM=y
CONFIG_NRFX_SYSTICK=y
CONFIG_NRFX_TEMP=y
CONFIG_NRFX_TIMER=y
CONFIG_NRFX_TWIM=y
CONFIG_NRFX_UARTE=y
CONFIG_NRFX_WDT=y
CONFIG_NRFX_PRS_BOX_0=y
CONFIG_NRFX_PRS_BOX_1=y
CONFIG_NRFX_PRS_BOX_2=y
CONFIG_NRFX_PRS_BOX_3=y
CONFIG_NRFX_PRS_BOX_4=y
```

## boards/nordic/bm_nrf54l15dk/bm_nrf54l15dk_nrf54l15_cpuapp_s115_softdevice_mcuboot_defconfig
```kconfig
#
# Copyright (c) 2025 Nordic Semiconductor
#
# SPDX-License-Identifier: LicenseRef-Nordic-5-Clause
#

# Enable console
CONFIG_CONSOLE=y
CONFIG_BM_UARTE_CONSOLE=y

# Remove boot banner
CONFIG_NCS_BOOT_BANNER=n
CONFIG_BOOT_BANNER=n

# Enable MPU
CONFIG_ARM_MPU=y

# Enable hardware stack protection
CONFIG_HW_STACK_PROTECTION=y

# MPU-based null-pointer dereferencing detection cannot
# be applied as the (0x0 - 0x400) is unmapped for this target.
CONFIG_NULL_POINTER_EXCEPTION_DETECTION_NONE=y

# Enable Cache
CONFIG_CACHE_MANAGEMENT=y
CONFIG_EXTERNAL_CACHE=y

# Start SYSCOUNTER on driver init
CONFIG_NRF_GRTC_START_SYSCOUNTER=y

# Disable partition manager
CONFIG_PARTITION_MANAGER_ENABLED=n

# Disable multithreading
CONFIG_MULTITHREADING=n
CONFIG_ZERO_LATENCY_IRQS=y

# Disable generation of the redundant SW ISR table
CONFIG_GEN_SW_ISR_TABLE=n

# Allow FLASH writes
CONFIG_MPU_ALLOW_FLASH_WRITE=y

# Shrink
CONFIG_GPIO=n

# Enable all NRFX drivers
CONFIG_NRFX_CLOCK=y
CONFIG_NRFX_CLOCK_LFXO_TWO_STAGE_ENABLED=y
CONFIG_NRFX_COMP=y
CONFIG_NRFX_DPPI00=y
CONFIG_NRFX_DPPI10=y
CONFIG_NRFX_DPPI20=y
CONFIG_NRFX_DPPI30=y
CONFIG_NRFX_EGU10=y
CONFIG_NRFX_EGU20=y
CONFIG_NRFX_GPIOTE20=y
CONFIG_NRFX_GPIOTE30=y
CONFIG_NRFX_GPPI=y
CONFIG_NRFX_GRTC=y
CONFIG_NRFX_I2S20=y
CONFIG_NRFX_NFCT=y
CONFIG_NRFX_PDM20=y
CONFIG_NRFX_PDM21=y
CONFIG_NRFX_POWER=y
CONFIG_NRFX_PPIB00=y
CONFIG_NRFX_PPIB01=y
CONFIG_NRFX_PPIB10=y
CONFIG_NRFX_PPIB11=y
CONFIG_NRFX_PPIB20=y
CONFIG_NRFX_PPIB21=y
CONFIG_NRFX_PPIB22=y
CONFIG_NRFX_PPIB30=y
CONFIG_NRFX_PWM20=y
CONFIG_NRFX_PWM21=y
CONFIG_NRFX_PWM22=y
CONFIG_NRFX_QDEC20=y
CONFIG_NRFX_QDEC21=y
CONFIG_NRFX_RRAMC=y
CONFIG_NRFX_SAADC=y
CONFIG_NRFX_SPIM00=y
CONFIG_NRFX_SPIM20=y
CONFIG_NRFX_SPIM21=y
CONFIG_NRFX_SPIM22=y
CONFIG_NRFX_SPIM30=y
CONFIG_NRFX_SYSTICK=y
CONFIG_NRFX_TEMP=y
CONFIG_NRFX_TIMER00=y
CONFIG_NRFX_TIMER10=y
CONFIG_NRFX_TIMER20=y
CONFIG_NRFX_TIMER21=y
CONFIG_NRFX_TIMER22=y
CONFIG_NRFX_TIMER23=y
CONFIG_NRFX_TIMER24=y
CONFIG_NRFX_TWIM20=y
CONFIG_NRFX_TWIM21=y
CONFIG_NRFX_TWIM22=y
CONFIG_NRFX_TWIM30=y
CONFIG_NRFX_UARTE00=y
CONFIG_NRFX_UARTE20=y
CONFIG_NRFX_UARTE21=y
CONFIG_NRFX_UARTE22=y
CONFIG_NRFX_UARTE30=y
CONFIG_NRFX_WDT30=y
CONFIG_NRFX_WDT31=y
CONFIG_NRFX_PRS_BOX_0=y
CONFIG_NRFX_PRS_BOX_1=y
CONFIG_NRFX_PRS_BOX_2=y
CONFIG_NRFX_PRS_BOX_3=y
CONFIG_NRFX_PRS_BOX_4=y
```

## boards/nordic/bm_nrf54l15dk/board.yml
```yaml
board:
  name: bm_nrf54l15dk
  full_name: Bare Metal nRF54L15 DK
  vendor: nordic
  socs:
    - name: nrf54l05
      variants:
        - name: s115_softdevice
          cpucluster: cpuapp
          variants:
            - name: mcuboot
    - name: nrf54l10
      variants:
        - name: s115_softdevice
          cpucluster: cpuapp
          variants:
            - name: mcuboot
    - name: nrf54l15
      variants:
        - name: s115_softdevice
          cpucluster: cpuapp
          variants:
            - name: mcuboot
runners:
  run_once:
    '--recover':
      - runners:
          - nrfjprog
          - nrfutil
        run: first
        groups:
          - boards:
              - bm_nrf54l15dk/nrf54l05/cpuapp
              - bm_nrf54l15dk/nrf54l05/cpuapp/s115_softdevice
              - bm_nrf54l15dk/nrf54l05/cpuapp/s115_softdevice/mcuboot
          - boards:
              - bm_nrf54l15dk/nrf54l10/cpuapp
              - bm_nrf54l15dk/nrf54l10/cpuapp/s115_softdevice
              - bm_nrf54l15dk/nrf54l10/cpuapp/s115_softdevice/mcuboot
          - boards:
              - bm_nrf54l15dk/nrf54l15/cpuapp
              - bm_nrf54l15dk/nrf54l15/cpuapp/s115_softdevice
              - bm_nrf54l15dk/nrf54l15/cpuapp/s115_softdevice/mcuboot
    '--erase':
      - runners:
          - nrfjprog
          - jlink
          - nrfutil
        run: first
        groups:
          - boards:
              - bm_nrf54l15dk/nrf54l05/cpuapp
              - bm_nrf54l15dk/nrf54l05/cpuapp/s115_softdevice
              - bm_nrf54l15dk/nrf54l05/cpuapp/s115_softdevice/mcuboot
          - boards:
              - bm_nrf54l15dk/nrf54l10/cpuapp
              - bm_nrf54l15dk/nrf54l10/cpuapp/s115_softdevice
              - bm_nrf54l15dk/nrf54l10/cpuapp/s115_softdevice/mcuboot
          - boards:
              - bm_nrf54l15dk/nrf54l15/cpuapp
              - bm_nrf54l15dk/nrf54l15/cpuapp/s115_softdevice
              - bm_nrf54l15dk/nrf54l15/cpuapp/s115_softdevice/mcuboot
    '--reset':
      - runners:
          - nrfjprog
          - jlink
          - nrfutil
        run: last
        groups:
          - boards:
              - bm_nrf54l15dk/nrf54l05/cpuapp
              - bm_nrf54l15dk/nrf54l05/cpuapp/s115_softdevice
              - bm_nrf54l15dk/nrf54l05/cpuapp/s115_softdevice/mcuboot
          - boards:
              - bm_nrf54l15dk/nrf54l10/cpuapp
              - bm_nrf54l15dk/nrf54l10/cpuapp/s115_softdevice
              - bm_nrf54l15dk/nrf54l10/cpuapp/s115_softdevice/mcuboot
          - boards:
              - bm_nrf54l15dk/nrf54l15/cpuapp
              - bm_nrf54l15dk/nrf54l15/cpuapp/s115_softdevice
              - bm_nrf54l15dk/nrf54l15/cpuapp/s115_softdevice/mcuboot
```

## boards/nordic/bm_nrf54lm20dk/Kconfig
```kconfig
#
# Copyright (c) 2026 Nordic Semiconductor ASA
#
# SPDX-License-Identifier: LicenseRef-Nordic-5-Clause
#

config BOARD_BM_NRF54LM20DK
	select BOARD_LATE_INIT_HOOK
```

## boards/nordic/bm_nrf54lm20dk/board.yml
```yaml
board:
  name: bm_nrf54lm20dk
  full_name: Bare Metal nRF54LM20 DK
  vendor: nordic
  socs:
    - name: nrf54lm20a
      variants:
        - name: s115_softdevice
          cpucluster: cpuapp
          variants:
            - name: mcuboot
        - name: s145_softdevice
          cpucluster: cpuapp
          variants:
            - name: mcuboot
runners:
  run_once:
    '--recover':
      - runners:
          - nrfjprog
          - nrfutil
        run: first
        groups:
          - boards:
              - bm_nrf54lm20dk/nrf54lm20a/cpuapp
              - bm_nrf54lm20dk/nrf54lm20a/cpuapp/s115_softdevice
              - bm_nrf54lm20dk/nrf54lm20a/cpuapp/s115_softdevice/mcuboot
              - bm_nrf54lm20dk/nrf54lm20a/cpuapp/s145_softdevice
              - bm_nrf54lm20dk/nrf54lm20a/cpuapp/s145_softdevice/mcuboot
    '--erase':
      - runners:
          - nrfjprog
          - jlink
          - nrfutil
        run: first
        groups:
          - boards:
              - bm_nrf54lm20dk/nrf54lm20a/cpuapp
              - bm_nrf54lm20dk/nrf54lm20a/cpuapp/s115_softdevice
              - bm_nrf54lm20dk/nrf54lm20a/cpuapp/s115_softdevice/mcuboot
              - bm_nrf54lm20dk/nrf54lm20a/cpuapp/s145_softdevice
              - bm_nrf54lm20dk/nrf54lm20a/cpuapp/s145_softdevice/mcuboot
    '--reset':
      - runners:
          - nrfjprog
          - jlink
          - nrfutil
        run: last
        groups:
          - boards:
              - bm_nrf54lm20dk/nrf54lm20a/cpuapp
              - bm_nrf54lm20dk/nrf54lm20a/cpuapp/s115_softdevice
              - bm_nrf54lm20dk/nrf54lm20a/cpuapp/s115_softdevice/mcuboot
              - bm_nrf54lm20dk/nrf54lm20a/cpuapp/s145_softdevice
              - bm_nrf54lm20dk/nrf54lm20a/cpuapp/s145_softdevice/mcuboot
```

## boards/nordic/bm_nrf54ls05dk/Kconfig.bm_nrf54ls05dk
```kconfig
#
# Copyright (c) 2026 Nordic Semiconductor ASA
#
# SPDX-License-Identifier: LicenseRef-Nordic-5-Clause
#

config BOARD_BM_NRF54LS05DK
	select SOC_NRF54LS05B_CPUAPP if BOARD_BM_NRF54LS05DK_NRF54LS05B_CPUAPP_S115_SOFTDEVICE || \
					BOARD_BM_NRF54LS05DK_NRF54LS05B_CPUAPP_S115_SOFTDEVICE_MCUBOOT ||  \
					BOARD_BM_NRF54LS05DK_NRF54LS05B_CPUAPP_S145_SOFTDEVICE || \
					BOARD_BM_NRF54LS05DK_NRF54LS05B_CPUAPP_S145_SOFTDEVICE_MCUBOOT
```
