## CMakeLists.txt
```
#
# Copyright (c) 2025 Nordic Semiconductor ASA
#
# SPDX-License-Identifier: LicenseRef-Nordic-5-Clause
#

cmake_minimum_required(VERSION 3.20.0)

find_package(Zephyr REQUIRED HINTS $ENV{ZEPHYR_BASE})
project(ble_mcumgr)

target_sources(app PRIVATE
  src/main.c
)
```

## Kconfig
```
#
# Copyright (c) 2025 Nordic Semiconductor ASA
#
# SPDX-License-Identifier: LicenseRef-Nordic-5-Clause
#

menu "Bluetooth LE MCUmgr sample"

config APP_FIRMWARE_LOADER_BLE_DEVICE_NAME
	string "Device name"
	default "nRF_BM_MCUmgr"

module=APP
module-str=Bluetooth LE MCUmgr Sample
source "$(ZEPHYR_BASE)/subsys/logging/Kconfig.template.log_config"

endmenu # "Bluetooth LE MCUmgr sample"

source "Kconfig.zephyr"
```

## prj.conf
```kconfig
# Logging
CONFIG_LOG=y
CONFIG_LOG_MODE_MINIMAL=y

CONFIG_CRC=y
CONFIG_REBOOT=y
CONFIG_ZCBOR=y
CONFIG_NET_BUF=y
CONFIG_ZEPHYR_QUEUE=y
CONFIG_IMG_MANAGER=y
CONFIG_IMG_BLOCK_BUF_SIZE=4096
CONFIG_FLASH=y
CONFIG_FLASH_MAP=y
CONFIG_FLASH_MAP_CUSTOM=y
CONFIG_FLASH_MAP_CUSTOM_NCS_BM_MCUMGR=y
CONFIG_STREAM_FLASH=y
CONFIG_SOC_FLASH_NRF_RRAM=n
CONFIG_BM_STORAGE=y
CONFIG_BM_STORAGE_BACKEND_SD=y
CONFIG_RING_BUFFER=y
CONFIG_RING_BUFFER_LARGE=y

# SoftDevice
CONFIG_SOFTDEVICE=y
CONFIG_NRF_SDH_BLE=y

# Enable RNG
CONFIG_PSA_CRYPTO=y
CONFIG_PSA_WANT_GENERATE_RANDOM=y

# Advertising library
CONFIG_BLE_ADV=y

# BLE connection parameter
CONFIG_BLE_CONN_PARAMS=y
CONFIG_BLE_CONN_PARAMS_MAX_CONN_INTERVAL=24
CONFIG_BLE_CONN_PARAMS_SUP_TIMEOUT=20
CONFIG_BLE_CONN_PARAMS_MAX_SUP_TIMEOUT_DEVIATION=20
CONFIG_BLE_CONN_PARAMS_INITIATE_ATT_MTU_EXCHANGE=y
CONFIG_BLE_CONN_PARAMS_DATA_LENGTH_RX=251
CONFIG_BLE_CONN_PARAMS_DATA_LENGTH_TX=251
CONFIG_BLE_CONN_PARAMS_INITIATE_DATA_LENGTH_UPDATE=y
CONFIG_NRF_SDH_BLE_GAP_EVENT_LENGTH=10
CONFIG_NRF_SDH_BLE_GATT_MAX_MTU_SIZE=498

# MCUMgr
CONFIG_BLE_MCUMGR=y
CONFIG_NCS_BM_MCUMGR=y
CONFIG_MCUMGR_TRANSPORT_REASSEMBLY=y
CONFIG_MCUMGR_MGMT_NOTIFICATION_HOOKS=y
CONFIG_MCUMGR_GRP_IMG=y
CONFIG_MCUMGR_GRP_IMG_SLOT_INFO=y
CONFIG_MCUMGR_GRP_OS=y
CONFIG_MCUMGR_GRP_OS_RESET_HOOK=y
CONFIG_MCUMGR_GRP_OS_ECHO=y
CONFIG_MCUMGR_GRP_OS_MCUMGR_PARAMS=y
CONFIG_MCUMGR_GRP_OS_BOOTLOADER_INFO=y

# MCUmgr service requires storage of vendor UUIDs
CONFIG_NRF_SDH_BLE_VS_UUID_COUNT=2
```

## socs/nrf54l15_cpuapp_s115_softdevice_mcuboot.conf
```kconfig
CONFIG_NRF_SDH_BLE_GATT_MAX_MTU_SIZE=498
CONFIG_BLE_CONN_PARAMS_MAX_CONN_INTERVAL=24
CONFIG_BLE_CONN_PARAMS_SUP_TIMEOUT=20
CONFIG_BLE_CONN_PARAMS_MAX_SUP_TIMEOUT_DEVIATION=20
```

## src/main.c
```c
/*
 * Copyright (c) 2025 Nordic Semiconductor ASA
 *
 * SPDX-License-Identifier: LicenseRef-Nordic-5-Clause
 */

#include <nrf_error.h>
#include <stdbool.h>
#include <stdint.h>
#include <string.h>
#include <ble_gap.h>
#include <nrf_soc.h>
#include <bm/softdevice_handler/nrf_sdh.h>
#include <bm/softdevice_handler/nrf_sdh_ble.h>
#include <bm/bluetooth/ble_adv.h>
#include <bm/bluetooth/ble_conn_params.h>
#include <bm/bluetooth/ble_conn_params.h>
#include <bm/bluetooth/services/ble_mcumgr.h>
#include <bm/mgmt/mcumgr/grp/img_mgmt/img_mgmt_write.h>

#include <zephyr/kernel.h>
#include <zephyr/mgmt/mcumgr/mgmt/callbacks.h>
#include <zephyr/sys/reboot.h>
#include <zephyr/logging/log.h>
#include <zephyr/logging/log_ctrl.h>
#include <bm/storage/bm_rmem.h>
#include <bm/storage/ble_rmem.h>

LOG_MODULE_REGISTER(app, CONFIG_APP_LOG_LEVEL);

BLE_ADV_DEF(ble_adv); /* BLE advertising instance */

/** Handle of the current connection */
static uint16_t conn_handle = BLE_CONN_HANDLE_INVALID;
static volatile bool should_reboot;
static volatile bool notification_sent;
static volatile bool device_disconnected;

static enum mgmt_cb_return os_mgmt_reboot_hook(uint32_t event, enum mgmt_cb_return prev_status,
					       int32_t *rc, uint16_t *group, bool *abort_more,
					       void *data, size_t data_size);

static struct mgmt_callback os_mgmt_reboot_callback = {
	.callback = os_mgmt_reboot_hook,
	.event_id = MGMT_EVT_OP_OS_MGMT_RESET,
};

/**
 * @brief Bluetooth LE event handler.
 *
 * @param[in] evt Bluetooth LE event.
 * @param[in] ctx Context.
 */
static void on_ble_evt(const ble_evt_t *evt, void *ctx)
{
	uint32_t nrf_err;

	__ASSERT(evt, "BLE event is NULL");

	if (evt == NULL) {
		return;
	}

	switch (evt->header.evt_id) {
	case BLE_GAP_EVT_CONNECTED:
	{
		LOG_INF("Peer connected");
		conn_handle = evt->evt.gap_evt.conn_handle;
		break;
	}

	case BLE_GAP_EVT_DISCONNECTED:
	{
		LOG_INF("Peer disconnected");
		conn_handle = BLE_CONN_HANDLE_INVALID;

		if (should_reboot == true) {
			device_disconnected = true;
		}
		break;
	}

	case BLE_GAP_EVT_SEC_PARAMS_REQUEST:
	{
		/* Pairing not supported */
		nrf_err = sd_ble_gap_sec_params_reply(evt->evt.gap_evt.conn_handle,
						      BLE_GAP_SEC_STATUS_PAIRING_NOT_SUPP,
						      NULL, NULL);

		if (nrf_err) {
			LOG_ERR("Failed to reply with Security params, nrf_error %#x", nrf_err);
		}

		break;
	}

	case BLE_GATTS_EVT_SYS_ATTR_MISSING:
	{
		/* No system attributes have been stored */
		nrf_err = sd_ble_gatts_sys_attr_set(evt->evt.gatts_evt.conn_handle, NULL, 0, 0);

		if (nrf_err) {
			LOG_ERR("Failed to set system attributes, nrf_error %#x", nrf_err);
		}

		break;
	}

	case BLE_GATTS_EVT_HVN_TX_COMPLETE:
	{
		if (should_reboot == true) {
			notification_sent = true;
		}

		break;
	}
	};
}

NRF_SDH_BLE_OBSERVER(sdh_ble, on_ble_evt, NULL, USER_LOW);

static void ble_adv_evt_handler(struct ble_adv *adv, const struct ble_adv_evt *adv_evt)
{
	/* ignore */
}

static enum mgmt_cb_return os_mgmt_reboot_hook(uint32_t event, enum mgmt_cb_return prev_status,
					       int32_t *rc, uint16_t *group, bool *abort_more,
					       void *data, size_t data_size)
{
	if (event == MGMT_EVT_OP_OS_MGMT_RESET) {
		should_reboot = true;
		*rc = MGMT_ERR_EOK;

		return MGMT_CB_ERROR_RC;
	}

	return MGMT_CB_OK;
}

/**
 * @brief Change Bluetooth address from the default random address
 */
static uint32_t ble_change_address(void)
{
	uint32_t nrf_err;
	ble_gap_addr_t device_address;

	nrf_err = sd_ble_gap_addr_get(&device_address);

	if (nrf_err) {
		return nrf_err;
	}

	device_address.addr[0] ^= 0x1;

	return sd_ble_gap_addr_set(&device_address);
}

int main(void)
{
	int err;
	uint32_t nrf_err;
	ble_gap_conn_sec_mode_t device_name_write_sec;
	struct ble_adv_config ble_adv_cfg = {
		.conn_cfg_tag = CONFIG_NRF_SDH_BLE_CONN_TAG,
		.evt_handler = ble_adv_evt_handler,
		.adv_data = {
			.name_type = BLE_ADV_DATA_FULL_NAME,
			.flags = BLE_GAP_ADV_FLAGS_LE_ONLY_GENERAL_DISC_MODE,
		},
	};
	ble_uuid_t adv_uuid_list[] = {
		{
			.uuid = BLE_UUID_MCUMGR_SERVICE,
		},
	};
	struct ble_mcumgr_config mcumgr_cfg = {
		.sec_mode = BLE_MCUMGR_CONFIG_SEC_MODE_DEFAULT,
	};

	LOG_INF("BLE MCUmgr sample started");
	mgmt_callback_register(&os_mgmt_reboot_callback);

	err = nrf_sdh_enable_request();

	if (err) {
		LOG_ERR("Failed to enable SoftDevice, err %d", err);
		return 0;
	}

	LOG_INF("SoftDevice enabled");

	err = nrf_sdh_ble_enable(CONFIG_NRF_SDH_BLE_CONN_TAG);

	if (err) {
		LOG_ERR("Failed to enable BLE, err %d", err);
		return 0;
	}

	LOG_INF("Bluetooth enabled");

	BLE_GAP_CONN_SEC_MODE_SET_NO_ACCESS(&device_name_write_sec);
	nrf_err = sd_ble_gap_device_name_set(&device_name_write_sec,
					     CONFIG_APP_FIRMWARE_LOADER_BLE_DEVICE_NAME,
					     strlen(CONFIG_APP_FIRMWARE_LOADER_BLE_DEVICE_NAME));
	if (nrf_err) {
		LOG_ERR("Failed to set device name, nrf_error %#x", nrf_err);
	}

#if CONFIG_BM_FLAT_SETTINGS_BLUETOOTH_NAME
	struct bm_retained_clipboard_ctx clipboard_ctx;

	err = bm_rmem_init(&clipboard_ctx);
	if (err) {
		LOG_ERR("Failed to initialize retained clipboard reader, err %d", err);
	}
#endif

	nrf_err = ble_mcumgr_init(&mcumgr_cfg);

	if (nrf_err) {
		LOG_ERR("Failed to initialize MCUmgr service, nrf_error %#x", nrf_err);
		return 0;
	}

	LOG_INF("Services initialized");

	nrf_err = ble_change_address();

	if (nrf_err) {
		LOG_ERR("Failed to change Bluetooth address, nrf_error %#x", nrf_err);
	}

	/* Add MCUmgr Bluetooth service UUID to scan response */
	adv_uuid_list->type = ble_mcumgr_service_uuid_type();
	ble_adv_cfg.sr_data.uuid_lists.complete.uuid = &adv_uuid_list[0];
	ble_adv_cfg.sr_data.uuid_lists.complete.len = ARRAY_SIZE(adv_uuid_list);

#if CONFIG_BM_FLAT_SETTINGS_BLUETOOTH_NAME
	const char *custom_advertising_name;
	uint8_t custom_advertising_name_size;
	char log_name_buffer[BLE_RMEM_MAX_NAME_SIZE + 1];

	custom_advertising_name_size = ble_rmem_adv_name_get(&clipboard_ctx,
							     &custom_advertising_name);

	if (custom_advertising_name_size > 0) {
		if (custom_advertising_name_size > BLE_RMEM_MAX_NAME_SIZE) {
			LOG_WRN("BLE ADV name is too long, it will be truncated to %d characters",
				BLE_RMEM_MAX_NAME_SIZE);
			custom_advertising_name_size = BLE_RMEM_MAX_NAME_SIZE;
		}
		/* Change advertising name to one from application */
		nrf_err = sd_ble_gap_device_name_set(&device_name_write_sec,
						     custom_advertising_name,
						     custom_advertising_name_size);
		if (nrf_err) {
			LOG_ERR("Failed to change advertising name, nrf_err %#x", nrf_err);
			return 0;
		}
#if CONFIG_LOG
		memcpy(log_name_buffer, custom_advertising_name, custom_advertising_name_size);
		log_name_buffer[custom_advertising_name_size] = '\0';
#endif
	}
#endif /* CONFIG_BM_FLAT_SETTINGS_BLUETOOTH_NAME */

	nrf_err = ble_adv_init(&ble_adv, &ble_adv_cfg);
	if (nrf_err) {
		LOG_ERR("Failed to initialize advertising, nrf_error %#x", nrf_err);
		return 0;
	}

	nrf_err = ble_adv_start(&ble_adv, BLE_ADV_MODE_FAST);
	if (nrf_err) {
		LOG_ERR("Failed to start advertising, nrf_error %#x", nrf_err);
		return 0;
	}

#if CONFIG_BM_FLAT_SETTINGS_BLUETOOTH_NAME
	LOG_INF("Advertising as %s", (custom_advertising_name_size > 0 ? log_name_buffer :
		CONFIG_APP_FIRMWARE_LOADER_BLE_DEVICE_NAME));
	/* Suppress Unused variable warning when LOG are disabled */
	ARG_UNUSED(log_name_buffer);
#else
	LOG_INF("Advertising as %s", CONFIG_APP_FIRMWARE_LOADER_BLE_DEVICE_NAME);
#endif /* CONFIG_BM_FLAT_SETTINGS_BLUETOOTH_NAME */

	while (notification_sent == false && device_disconnected == false) {
		log_flush();

		k_cpu_idle();
	}

	if (device_disconnected == false) {
		nrf_err = sd_ble_gap_disconnect(conn_handle,
						BLE_HCI_REMOTE_USER_TERMINATED_CONNECTION);

		if (nrf_err) {
			device_disconnected = true;
		}

		while (device_disconnected == false) {
			log_flush();

			k_cpu_idle();
		}
	}

	/* Wait for the new firmware image to be written. */
	while (img_mgmt_write_in_progress()) {
		log_flush();

		k_cpu_idle();
	}

	sys_reboot(SYS_REBOOT_WARM);
	return 0;
}
```
