## CMakeLists.txt
```
#
# Copyright (c) 2025 Nordic Semiconductor ASA
#
# SPDX-License-Identifier: LicenseRef-Nordic-5-Clause
#

cmake_minimum_required(VERSION 3.20.0)

find_package(Zephyr REQUIRED HINTS $ENV{ZEPHYR_BASE})
project(uart_mcumgr)

zephyr_include_directories(
  include
  ${ZEPHYR_BASE}/subsys/mgmt/mcumgr/transport/include
)
target_sources(app PRIVATE src/main.c)
```

## prj.conf
```kconfig
# Logging
CONFIG_PRINTK=n
CONFIG_CONSOLE=n
CONFIG_BM_UARTE_CONSOLE=n
CONFIG_NCS_BARE_METAL_BOOT_BANNER=n

CONFIG_BASE64=y
CONFIG_CRC=y
CONFIG_REBOOT=y
CONFIG_ZCBOR=y
CONFIG_NET_BUF=y
CONFIG_ZEPHYR_QUEUE=y
CONFIG_IMG_MANAGER=y
CONFIG_IMG_BLOCK_BUF_SIZE=4096
CONFIG_FLASH=y
CONFIG_FLASH_MAP=y
CONFIG_FLASH_MAP_CUSTOM=y
CONFIG_FLASH_MAP_CUSTOM_NCS_BM_MCUMGR=y
CONFIG_STREAM_FLASH=y
CONFIG_SOC_FLASH_NRF_RRAM=y
CONFIG_BM_SCHEDULER=y
CONFIG_BM_STORAGE=y
CONFIG_BM_STORAGE_BACKEND_RRAM=y
CONFIG_RING_BUFFER=y
CONFIG_RING_BUFFER_LARGE=y

# MCUMgr
CONFIG_NCS_BM_MCUMGR=y
CONFIG_MCUMGR_TRANSPORT_BM_UART=y
CONFIG_MCUMGR_TRANSPORT_REASSEMBLY=y
CONFIG_MCUMGR_MGMT_NOTIFICATION_HOOKS=y
CONFIG_MCUMGR_GRP_IMG=y
CONFIG_MCUMGR_GRP_IMG_SLOT_INFO=y
CONFIG_MCUMGR_GRP_OS=y
CONFIG_MCUMGR_GRP_OS_RESET_HOOK=y
CONFIG_MCUMGR_GRP_OS_ECHO=y
CONFIG_MCUMGR_GRP_OS_MCUMGR_PARAMS=y
CONFIG_MCUMGR_GRP_OS_BOOTLOADER_INFO=y
```

## src/main.c
```c
/*
 * Copyright (c) 2025 Nordic Semiconductor ASA
 *
 * SPDX-License-Identifier: LicenseRef-Nordic-5-Clause
 */

#include <string.h>
#include <zephyr/kernel.h>
#include <zephyr/drivers/uart.h>
#include <zephyr/mgmt/mcumgr/transport/serial.h>
#include <zephyr/drivers/console/uart_mcumgr.h>
#include <zephyr/mgmt/mcumgr/mgmt/mgmt.h>
#include <zephyr/mgmt/mcumgr/mgmt/callbacks.h>
#include <zephyr/sys/reboot.h>
#include <zephyr/logging/log.h>
#include <bm/bm_scheduler.h>
#include <nrfx_uarte.h>
#include <smp_uart.h>
#include <bm/mgmt/mcumgr/grp/img_mgmt/img_mgmt_write.h>
#include <board-config.h>

LOG_MODULE_REGISTER(app_uart_mcumgr, CONFIG_APP_UART_MCUMGR_SAMPLE_LOG_LEVEL);

static bool should_reboot;

static enum mgmt_cb_return os_mgmt_reboot_hook(uint32_t event, enum mgmt_cb_return prev_status,
					       int32_t *rc, uint16_t *group, bool *abort_more,
					       void *data, size_t data_size);

static struct mgmt_callback os_mgmt_reboot_callback = {
	.callback = os_mgmt_reboot_hook,
	.event_id = MGMT_EVT_OP_OS_MGMT_RESET,
};

static enum mgmt_cb_return os_mgmt_reboot_hook(uint32_t event, enum mgmt_cb_return prev_status,
					       int32_t *rc, uint16_t *group, bool *abort_more,
					       void *data, size_t data_size)
{
	if (event == MGMT_EVT_OP_OS_MGMT_RESET) {
		should_reboot = true;
		*rc = MGMT_ERR_EOK;

		return MGMT_CB_ERROR_RC;
	}

	return MGMT_CB_OK;
}

int main(void)
{
	LOG_INF("UART MCUmgr sample started");

	mgmt_callback_register(&os_mgmt_reboot_callback);

	while (should_reboot == false) {
		k_cpu_idle();

		smp_uart_process_rx_queue();
		bm_scheduler_process();
	}

	/* Wait for the new firmware image to be written. */
	while (img_mgmt_write_in_progress()) {
		bm_scheduler_process();
		k_sleep(K_MSEC(1));
	}

	sys_reboot(SYS_REBOOT_WARM);
}
```
