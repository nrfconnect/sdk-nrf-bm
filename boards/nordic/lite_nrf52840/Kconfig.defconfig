## boards/nordic/lite_nrf52840/Kconfig.lite_nrf52840
```kconfig
# Copyright (c) 2025 Nordic Semiconductor ASA
# SPDX-License-Identifier: Apache-2.0

# This board is for internal development use only.
# nRF52840 is not planned to be supported in the final version of NCS Lite.

config BOARD_LITE_NRF52840
	select SOC_NRF52840_QIAA
```

## boards/nordic/lite_nrf52840/board.yml
```yaml
board:
  name: lite_nrf52840
  full_name: Lite nRF52840
  vendor: nordic
  socs:
  - name: nrf52840
    variants:
    - name: no_softdevice
```

## boards/nordic/lite_nrf52840/lite_nrf52840_nrf52840_defconfig
```kconfig
# Copyright (c) 2025 Nordic Semiconductor ASA
# SPDX-License-Identifier: Apache-2.0

# Enable MPU
CONFIG_ARM_MPU=y

# Enable hardware stack protection
CONFIG_HW_STACK_PROTECTION=y

# Enable RTT
CONFIG_USE_SEGGER_RTT=y

# Enable uart driver
CONFIG_SERIAL=y

# Enable console
CONFIG_CONSOLE=y
CONFIG_LITE_UARTE_CONSOLE=y

# Remove boot banner
CONFIG_NCS_BOOT_BANNER=n
CONFIG_BOOT_BANNER=n

CONFIG_MULTITHREADING=n
CONFIG_ZERO_LATENCY_IRQS=y

#Enable SoftDevice
CONFIG_CLOCK_CONTROL=n
CONFIG_SOFTDEVICE=y
CONFIG_NRF_SDH=y

# Enable all NRFX drivers
CONFIG_NRFX_CLOCK=y
CONFIG_NRFX_CLOCK_LFXO_TWO_STAGE_ENABLED=y
CONFIG_NRFX_COMP=y
CONFIG_NRFX_EGU0=y
CONFIG_NRFX_EGU1=y
CONFIG_NRFX_EGU2=y
CONFIG_NRFX_EGU3=y
CONFIG_NRFX_EGU4=y
CONFIG_NRFX_EGU5=y
CONFIG_NRFX_GPIOTE0=y
CONFIG_NRFX_GPPI=y
CONFIG_NRFX_I2S0=y
CONFIG_NRFX_NFCT=y
CONFIG_NRFX_NVMC=y
CONFIG_NRFX_PDM0=y
CONFIG_NRFX_POWER=y
CONFIG_NRFX_PPI=y
CONFIG_NRFX_PWM0=y
CONFIG_NRFX_PWM1=y
CONFIG_NRFX_PWM2=y
CONFIG_NRFX_PWM3=y
CONFIG_NRFX_QDEC0=y
CONFIG_NRFX_QSPI=y
CONFIG_NRFX_RNG=y
CONFIG_NRFX_RTC0=y
CONFIG_NRFX_RTC1=y
CONFIG_NRFX_RTC2=y
CONFIG_NRFX_SAADC=y
CONFIG_NRFX_SPIM0=y
CONFIG_NRFX_SPIM1=y
CONFIG_NRFX_SPIM2=y
CONFIG_NRFX_SPIM3=y
CONFIG_NRFX_SYSTICK=y
CONFIG_NRFX_TEMP=y
CONFIG_NRFX_TIMER0=y
CONFIG_NRFX_TIMER1=y
CONFIG_NRFX_TIMER2=y
CONFIG_NRFX_TIMER3=y
CONFIG_NRFX_TIMER4=y
CONFIG_NRFX_UARTE0=y
CONFIG_NRFX_UARTE1=y
CONFIG_NRFX_UARTE_CONFIG_TX_LINK=y
CONFIG_NRFX_UARTE_CONFIG_RX_CACHE_ENABLED=y
CONFIG_NRFX_WDT0=y
CONFIG_NRFX_PRS_BOX_0=y
CONFIG_NRFX_PRS_BOX_1=y
CONFIG_NRFX_PRS_BOX_2=y
CONFIG_NRFX_PRS_BOX_3=y
CONFIG_NRFX_PRS_BOX_4=y
```

## boards/nordic/lite_nrf54l15/Kconfig.lite_nrf54l15
```kconfig
# Copyright (c) 2025 Nordic Semiconductor ASA
# SPDX-License-Identifier: Apache-2.0

config BOARD_LITE_NRF54L15
	select SOC_NRF54L15_CPUAPP
```

## boards/nordic/lite_nrf54l15/board.yml
```yaml
board:
  name: lite_nrf54l15
  full_name: Lite nRF54L15
  vendor: nordic
  socs:
  - name: nrf54l15
    variants:
    - name: no_softdevice
      cpucluster: cpuapp
```

## boards/nordic/lite_nrf54l15_template/board.yml
```yaml
board:
  name: lite_nrf54l15_template # Your board name
  full_name: Lite nRF54L15 Template Board # Your full board name
  vendor: nordic
  socs:
  - name: nrf54l15
    variants:
    - name: no_softdevice
      cpucluster: cpuapp
```

## drivers/bm_lpuarte/Kconfig
```kconfig
#
# Copyright (c) 2025 Nordic Semiconductor
#
# SPDX-License-Identifier: LicenseRef-Nordic-5-Clause
#

config BM_SW_LPUARTE
	bool "Low Power UARTE using REQ/RDY lines"
	depends on BM_GPIOTE
	depends on BM_TIMER
	depends on NRFX_UARTE
	help
	  Low Power UARTE implements UARTE API and extends standard UARTE
	  communication with a 2-pin protocol for receiver wake-up and flow control.

if BM_SW_LPUARTE

config BM_SW_LPUARTE_HFXO
	bool "Turn on HFXO for RX and TX"
	default y
	depends on SOFTDEVICE
	help
	  According to the UART specification high frequency RC oscillator is
	  not accurate enough. However, in normal conditions and accurate clock
	  on the transmitter side it may be accepted to disable it. Turning on
	  HFXO prolongs receiver activation for up to 3 milliseconds.

module = BM_SW_LPUARTE
module-str = Low Power UARTE
source "subsys/logging/Kconfig.template.log_config"

endif # BM_SW_LPUARTE
```

## drivers/console/Kconfig
```kconfig
#
# Copyright (c) 2025 Nordic Semiconductor
#
# SPDX-License-Identifier: LicenseRef-Nordic-5-Clause
#
menu "Console Device Drivers"

rsource "Kconfig.bm_uarte"

endmenu
```

## drivers/console/Kconfig.bm_uarte
```kconfig
#
# Copyright (c) 2025 Nordic Semiconductor
#
# SPDX-License-Identifier: LicenseRef-Nordic-5-Clause
#

menuconfig BM_UARTE_CONSOLE
	bool "UARTE console"
	depends on CONSOLE
	select CONSOLE_HAS_DRIVER

if BM_UARTE_CONSOLE

config DEPRECATED_UART_NRFX_UARTE_LEGACY_SHIM
	bool
	default n

config BM_UARTE_CONSOLE_UARTE_IRQ_PRIO
	int "IRQ priority"
	range 3 7
	default 3

config BM_UARTE_CONSOLE_UARTE_USE_HWFC
	bool "Use hardware flow control"

config BM_UARTE_CONSOLE_UARTE_PARITY_INCLUDED
	bool "Use parity"

config BM_UARTE_CONSOLE_ADD_CR_BEFORE_LF
	bool "Add carriage return before linefeed"
	default y

#
# Console termination
#
choice
	prompt "Termination mode"
	default BM_UARTE_CONSOLE_CR_LF_TERMINATION
	help
		Sets the command terminator used by the serial terminal.
		Available options are:
		-  LF termination
		-  CR+LF termination
	config BM_UARTE_CONSOLE_LF_TERMINATION
		bool "LF termination"
	config BM_UARTE_CONSOLE_CR_LF_TERMINATION
		bool "CR+LF termination"
endchoice

endif # BM_UARTE_CONSOLE
```

## drivers/console/Kconfig.lite_uarte
```kconfig
#
# Copyright (c) 2025 Nordic Semiconductor
#
# SPDX-License-Identifier: LicenseRef-Nordic-5-Clause
#

menuconfig LITE_UARTE_CONSOLE
	bool "Lite UARTE console"
	depends on CONSOLE
	select CONSOLE_HAS_DRIVER

if LITE_UARTE_CONSOLE

config DEPRECATED_UART_NRFX_UARTE_LEGACY_SHIM
	bool
	default n

config LITE_UARTE_CONSOLE_UARTE_IRQ_PRIO
	int "IRQ priority"
	range 3 7
	default 3

config LITE_UARTE_CONSOLE_UARTE_USE_HWFC
	bool "Use hardware flow control"

config LITE_UARTE_CONSOLE_UARTE_PARITY_INCLUDED
	bool "Use parity"


config LITE_UARTE_CONSOLE_ADD_CR_BEFORE_LF
	bool "Add carriage return before linefeed"
	default y

#
# Console termination
#
choice
	prompt "Termination mode"
	default LITE_UARTE_CONSOLE_CR_LF_TERMINATION
	help
		Sets the command terminator used by the serial terminal.
		Available options are:
		-  LF termination
		-  CR+LF termination
	config LITE_UARTE_CONSOLE_LF_TERMINATION
		bool "LF termination"
	config LITE_UARTE_CONSOLE_CR_LF_TERMINATION
		bool "CR+LF termination"
endchoice

endif # LITE_UARTE_CONSOLE
```

## drivers/flash/Kconfig
```kconfig
#
# Copyright (c) 2025 Nordic Semiconductor
#
# SPDX-License-Identifier: LicenseRef-Nordic-5-Clause
#

if FLASH

# zephyr-keep-sorted-start
rsource "Kconfig.nrf_rram"
# zephyr-keep-sorted-stop

endif # FLASH
```

## drivers/flash/Kconfig.nrf_rram
```kconfig
#
# Copyright (c) 2025 Nordic Semiconductor ASA
#
# SPDX-License-Identifier: Apache-2.0
#

menuconfig SOC_FLASH_NRF_RRAM_BM
	bool "Nordic Semiconductor nRF SoftDevice-based RRAM flash driver"
	depends on DT_HAS_NORDIC_RRAM_CONTROLLER_ENABLED
	depends on FLASH
	select NRFX_RRAMC if !BUILD_WITH_TFM
	select FLASH_HAS_DRIVER_ENABLED
	select FLASH_HAS_PAGE_LAYOUT
	select FLASH_HAS_NO_EXPLICIT_ERASE
	select FLASH_NRF_FORCE_ALT
	select MPU_ALLOW_FLASH_WRITE if ARM_MPU
	default y if SOFTDEVICE
	help
	  Enables Nordic Semiconductor nRF RRAM flash driver using the SoftDevice.

if SOC_FLASH_NRF_RRAM_BM

config NRF_RRAM_REGION_ADDRESS_RESOLUTION
	hex
	default 0x1000
	help
	  RRAMC's region protection address resolution.
	  Applies to region with configurable start address.

config NRF_RRAM_REGION_SIZE_UNIT
	hex
	default 0x1000
	help
	  Base unit for the size of RRAMC's region protection.

endif # SOC_FLASH_NRF_RRAM_BM
```

## lib/ble_adv/Kconfig
```kconfig
#
# Copyright (c) 2024 Nordic Semiconductor
#
# SPDX-License-Identifier: LicenseRef-Nordic-5-Clause
#

menuconfig BLE_ADV
	bool "BLE Advertising"

if BLE_ADV

config BLE_ADV_NAME
	string "Advertising name"
	default "nRF5 is life"

config BLE_ADV_RESTART_ON_DISCONNECT
	bool "Start advertising upon disconnection"
	default y

config BLE_ADV_USE_WHITELIST
	bool "Use whitelist"

config BLE_ADV_EXTENDED_ADVERTISING
	bool "Extended advertising"
	default y

config BLE_ADV_DIRECTED_ADVERTISING
	bool "Directed advertising"
	default y

config BLE_ADV_DIRECTED_ADVERTISING_HIGH_DUTY
	bool "High duty"
	depends on BLE_ADV_DIRECTED_ADVERTISING
	default y

config BLE_ADV_DIRECTED_ADVERTISING_TIMEOUT
	int "Directed advertising timeout (10 ms units)"
	depends on BLE_ADV_DIRECTED_ADVERTISING
	range 0 18000
	default 100

config BLE_ADV_DIRECTED_ADVERTISING_INTERVAL
	int "Directed advertising interval (0.625 ms units)"
	depends on BLE_ADV_DIRECTED_ADVERTISING
	range 32 16384
	default 32

config BLE_ADV_FAST_ADVERTISING
	bool "Fast advertising"
	default y

config BLE_ADV_FAST_ADVERTISING_TIMEOUT
	int "Fast advertising timeout (10 ms units)"
	depends on BLE_ADV_FAST_ADVERTISING
	range 0 18000
	default 1000

config BLE_ADV_FAST_ADVERTISING_INTERVAL
	int "Fast advertising interval (0.625 ms units)"
	depends on BLE_ADV_FAST_ADVERTISING
	range 32 16384
	default 32

config BLE_ADV_SLOW_ADVERTISING
	bool "Slow advertising"
	default y

config BLE_ADV_SLOW_ADVERTISING_TIMEOUT
	int "Slow advertising timeout (10 ms units)"
	depends on BLE_ADV_SLOW_ADVERTISING
	range 0 18000
	default 18000

config BLE_ADV_SLOW_ADVERTISING_INTERVAL
	int "Slow advertising interval (0.625 ms units)"
	depends on BLE_ADV_SLOW_ADVERTISING
	range 32 16384
	default 64

choice
	prompt "Primary PHY"
	default BLE_ADV_PRIMARY_PHY_AUTO

config BLE_ADV_PRIMARY_PHY_AUTO
	bool "Auto"
config BLE_ADV_PRIMARY_PHY_1MBPS
	bool "1 Megabit"
config BLE_ADV_PRIMARY_PHY_2MBPS
	bool "2 Megabits"
config BLE_ADV_PRIMARY_PHY_CODED
	bool "Coded"
endchoice

config BLE_ADV_PRIMARY_PHY
	hex
	default 0x00 if BLE_ADV_PRIMARY_PHY_AUTO
	default 0x01 if BLE_ADV_PRIMARY_PHY_1MBPS
	default 0x02 if BLE_ADV_PRIMARY_PHY_2MBPS
	default 0x04 if BLE_ADV_PRIMARY_PHY_CODED

choice
	prompt "Secondary PHY"
	default BLE_ADV_SECONDARY_PHY_AUTO

config BLE_ADV_SECONDARY_PHY_AUTO
	bool "Auto"
config BLE_ADV_SECONDARY_PHY_1MBPS
	bool "1 Megabit"
config BLE_ADV_SECONDARY_PHY_2MBPS
	bool "2 Megabits"
config BLE_ADV_SECONDARY_PHY_CODED
	bool "Coded"
endchoice

config BLE_ADV_SECONDARY_PHY
	hex
	default 0x00 if BLE_ADV_SECONDARY_PHY_AUTO
	default 0x01 if BLE_ADV_SECONDARY_PHY_1MBPS
	default 0x02 if BLE_ADV_SECONDARY_PHY_2MBPS
	default 0x04 if BLE_ADV_SECONDARY_PHY_CODED

module=BLE_ADV
module-dep=LOG
module-str=BLE Advertising
source "$(ZEPHYR_BASE)/subsys/logging/Kconfig.template.log_config"

endif # BLE_ADV
```

## lib/ble_conn_params/Kconfig
```kconfig
#
# Copyright (c) 2024 Nordic Semiconductor
#
# SPDX-License-Identifier: LicenseRef-Nordic-5-Clause
#
menuconfig BLE_CONN_PARAMS
	bool "BLE Connection Parameters"

if BLE_CONN_PARAMS

menuconfig BLE_CONN_PARAMS_AUTO_GAP_CONN_PARAM_UPDATE
	bool "Handle GAP connection parameter updates"
	default y

if BLE_CONN_PARAMS_AUTO_GAP_CONN_PARAM_UPDATE

config BLE_CONN_PARAMS_MIN_CONN_INTERVAL
	int "Minimum connection interval (1.25 ms units)"
	range 6 3200
	default 6
	help
	  Minimum connection interval, in 1.25 ms units.
	  Min 7.5 ms, Max 4 sec.

config BLE_CONN_PARAMS_MAX_CONN_INTERVAL
	int "Maximum connection interval (1.25 ms units)"
	range BLE_CONN_PARAMS_MIN_CONN_INTERVAL 3200
	default 256
	help
	  Maximum connection interval.
	  Min 7.5 ms, Max 4 sec.

config BLE_CONN_PARAMS_SLAVE_LATENCY
	int "Slave latency"
	range 0 499
	default 0
	help
	  Number of connection events that peripheral is allowed to skip.

config BLE_CONN_PARAMS_SUP_TIMEOUT
	int "Connection supervision timeout (10 ms units)"
	range 10 3200
	default 100
	help
	  Connection supervision timeout, in units of 10 milliseconds.
	  Min 100 ms, Max 32 sec.

config BLE_CONN_PARAMS_MAX_SLAVE_LATENCY_DEVIATION
	int "Maximum slave latency deviation (1.25 ms units)"
	range 0 499
	default 0
	help
	  How much can the slave latency deviate from the desired value.

config BLE_CONN_PARAMS_MAX_SUP_TIMEOUT_DEVIATION
	int "Maximum supervision timeout deviation (10 ms units)"
	range 0 3190
	default 400
	help
	  How much can the connection supervision timeout deviate from the desired value.

config BLE_CONN_PARAMS_NEGOTIATION_RETRIES
	int "Number of attempts to negotiate parameters"
	default 2
	help
	  Maximum number of attempts to negotiate connection parameters.

config BLE_CONN_PARAMS_DISCONNECT_ON_FAILURE
	bool "Disconnect upon failure to negotiate configured parameters"

endif # BLE_CONN_PARAMS_AUTO_GAP_CONN_PARAM_UPDATE

config BLE_CONN_PARAMS_AUTO_ATT_MTU
	bool "Handle ATT MTU exchanges"
	default y

if BLE_CONN_PARAMS_AUTO_ATT_MTU

# Define a hidden KConfig for this module
config BLE_CONN_PARAMS_ATT_MTU
	int
	default NRF_SDH_BLE_GATT_MAX_MTU_SIZE

# Show the SDH Kconfig entry
config NRF_SDH_BLE_GATT_MAX_MTU_SIZE
	int "ATT MTU"

config BLE_CONN_PARAMS_INITIATE_ATT_MTU_EXCHANGE
	bool "Initiate ATT MTU exchange on connection" if BLE_CONN_PARAMS_ATT_MTU != 23

endif # BLE_CONN_PARAMS_AUTO_ATT_MTU

config BLE_CONN_PARAMS_AUTO_DATA_LENGTH
	bool "Handle data length updates"
	default y
	depends on SOFTDEVICE_DATA_LENGTH_UPDATE

if BLE_CONN_PARAMS_AUTO_DATA_LENGTH

config BLE_CONN_PARAMS_DATA_LENGTH
	int "Data length"
	range 27 251
	default 27

config BLE_CONN_PARAMS_INITIATE_DATA_LENGTH_UPDATE
	bool "Initiate data length update on connection" if BLE_CONN_PARAMS_DATA_LENGTH != 27

endif # BLE_CONN_PARAMS_AUTO_DATA_LENGTH

config BLE_CONN_PARAMS_AUTO_PHY_UPDATE
	bool "Handle PHY mode updates"
	default y
if BLE_CONN_PARAMS_AUTO_PHY_UPDATE

choice
	prompt "Preferred radio PHY mode in connection"
	default BLE_CONN_PARAMS_PHY_AUTO

config BLE_CONN_PARAMS_PHY_AUTO
	bool "Auto"
config BLE_CONN_PARAMS_PHY_1MBPS
	bool "1 Megabit"
config BLE_CONN_PARAMS_PHY_2MBPS
	bool "2 Megabits"
config BLE_CONN_PARAMS_PHY_CODED
	bool "Coded"
endchoice

config BLE_CONN_PARAMS_PHY
	hex
	default 0x00 if BLE_CONN_PARAMS_PHY_AUTO
	default 0x01 if BLE_CONN_PARAMS_PHY_1MBPS
	default 0x02 if BLE_CONN_PARAMS_PHY_2MBPS
	default 0x04 if BLE_CONN_PARAMS_PHY_CODED

config BLE_CONN_PARAMS_INITIATE_PHY_UPDATE
	bool "Initiate PHY mode update on connection"
	depends on BLE_CONN_PARAMS_AUTO_PHY_UPDATE

endif # BLE_CONN_PARAMS_AUTO_PHY_UPDATE

module=BLE_CONN_PARAMS
module-dep=LOG
module-str=BLE Connection Parameters
source "${ZEPHYR_BASE}/subsys/logging/Kconfig.template.log_config"

endif # BLE_CONN_PARAMS
```

## lib/ble_conn_state/Kconfig
```kconfig
#
# Copyright (c) 2025 Nordic Semiconductor
#
# SPDX-License-Identifier: LicenseRef-Nordic-5-Clause
#
menuconfig BLE_CONN_STATE
	bool "Connection state"
	depends on NRF_SDH_BLE
	help
	  A library to defer event processing to main().

if BLE_CONN_STATE

config BLE_CONN_STATE_USER_FLAG_COUNT
	int "User flag count"
	range 0 24
	default 24
	help
	   The number of available user flags.

config BLE_CONN_STATE_BLE_OBSERVER_PRIO
	int "BLE observer priority"
	default 0

module=BLE_CONN_STATE
module-dep=LOG
module-str=BLE Connection state
source "${ZEPHYR_BASE}/subsys/logging/Kconfig.template.log_config"

endif
```

## lib/ble_db_discovery/Kconfig
```kconfig
#
# Copyright (c) 2025 Nordic Semiconductor
#
# SPDX-License-Identifier: LicenseRef-Nordic-5-Clause
#

menuconfig BLE_DB_DISCOVERY
	bool "BLE DB discovery"
	depends on SOFTDEVICE
	select EXPERIMENTAL
	help
	  database discovery.

if BLE_DB_DISCOVERY

config BLE_GATT_DB_MAX_CHARS
	int "database max characteristics"
	range 1 6
	default 6
	help
		The maximum number of database characteristics.

config BLE_DB_DISCOVERY_MAX_SRV
	int "max discovered services"
	range 1 6
	default 6
	help
		The total number of services that can be discovered by this module

endif # BLE_DB_DISCOVERY
```
