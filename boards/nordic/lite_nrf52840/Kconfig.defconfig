## lib/ble_gq/Kconfig
```kconfig
#
# Copyright (c) 2025 Nordic Semiconductor
#
# SPDX-License-Identifier: LicenseRef-Nordic-5-Clause
#
menuconfig BLE_GATT_QUEUE
	bool "BLE GATT Queue"

if BLE_GATT_QUEUE

config BLE_GQ_MAX_CONNECTIONS
	int "Max simultaneous connections"
	default 1
	help
	  Default value used for GATT queue instances defined using BLE_GQ_DEF.
	  Sets the max number of connections that a default GATT queue instance can manage.

config BLE_GQ_QUEUE_SIZE
	int "Request queue size (per connection)"
	default 8
	help
	  Default value used for GATT queue instances defined using BLE_GQ_DEF.
	  Sets the max number of requests that can be queued for each connection that
	  have been registered to a GATT queue instance with default configuration.

config BLE_GQ_HEAP_SIZE
	int "Datapool heap size (bytes)"
	default 256
	help
	  Default value used for GATT queue instances defined using BLE_GQ_DEF. Sets the heap size
	  for storing additional data that can be of variable size.

config BLE_GQ_OBSERVER_PRIO
	int "SoftDevice event observer priority"
	default 0

module=BLE_GQ
module-str=BLE GATT Queue
source "$(ZEPHYR_BASE)/subsys/logging/Kconfig.template.log_config"

endif # BLE_GATT_QUEUE
```

## lib/ble_qwr/Kconfig
```kconfig
#
# Copyright (c) 2025 Nordic Semiconductor
#
# SPDX-License-Identifier: LicenseRef-Nordic-5-Clause
#
menuconfig BLE_QWR
	bool "Queued writes"

if BLE_QWR

config BLE_QWR_MAX_ATTR
	int "Maximum queued writes attributes"
	default 0
	help
	   Maximum queued writes attributes

config BLE_QWR_BLE_OBSERVER_PRIO
	int "BLE observer priority"
	default 2

module=BLE_QWR
module-dep=LOG
module-str=BLE QWR
source "$(ZEPHYR_BASE)/subsys/logging/Kconfig.template.log_config"

endif
```

## lib/ble_racp/Kconfig
```kconfig
#
# Copyright (c) 2025 Nordic Semiconductor
#
# SPDX-License-Identifier: LicenseRef-Nordic-5-Clause
#

menuconfig BLE_RACP
	bool "BLE Record Access Control Point"

if BLE_RACP

module=BLE_RACP
module-dep=LOG
module-str=BLE RACP
source "$(ZEPHYR_BASE)/subsys/logging/Kconfig.template.log_config"

endif # BLE_RACP
```

## lib/ble_radio_notification/Kconfig
```kconfig
#
# Copyright (c) 2025 Nordic Semiconductor
#
# SPDX-License-Identifier: LicenseRef-Nordic-5-Clause
#
menuconfig BLE_RADIO_NOTIFICATION
	bool "BLE Radio Notification"

if BLE_RADIO_NOTIFICATION

choice BLE_RADIO_NOTIFICATION_TYPE
	prompt "Radio notification type"
	default BLE_RADIO_NOTIFICATION_ON_BOTH

config BLE_RADIO_NOTIFICATION_ON_ACTIVE
	bool "on active"

config BLE_RADIO_NOTIFICATION_ON_INACTIVE
	bool "on inactive"

config BLE_RADIO_NOTIFICATION_ON_BOTH
	bool "on both active and inactive"

endchoice # BLE_RADIO_NOTIFICATION_TYPE

config BLE_RADIO_NOTIFICATION_IRQ_PRIO
	int "BLE Radio Notification IRQ priority"
	default 3
	help
	   IRQ Priority level 0 and 4 are reserved by the SoftDevice.


module=BLE_RADIO_NOTIFICATION
module-dep=LOG
module-str=BLE Radio Notification
source "$(ZEPHYR_BASE)/subsys/logging/Kconfig.template.log_config"

endif # BLE_RADIO_NOTIFICATION
```

## lib/bluetooth/Kconfig
```kconfig
#
# Copyright (c) 2025 Nordic Semiconductor
#
# SPDX-License-Identifier: LicenseRef-Nordic-5-Clause
#
menu "Bluetooth libraries"

rsource "ble_adv/Kconfig"
rsource "ble_conn_params/Kconfig"
rsource "ble_conn_state/Kconfig"
rsource "ble_db_discovery/Kconfig"
rsource "ble_gq/Kconfig"
rsource "ble_racp/Kconfig"
rsource "ble_radio_notification/Kconfig"
rsource "ble_scan/Kconfig"
rsource "ble_qwr/Kconfig"
rsource "peer_manager/Kconfig"

menu "Common"

config BLE_GATT_DB_MAX_CHARS
	int "Maximum number of characteristics in a service record (See ble_gatt_db.h)"
	default 6
	help
	  Maximum number of characteristics that can be stored in the characteristics array of
	  the GATT database service structure defined in include/bm/bluetooth/ble_gatt_db.h.
	  The structure is shared by multiple libraries, like ble_db_discovery and peer_manager.

endmenu # Common

endmenu
```

## lib/bluetooth/ble_conn_state/Kconfig
```kconfig
#
# Copyright (c) 2025 Nordic Semiconductor
#
# SPDX-License-Identifier: LicenseRef-Nordic-5-Clause
#
menuconfig BLE_CONN_STATE
	bool "Connection state"
	depends on SOFTDEVICE
	depends on NRF_SDH_BLE
	help
	  A library to defer event processing to main().

if BLE_CONN_STATE

config BLE_CONN_STATE_USER_FLAG_COUNT
	int "User flag count"
	range 0 24
	default 24
	help
	   The number of available user flags.

module=BLE_CONN_STATE
module-str=BLE Connection state
source "${ZEPHYR_BASE}/subsys/logging/Kconfig.template.log_config"

endif
```

## lib/bluetooth/ble_db_discovery/Kconfig
```kconfig
#
# Copyright (c) 2025 Nordic Semiconductor
#
# SPDX-License-Identifier: LicenseRef-Nordic-5-Clause
#

menuconfig BLE_DB_DISCOVERY
	bool "BLE DB discovery [EXPERIMENTAL]"
	depends on SOFTDEVICE_CENTRAL
	depends on NRF_SDH_BLE
	depends on BLE_GATT_QUEUE
	select EXPERIMENTAL

if BLE_DB_DISCOVERY

config BLE_DB_DISCOVERY_MAX_SRV
	int "Maximum number of services for discovery"
	default 6
	help
	  Maximum number of service UUIDs that can be registered for discovery per DB discovery
	  instance. Increasing this value will increase the size of 'struct ble_db_discovery'.

config BLE_DB_DISCOVERY_SRV_DISC_START_HANDLE
	hex "Attribute handle to start discovery from"
	range 0x0001 0xFFFF
	default 0x0001
	help
	  The attribute handle value to start service discovery from.

module=BLE_DB_DISCOVERY
module-str=BLE DB Discovery
source "$(ZEPHYR_BASE)/subsys/logging/Kconfig.template.log_config"

endif # BLE_DB_DISCOVERY
```
