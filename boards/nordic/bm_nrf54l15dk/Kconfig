## boards/nordic/bm_nrf54l15dk/Kconfig
```kconfig
#
# Copyright (c) 2025 Nordic Semiconductor
#
# SPDX-License-Identifier: LicenseRef-Nordic-5-Clause
#

config BOARD_BM_NRF54L15DK
	select BOARD_LATE_INIT_HOOK
	select SOC_NRF54L10_DEVELOP_IN_NRF54L15 if SOC_NRF54L10
	select SOC_NRF54L05_DEVELOP_IN_NRF54L15 if SOC_NRF54L05
```

## boards/nordic/bm_nrf54lm20dk/Kconfig
```kconfig
#
# Copyright (c) 2026 Nordic Semiconductor ASA
#
# SPDX-License-Identifier: LicenseRef-Nordic-5-Clause
#

config BOARD_BM_NRF54LM20DK
	select BOARD_LATE_INIT_HOOK
	select SOC_NRF54LM20A_DEVELOP_IN_NRF54LM20B if SOC_NRF54LM20A_CPUAPP
```

## subsys/softperipheral/Kconfig
```kconfig
#
# Copyright (c) 2026 Nordic Semiconductor
#
# SPDX-License-Identifier: LicenseRef-Nordic-5-Clause
#

choice BM_SOFTPERIPHERAL
	prompt "Soft peripheral selection"
	default BM_SOFTPERIPHERAL_NONE
	depends on NRFX_GPIOTE

config BM_SOFTPERIPHERAL_NONE
	bool "None"

config BM_SOFTPERIPHERAL_SCAN
	bool "sCAN"

config BM_SOFTPERIPHERAL_SEMMC
	bool "sEMMC"

config BM_SOFTPERIPHERAL_SQSPI
	bool "sQSPI"

endchoice # BM_SOFTPERIPHERAL

if !BM_SOFTPERIPHERAL_NONE

rsource "scan/Kconfig"
rsource "semmc/Kconfig"
rsource "sqspi/Kconfig"

endif # !BM_SOFTPERIPHERAL_NONE
```
